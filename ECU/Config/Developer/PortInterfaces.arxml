AUTOSAR XML (schema 4-1-2)
package /MICROSAR_SWCS_DEV/ComM_swc
  mode declaration group ComMMode: category=ALPHABETICAL, initial-mode=COMM_NO_COMMUNICATION
    mode COMM_FULL_COMMUNICATION
    mode COMM_NO_COMMUNICATION
    mode COMM_SILENT_COMMUNICATION
package /MICROSAR_SWCS_DEV/ComM_swc/Interfaces
  4 x client server interface, all with is-service=true:
    ComM_ChannelLimitation
      operation GetInhibitionStatus: possible-error=ComM_ChannelLimitation/E_NOT_OK
        arg Status: type=ComM_InhibitionStatusType, direction=OUT
      operation LimitChannelToNoComMode: possible-error=ComM_ChannelLimitation/E_NOT_OK
        arg Status: type=Boolean, direction=IN
      error E_NOT_OK: error-code=1
    ComM_ChannelWakeUp
      operation GetInhibitionStatus: possible-error=ComM_ChannelWakeUp/E_NOT_OK
        arg Status: type=ComM_InhibitionStatusType, direction=OUT
      operation PreventWakeUp: possible-error=ComM_ChannelWakeUp/E_NOT_OK
        arg Status: type=Boolean, direction=IN
      error E_NOT_OK: error-code=1
    ComM_ECUModeLimitation
      4 x operation, all with possible-error=ComM_ECUModeLimitation/E_NOT_OK:
        LimitECUToNoComMode
          arg Status: type=Boolean, direction=IN
        ReadInhibitCounter
          arg CounterValue: type=UInt16, direction=OUT
        ResetInhibitCounter
        SetECUGroupClassification
          arg Status: type=ComM_InhibitionStatusType, direction=IN
      error E_NOT_OK: error-code=1
    ComM_UserRequest
      4 x operation:
        GetCurrentComMode: possible-error=ComM_UserRequest/E_NOT_OK
          arg ComMode: type=ComM_ModeType, direction=OUT
        GetMaxComMode: possible-error=ComM_UserRequest/E_NOT_OK
          arg ComMode: type=ComM_ModeType, direction=OUT
        GetRequestedComMode: possible-error=ComM_UserRequest/E_NOT_OK
          arg ComMode: type=ComM_ModeType, direction=OUT
        RequestComMode: possible-error=[ComM_UserRequest/E_NOT_OK, E_MODE_LIMITATION]
          arg ComMode: type=ComM_ModeType, direction=IN
      error E_MODE_LIMITATION: error-code=2
      error E_NOT_OK: error-code=1
  mode switch interface ComM_CurrentMode: is-service=true
    mode group currentMode: type=ComMMode
package /MICROSAR_SWCS_DEV/IoHwAb_swc/Interfaces
  client server interface IoHwAbCSPortInterface
    operation LightIntensity
      arg io_signal: type=uint16, direction=OUT
    error E_NOT_OK: error-code=1
  client server interface LightIntensity
    operation LightIntensity
      arg io_signal: type=uint16, direction=OUT
    error E_NOT_OK: error-code=1
package /PortInterfaces
  sender receiver interface Input: invalidation-policy{data-element=LightSwitch, handle-invalid=DONT-INVALIDATE}
    data LightSwitch: type=uint8
  sender receiver interface Output: invalidation-policy{data-element=HeadLight, handle-invalid=DONT-INVALIDATE}
    data HeadLight: type=Boolean
package /Predefined_DEV/ServicePortInterfaces
  21 x client server interface, all with is-service=true:
    NvMAdministration
      operation SetBlockProtection: possible-error=NvMAdministration/E_NOT_OK
        arg ProtectionEnabled: type=Boolean, direction=IN
      error E_NOT_OK: error-code=1
    NvMNotifyInitBlock
      operation InitBlock
    NvMNotifyJobFinished
      operation JobFinished
        arg ServiceId: type=NvM_ServiceIdType, direction=IN
        arg JobResult: type=NvM_RequestResultType, direction=IN
    NvMService
      operation GetErrorStatus
        arg ErrorStatus: type=NvM_RequestResultType, direction=OUT
      error E_NOT_OK: error-code=1
    NvMService_AC2
      operation GetErrorStatus
        arg ErrorStatus: type=NvM_RequestResultType, direction=OUT
      operation ReadBlock
        arg DstPtr: type=dtRef_VOID, direction=IN
      operation WriteBlock
        arg SrcPtr: type=dtRef_const_VOID, direction=IN
      error E_NOT_OK: error-code=1
    NvMService_AC2_Defs
      4 x operation:
        GetErrorStatus
          arg ErrorStatus: type=NvM_RequestResultType, direction=OUT
        ReadBlock
          arg DstPtr: type=dtRef_VOID, direction=IN
        RestoreBlockDefaults
          arg DstPtr: type=dtRef_VOID, direction=IN
        WriteBlock
          arg SrcPtr: type=dtRef_const_VOID, direction=IN
      error E_NOT_OK: error-code=1
    NvMService_AC2_DS
      5 x operation:
        GetDataIndex
          arg DataIndex: type=UInt8, direction=OUT
        GetErrorStatus
          arg ErrorStatus: type=NvM_RequestResultType, direction=OUT
        ReadBlock
          arg DstPtr: type=dtRef_VOID, direction=IN
        SetDataIndex
          arg DataIndex: type=UInt8, direction=IN
        WriteBlock
          arg SrcPtr: type=dtRef_const_VOID, direction=IN
      error E_NOT_OK: error-code=1
    NvMService_AC2_DS_Defs
      6 x operation:
        GetDataIndex
          arg DataIndex: type=UInt8, direction=OUT
        GetErrorStatus
          arg ErrorStatus: type=NvM_RequestResultType, direction=OUT
        ReadBlock
          arg DstPtr: type=dtRef_VOID, direction=IN
        RestoreBlockDefaults
          arg DstPtr: type=dtRef_VOID, direction=IN
        SetDataIndex
          arg DataIndex: type=UInt8, direction=IN
        WriteBlock
          arg SrcPtr: type=dtRef_const_VOID, direction=IN
      error E_NOT_OK: error-code=1
    NvMService_AC2_SRBS
      4 x operation:
        GetErrorStatus
          arg ErrorStatus: type=NvM_RequestResultType, direction=OUT
        ReadBlock
          arg DstPtr: type=dtRef_VOID, direction=IN
        SetRamBlockStatus
          arg RamBlockStatus: type=Boolean, direction=IN
        WriteBlock
          arg SrcPtr: type=dtRef_const_VOID, direction=IN
      error E_NOT_OK: error-code=1
    NvMService_AC2_SRBS_Defs
      5 x operation, all with possible-error=NvMService_AC2_SRBS_Defs/E_NOT_OK:
        GetErrorStatus
          arg ErrorStatus: type=NvM_RequestResultType, direction=OUT
        ReadBlock
          arg DstPtr: type=dtRef_VOID, direction=IN
        RestoreBlockDefaults
          arg DstPtr: type=dtRef_VOID, direction=IN
        SetRamBlockStatus
          arg RamBlockStatus: type=Boolean, direction=IN
        WriteBlock
          arg SrcPtr: type=dtRef_const_VOID, direction=IN
      error E_NOT_OK: error-code=1
    NvMService_AC2_SRBS_DS
      6 x operation:
        GetDataIndex
          arg DataIndex: type=UInt8, direction=OUT
        GetErrorStatus
          arg ErrorStatus: type=NvM_RequestResultType, direction=OUT
        ReadBlock
          arg DstPtr: type=dtRef_VOID, direction=IN
        SetDataIndex
          arg DataIndex: type=UInt8, direction=IN
        SetRamBlockStatus
          arg RamBlockStatus: type=Boolean, direction=IN
        WriteBlock
          arg SrcPtr: type=dtRef_const_VOID, direction=IN
      error E_NOT_OK: error-code=1
    NvMService_AC2_SRBS_DS_Defs
      7 x operation:
        GetDataIndex
          arg DataIndex: type=UInt8, direction=OUT
        GetErrorStatus
          arg ErrorStatus: type=NvM_RequestResultType, direction=OUT
        ReadBlock
          arg DstPtr: type=dtRef_VOID, direction=IN
        RestoreBlockDefaults
          arg DstPtr: type=dtRef_VOID, direction=IN
        SetDataIndex
          arg DataIndex: type=UInt8, direction=IN
        SetRamBlockStatus
          arg RamBlockStatus: type=Boolean, direction=IN
        WriteBlock
          arg SrcPtr: type=dtRef_const_VOID, direction=IN
      error E_NOT_OK: error-code=1
    NvMService_AC3
      5 x operation:
        EraseBlock
        GetErrorStatus
          arg ErrorStatus: type=NvM_RequestResultType, direction=OUT
        InvalidateNvBlock
        ReadBlock
          arg DstPtr: type=dtRef_VOID, direction=IN
        WriteBlock
          arg SrcPtr: type=dtRef_const_VOID, direction=IN
      error E_NOT_OK: error-code=1
    NvMService_AC3_Defs
      6 x operation:
        EraseBlock
        GetErrorStatus
          arg ErrorStatus: type=NvM_RequestResultType, direction=OUT
        InvalidateNvBlock
        ReadBlock
          arg DstPtr: type=dtRef_VOID, direction=IN
        RestoreBlockDefaults
          arg DstPtr: type=dtRef_VOID, direction=IN
        WriteBlock
          arg SrcPtr: type=dtRef_const_VOID, direction=IN
      error E_NOT_OK: error-code=1
    NvMService_AC3_DS
      7 x operation:
        EraseBlock
        GetDataIndex
          arg DataIndex: type=UInt8, direction=OUT
        GetErrorStatus
          arg ErrorStatus: type=NvM_RequestResultType, direction=OUT
        InvalidateNvBlock
        ReadBlock
          arg DstPtr: type=dtRef_VOID, direction=IN
        SetDataIndex
          arg DataIndex: type=UInt8, direction=IN
        WriteBlock
          arg SrcPtr: type=dtRef_const_VOID, direction=IN
      error E_NOT_OK: error-code=1
    NvMService_AC3_DS_Defs
      8 x operation:
        EraseBlock
        GetDataIndex
          arg DataIndex: type=UInt8, direction=OUT
        GetErrorStatus
          arg ErrorStatus: type=NvM_RequestResultType, direction=OUT
        InvalidateNvBlock
        ReadBlock
          arg DstPtr: type=dtRef_VOID, direction=IN
        RestoreBlockDefaults
          arg DstPtr: type=dtRef_VOID, direction=IN
        SetDataIndex
          arg DataIndex: type=UInt8, direction=IN
        WriteBlock
          arg SrcPtr: type=dtRef_const_VOID, direction=IN
      error E_NOT_OK: error-code=1
    NvMService_AC3_SRBS
      6 x operation, all with possible-error=NvMService_AC3_SRBS/E_NOT_OK:
        EraseBlock
        GetErrorStatus
          arg ErrorStatus: type=NvM_RequestResultType, direction=OUT
        InvalidateNvBlock
        ReadBlock
          arg DstPtr: type=dtRef_VOID, direction=IN
        SetRamBlockStatus
          arg RamBlockStatus: type=Boolean, direction=IN
        WriteBlock
          arg SrcPtr: type=dtRef_const_VOID, direction=IN
      error E_NOT_OK: error-code=1
    NvMService_AC3_SRBS_Defs
      7 x operation, all with possible-error=NvMService_AC3_SRBS_Defs/E_NOT_OK:
        EraseBlock
        GetErrorStatus
          arg ErrorStatus: type=NvM_RequestResultType, direction=OUT
        InvalidateNvBlock
        ReadBlock
          arg DstPtr: type=dtRef_VOID, direction=IN
        RestoreBlockDefaults
          arg DstPtr: type=dtRef_VOID, direction=IN
        SetRamBlockStatus
          arg RamBlockStatus: type=Boolean, direction=IN
        WriteBlock
          arg SrcPtr: type=dtRef_const_VOID, direction=IN
      error E_NOT_OK: error-code=1
    NvMService_AC3_SRBS_DS
      8 x operation, all with possible-error=NvMService_AC3_SRBS_DS/E_NOT_OK:
        EraseBlock
        GetDataIndex
          arg DataIndex: type=UInt8, direction=OUT
        GetErrorStatus
          arg ErrorStatus: type=NvM_RequestResultType, direction=OUT
        InvalidateNvBlock
        ReadBlock
          arg DstPtr: type=dtRef_VOID, direction=IN
        SetDataIndex
          arg DataIndex: type=UInt8, direction=IN
        SetRamBlockStatus
          arg RamBlockStatus: type=Boolean, direction=IN
        WriteBlock
          arg SrcPtr: type=dtRef_const_VOID, direction=IN
      error E_NOT_OK: error-code=1
    NvMService_AC3_SRBS_DS_Defs
      9 x operation:
        EraseBlock
        GetDataIndex
          arg DataIndex: type=UInt8, direction=OUT
        GetErrorStatus
          arg ErrorStatus: type=NvM_RequestResultType, direction=OUT
        InvalidateNvBlock
        ReadBlock
          arg DstPtr: type=dtRef_VOID, direction=IN
        RestoreBlockDefaults
          arg DstPtr: type=dtRef_VOID, direction=IN
        SetDataIndex
          arg DataIndex: type=UInt8, direction=IN
        SetRamBlockStatus
          arg RamBlockStatus: type=Boolean, direction=IN
        WriteBlock
          arg SrcPtr: type=dtRef_const_VOID, direction=IN
      error E_NOT_OK: error-code=1
    NvMService_SRBS
      operation GetErrorStatus
        arg ErrorStatus: type=NvM_RequestResultType, direction=OUT
      operation SetRamBlockStatus
        arg RamBlockStatus: type=Boolean, direction=IN
      error E_NOT_OK: error-code=1
