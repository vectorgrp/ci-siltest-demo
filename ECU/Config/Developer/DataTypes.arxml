AUTOSAR XML (schema 4-1-2)
standard types defined: uint16, Boolean, UInt16, UInt32, dtRef_const_VOID, dtRef_VOID, UInt8, boolean, uint8, float32_DataConstr, float64_DataConstr, sint16_DataConstr, sint32_DataConstr, sint8_DataConstr, uint16_DataConstr, uint32_DataConstr, uint8_DataConstr, float32, float64, sint16, sint32, sint8, uint32
package /MICROSAR_SWCS_DEV/IoHwAb_swc/DataTypes/DataConstrs
  range uint16_Constr: raw 0..65535
package /MICROSAR_SWCS_DEV/ComM_swc/DataTypes
  4 x impl type, all with category=VALUE:
    ComM_InhibitionStatusType: base-type=ComM_InhibitionStatusType, range raw 0..255
    ComM_ModeType: base-type=ComM_ModeType, compu {0=COMM_NO_COMMUNICATION, 1=COMM_SILENT_COMMUNICATION, 2=COMM_FULL_COMMUNICATION}
    ComM_UserHandleType: base-type=ComM_UserHandleType, range raw 0..255
    NetworkHandleType: base-type=NetworkHandleType, range raw 0..255, type-emitter=ComM
package /MICROSAR_SWCS_DEV/ComM_swc/DataTypes/BaseTypes
  4 x base type, all with category=FIXED_LENGTH, base-type-encoding=NONE:
    ComM_InhibitionStatusType: base-type-size=8, native-declaration=uint8
    ComM_ModeType: base-type-size=8, native-declaration=uint8
    ComM_UserHandleType: base-type-size=16, native-declaration=uint16
    NetworkHandleType: base-type-size=8, native-declaration=uint8
package /MICROSAR_SWCS_DEV/ComM_swc/DataTypes/DataConstrs
  range UInt16_Constr: raw 0..65535
  range UInt32_Constr: raw 0..4294967295
package /MICROSAR_SWCS_DEV/NvM_swc/DataTypes
  impl type NvM_RequestResultType: category=VALUE, base-type=NvM_RequestResultType, compu {0=NVM_REQ_OK, 1=NVM_REQ_NOT_OK, 2=NVM_REQ_PENDING, 3=NVM_REQ_INTEGRITY_FAILED, 4=NVM_REQ_BLOCK_SKIPPED, 5=NVM_REQ_NV_INVALIDATED, 6=NVM_REQ_CANCELED, 7=NVM_REQ_REDUNDANCY_FAILED, 8=NVM_REQ_RESTORED_FROM_ROM}
  impl type NvM_ServiceIdType: category=VALUE, base-type=NvM_ServiceIdType, compu {6=NVM_READ_BLOCK, 7=NVM_WRITE_BLOCK, 8=NVM_RESTORE_BLOCK_DEFAULTS, 9=NVM_ERASE_BLOCK, 11=NVM_INVALIDATE_NV_BLOCK, 12=NVM_READ_ALL}
package /MICROSAR_SWCS_DEV/NvM_swc/DataTypes/BaseTypes
  base type NvM_RequestResultType: category=FIXED_LENGTH, base-type-size=8, base-type-encoding=NONE, native-declaration=uint8
  base type NvM_ServiceIdType: category=FIXED_LENGTH, base-type-size=8, base-type-encoding=NONE, native-declaration=uint8
package /MICROSAR_SWCS_DEV/NvM_swc/DataTypes/DataConstrs
  range UInt8_Constr: raw 0..255
package /DataType/Constraint
  range DC_HeadLight: raw 0..1
  range DC_LightSwitch: raw 0..3
package /DataType/Semantics
  compu method CM_HeadLight: 0=Cx0_Off, 1=Cx1_On
  compu method CM_LightSwitch: 0=Cx0_Off, 1=Cx1_On, 2=Cx2_Auto, 3=Cx3_SNA  # Source signal range: [0,2]
