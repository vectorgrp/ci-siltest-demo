AUTOSAR XML (schema 4-1-2)
package /ECUCompositionTypes
  composition sw component type ECU_Composition
package /EndToEndProtections
  end to end protection set EndToEndConnections
package /Systems
  system LightControl: category=SYSTEM_EXTRACT
    system mapping LightControl_MPPNG
    root-software-compositions:
      root sw composition prototype ECU_Composition: software-composition=ECU_Composition
