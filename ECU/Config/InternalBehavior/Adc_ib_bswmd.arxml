AUTOSAR XML (schema 4-1-2)
package /TS_T2D22M10I1R0/Adc_ib_bswmd/BswModuleDescriptions
  bsw module description Adc
    bsw internal behavior AdcBehavior
      27 x exclusive area:
        ADC_EXCLUSIVE_AREA_{00..26}
