AUTOSAR XML (schema 4-0-3)
package /TS_T2D22M10I0R0/Dio_ib_bswmd/BswModuleDescriptions
  bsw module description Dio
    bsw internal behavior DioBehavior
      exclusive area DIO_EXCLUSIVE_AREA_00
package /TS_T2D22M10I1R0/Dio_ib_bswmd/BswModuleDescriptions
  bsw module description Dio
    bsw internal behavior DioBehavior
      exclusive area DIO_EXCLUSIVE_AREA_00
