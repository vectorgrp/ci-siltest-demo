AUTOSAR XML (schema 4-1-2)
package /MICROSAR/Can_CanoeemuCanoe_ib_bswmd/BswModuleDescriptions
  bsw module description Can
    provided-entrys:
      BswModuleDescriptions/Can_MainFunction_BusOff
      BswModuleDescriptions/Can_MainFunction_Wakeup
      BswModuleDescriptions/Can_MainFunction_Mode
    bsw internal behavior Can_CanoeemuCanoeBehavior
      8 x exclusive area:
        CAN_EXCLUSIVE_AREA_{0..7}
      bsw schedulable entity Can_MainFunction_BusOff: implemented-entry=BswModuleDescriptions/Can_MainFunction_BusOff
      bsw schedulable entity Can_MainFunction_Wakeup: implemented-entry=BswModuleDescriptions/Can_MainFunction_Wakeup
      bsw schedulable entity Can_MainFunction_Mode: implemented-entry=BswModuleDescriptions/Can_MainFunction_Mode
      bsw timing event Can_MainFunction_BusOffTimingEvent0: starts-on-event=Can_CanoeemuCanoeBehavior/Can_MainFunction_BusOff, period=0.01
      bsw timing event Can_MainFunction_WakeupTimingEvent0: starts-on-event=Can_CanoeemuCanoeBehavior/Can_MainFunction_Wakeup, period=0.01
      bsw timing event Can_MainFunction_ModeTimingEvent0: starts-on-event=Can_CanoeemuCanoeBehavior/Can_MainFunction_Mode, period=0.01
  bsw module entry Can_MainFunction_BusOff: call-type=SCHEDULED, execution-context=TASK
  bsw module entry Can_MainFunction_Wakeup: call-type=SCHEDULED, execution-context=TASK
  bsw module entry Can_MainFunction_Mode: call-type=SCHEDULED, execution-context=TASK
package /MICROSAR/Can_Mac7100Flexcan_ib_bswmd/BswModuleDescriptions
  bsw module description Can
    provided-entrys:
      BswModuleDescriptions/Can_MainFunction_BusOff
      BswModuleDescriptions/Can_MainFunction_Wakeup
      BswModuleDescriptions/Can_MainFunction_Mode
    bsw internal behavior Can_Mac7100Flexcan_Behavior
      7 x exclusive area:
        CAN_EXCLUSIVE_AREA_{0..6}
      bsw schedulable entity Can_MainFunction_BusOff: implemented-entry=BswModuleDescriptions/Can_MainFunction_BusOff
      bsw schedulable entity Can_MainFunction_Wakeup: implemented-entry=BswModuleDescriptions/Can_MainFunction_Wakeup
      bsw schedulable entity Can_MainFunction_Mode: implemented-entry=BswModuleDescriptions/Can_MainFunction_Mode
      bsw timing event Can_MainFunction_BusOffTimingEvent0: starts-on-event=Can_Mac7100Flexcan_Behavior/Can_MainFunction_BusOff, period=0.01
      bsw timing event Can_MainFunction_WakeupTimingEvent0: starts-on-event=Can_Mac7100Flexcan_Behavior/Can_MainFunction_Wakeup, period=0.01
      bsw timing event Can_MainFunction_ModeTimingEvent0: starts-on-event=Can_Mac7100Flexcan_Behavior/Can_MainFunction_Mode, period=0.01
  bsw module entry Can_MainFunction_BusOff: call-type=SCHEDULED, execution-context=TASK
  bsw module entry Can_MainFunction_Wakeup: call-type=SCHEDULED, execution-context=TASK
  bsw module entry Can_MainFunction_Mode: call-type=SCHEDULED, execution-context=TASK
