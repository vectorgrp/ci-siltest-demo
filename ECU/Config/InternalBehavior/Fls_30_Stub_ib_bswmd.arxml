AUTOSAR XML (schema 4-1-2)
package /MICROSAR/Fls_ib_bswmd/BswModuleDescriptions
  bsw module entry Fls_30_Stub_MainFunction: call-type=SCHEDULED, execution-context=TASK
