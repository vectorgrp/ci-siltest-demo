AUTOSAR XML (schema 4-1-2)
package /MICROSAR/Fls_ib_bswmd/BswModuleDescriptions
  bsw module description Fls: provided-entrys=[Fls_MainFunction, Fls_30_Stub_MainFunction]
    bsw internal behavior FlsBehavior
      bsw schedulable entity Fls_MainFunction: implemented-entry=Fls_MainFunction
      bsw timing event Fls_MainFunctionTimingEvent0: starts-on-event=Fls_MainFunction, period=0.01
  bsw module entry Fls_MainFunction: call-type=SCHEDULED, execution-context=TASK
