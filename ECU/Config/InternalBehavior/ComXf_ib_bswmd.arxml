AUTOSAR XML (schema 00048)
package /MICROSAR
  bsw implementation ComXf_Impl: programming-language=C, sw-version=1.20.00, used-code-generator=DaVinci Configurator, vendor-id=30, ar-release-version=4.03.01
