AUTOSAR XML (schema 4-0-3)
package /TS_T2D22M10I0R0/Mcu_ib_bswmd/BswModuleDescriptions
  bsw module description Mcu
    bsw internal behavior McuBehavior
      4 x exclusive area:
        MCU_EXCLUSIVE_AREA_{00..03}
package /TS_T2D22M10I1R0/Mcu_ib_bswmd/BswModuleDescriptions
  bsw module description Mcu
    bsw internal behavior McuBehavior
      4 x exclusive area:
        MCU_EXCLUSIVE_AREA_{00..03}
