AUTOSAR XML (schema 4-2-1)
package /MICROSAR/CanTrcv_Tja1043_ib_bswmd/BswModuleDescriptions
  bsw module description CanTrcv: provided-entrys=CanTrcv_30_Tja1043_MainFunction
    bsw internal behavior CanTrcv_Tja1043_Behavior
      exclusive area CANTRCV_30_TJA1043_EXCLUSIVE_AREA_0
      bsw schedulable entity CanTrcv_30_Tja1043_MainFunction: implemented-entry=CanTrcv_30_Tja1043_MainFunction
      bsw timing event CanTrcv_30_Tja1043_MainFunctionTimingEvent0: starts-on-event=CanTrcv_30_Tja1043_MainFunction, period=0.01
  bsw module entry CanTrcv_30_Tja1043_MainFunction: call-type=SCHEDULED, execution-context=TASK
