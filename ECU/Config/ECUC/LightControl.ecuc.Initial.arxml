AUTOSAR XML (schema 00048)
package /InitialEcuC
  ecuc value collection InitialEcuC: ecuc-values=[Can, CanIf, CanNm, CanSM, Com, ComM, EcuC, EcuM, Nm, PduR]
  module config Can
    CanConfigSet
      CT_CAN00_6199f384 (CanController):  # CAN00
        CanBusName = CAN00
        CanControllerActivation = true
        CanControllerDefaultBaudrate = CanControllerBaudrateConfig
        CanControllerSystemRef = CT_CAN00
        CanWakeupSourceRef = EcuMCommonConfiguration/CN_CAN00_a2373004
        CanControllerBaudrateConfig: CanControllerBaudRate=500
      CN_CAN00_193527e3_Rx (CanHardwareObject): CanHandleType=BASIC, CanIdType=STANDARD, CanIdValue=0, CanObjectType=RECEIVE, CanControllerRef=CanConfigSet/CT_CAN00_6199f384
      CN_CAN00_a2373004_Tx (CanHardwareObject): CanHandleType=BASIC, CanIdValue=0, CanObjectType=TRANSMIT, CanControllerRef=CanConfigSet/CT_CAN00_6199f384
    CanGeneral: CanIndex=0
  module config CanIf
    CanIfCtrlDrvCfg_7d254554 (CanIfCtrlDrvCfg): CanIfCtrlDrvInitHohConfigRef=CanIfInitHohCfg, CanIfCtrlDrvNameRef=CanGeneral
      CT_CAN00_6199f384 (CanIfCtrlCfg): CanIfCtrlCanCtrlRef=CanConfigSet/CT_CAN00_6199f384
    CanIfInitCfg
      CHNL_0fb271d2 (CanIfBufferCfg): CanIfBufferSize=0, CanIfBufferHthRef=CanIfInitHohCfg/CN_CAN00_a2373004_Tx
      CanIfInitHohCfg: CanIfInitRefCfgSet=CanConfigSet
        CN_CAN00_193527e3_Rx (CanIfHrhCfg): CanIfHrhCanCtrlIdRef=CanIfCtrlDrvCfg_7d254554/CT_CAN00_6199f384, CanIfHrhIdSymRef=CanConfigSet/CN_CAN00_193527e3_Rx
        CN_CAN00_a2373004_Tx (CanIfHthCfg): CanIfHthCanCtrlIdRef=CanIfCtrlDrvCfg_7d254554/CT_CAN00_6199f384, CanIfHthIdSymRef=CanConfigSet/CN_CAN00_a2373004_Tx
      BFC_665f3a14_Rx (CanIfRxPduCfg):
        CanIfRxPduCanIdType = STANDARD_CAN
        CanIfRxPduDlc = 8
        CanIfRxPduUserRxIndicationName = CanNm_RxIndication
        CanIfRxPduUserRxIndicationUL = CAN_NM
        CanIfRxPduHrhIdRef = CanIfInitHohCfg/CN_CAN00_193527e3_Rx
        CanIfRxPduRef = BFC_f09b214a_Rx
        CHNL_6a942da5 (CanIfRxPduCanIdRange): CanIfRxPduCanIdRangeLowerCanId=1024, CanIfRxPduCanIdRangeUpperCanId=1087
      LightSwitch_oCAN00_042dae16_Rx (CanIfRxPduCfg):
        CanIfRxPduCanId = 528
        CanIfRxPduCanIdType = STANDARD_CAN
        CanIfRxPduDlc = 2
        CanIfRxPduUserRxIndicationName = PduR_CanIfRxIndication
        CanIfRxPduUserRxIndicationUL = PDUR
        CanIfRxPduHrhIdRef = CanIfInitHohCfg/CN_CAN00_193527e3_Rx
        CanIfRxPduRef = EcucPduCollection/LightSwitch_oCAN00_8d4de26e_Rx
      LightCtrl_oCAN00_d9f1a7da_Tx (CanIfTxPduCfg):
        CanIfTxPduCanId = 616
        CanIfTxPduCanIdType = STANDARD_CAN
        CanIfTxPduDlc = 8
        CanIfTxPduUserTxConfirmationName = PduR_CanIfTxConfirmation
        CanIfTxPduUserTxConfirmationUL = PDUR
        CanIfTxPduBufferRef = CanIfInitCfg/CHNL_0fb271d2
        CanIfTxPduRef = EcucPduCollection/LightCtrl_oCAN00_0afee19e_Tx
      NmBFC_oCAN00_feb4f615_Tx (CanIfTxPduCfg):
        CanIfTxPduCanId = 1026
        CanIfTxPduCanIdType = STANDARD_CAN
        CanIfTxPduDlc = 8
        CanIfTxPduUserTxConfirmationName = CanNm_TxConfirmation
        CanIfTxPduUserTxConfirmationUL = CAN_NM
        CanIfTxPduBufferRef = CanIfInitCfg/CHNL_0fb271d2
        CanIfTxPduRef = EcucPduCollection/NmBFC_oCAN00_4874935e_Tx
    CanIfPrivateCfg: CanIfPrivateSoftwareFilterType=LINEAR
    CanIfPublicCfg: CanIfPublicPnSupport=false
  module config CanNm
    CanNmGlobalConfig: CanNmPnEiraCalcEnabled=false, CanNmUserDataEnabled=true
      CAN00_CAN_5faa4e95 (CanNmChannelConfig):
        CanNmMsgCycleOffset = 0
        CanNmMsgCycleTime = 0.1
        CanNmMsgReducedTime = 0.05
        CanNmNodeId = 2
        CanNmRepeatMessageTime = 0.4
        CanNmTimeoutTime = 1
        CanNmUserDataLength = 6
        CanNmWaitBusSleepTime = 0.75
        CanNmComMNetworkHandleRef = ComMConfigSet/CN_CAN00_a2373004
        CAN00_CAN_5faa4e95_Rx (CanNmRxPdu): CanNmRxPduRef=BFC_f09b214a_Rx
        NmBFC_oCAN00_4874935e_Tx (CanNmTxPdu): CanNmTxPduRef=EcucPduCollection/NmBFC_oCAN00_4874935e_Tx
  module config CanSM
    CanSMConfiguration
      CHNL_0fb271d2 (CanSMManagerNetwork): CanSMComMNetworkHandleRef=ComMConfigSet/CN_CAN00_a2373004
        CT_CAN00_9bd332a1 (CanSMController): CanSMControllerId=CanIfCtrlDrvCfg_7d254554/CT_CAN00_6199f384
  module config Com
    ComConfig
      LightCtrl_oCAN00_2e88b3f5_Tx (ComIPdu):
        ComIPduDirection = SEND
        ComIPduType = NORMAL
        ComIPduGroupRef = BFC_oCAN00_Tx_5d56b2ca
        ComIPduSignalRef = HeadLight_oLightCtrl_oCAN00_3d3756da_Tx
        ComPduIdRef = EcucPduCollection/LightCtrl_oCAN00_2e88b3f5_Tx
        ComTxIPdu: ComMinimumDelayTime=0, ComTxIPduUnusedAreasDefault=0
          ComTxModeFalse
            ComTxMode: ComTxModeMode=PERIODIC, ComTxModeTimeOffset=0, ComTxModeTimePeriod=0.01
          ComTxModeTrue
            ComTxMode: ComTxModeMode=PERIODIC, ComTxModeTimeOffset=0, ComTxModeTimePeriod=0.01
      LightSwitch_oCAN00_d3b6d56e_Rx (ComIPdu):
        ComIPduDirection = RECEIVE
        ComIPduType = NORMAL
        ComIPduGroupRef = BFC_oCAN00_Rx_0b0c154c
        ComIPduSignalRef = LightSwitch_oLightSwitch_oCAN00_b775c021_Rx
        ComPduIdRef = EcucPduCollection/LightSwitch_oCAN00_d3b6d56e_Rx
      BFC_oCAN00_Rx_0b0c154c (ComIPduGroup)
      BFC_oCAN00_Tx_5d56b2ca (ComIPduGroup)
      HeadLight_oLightCtrl_oCAN00_3d3756da_Tx (ComSignal):
        ComBitPosition = 0
        ComBitSize = 1
        ComSignalEndianness = LITTLE_ENDIAN
        ComSignalInitValue = 0
        ComSignalType = BOOLEAN
        ComTransferProperty = PENDING
        ComSystemTemplateSystemSignalRef = HeadLight
      LightSwitch_oLightSwitch_oCAN00_b775c021_Rx (ComSignal):
        ComBitPosition = 0
        ComBitSize = 2
        ComSignalDataInvalidValue = 3
        ComSignalEndianness = LITTLE_ENDIAN
        ComSignalInitValue = 0
        ComSignalType = UINT8
        ComTimeout = 0
        ComSystemTemplateSystemSignalRef = LightSwitch
    ComGeneral
  module config ComM
    ComMConfigSet: ComMPncEnabled=false
      CN_CAN00_a2373004 (ComMChannel): ComMBusType=COMM_BUS_TYPE_CAN, ComMChannelId=0
        ComMNetworkManagement: ComMNmVariant=FULL
        CN_CAN00_6854f362 (ComMUserPerChannel): ComMUserChannel=CN_CAN00_68d36c54
      CN_CAN00_68d36c54 (ComMUser): ComMUserIdentifier=0
    ComMGeneral: ComMPncIdCounting=COMM_PNC_ID_COUNT_FROM_NM_MESSAGE, ComMPncSupport=false
  module config EcuC
    EcucPduCollection: PduIdTypeEnum=UINT8, PduLengthTypeEnum=UINT8
      6 x Pdu:
        BFC_f09b214a_Rx: PduLength=8
        LightCtrl_oCAN00_0afee19e_Tx: DynamicLength=false, PduLength=8, SysTPduToFrameMappingRef=LightCtrl
        LightCtrl_oCAN00_2e88b3f5_Tx: DynamicLength=false, PduLength=8
        LightSwitch_oCAN00_8d4de26e_Rx: DynamicLength=false, PduLength=2, SysTPduToFrameMappingRef=LightSwitch
        LightSwitch_oCAN00_d3b6d56e_Rx: DynamicLength=false, PduLength=2
        NmBFC_oCAN00_4874935e_Tx: DynamicLength=false, PduLength=8, SysTPduToFrameMappingRef=NmBFC
  module config EcuM
    EcuMConfiguration
      EcuMCommonConfiguration
        EcuMDriverInitListOne
        EcuMDriverRestartList
        CN_CAN00_a2373004 (EcuMWakeupSource): EcuMWakeupSourceId=5, EcuMComMChannelRef=ComMConfigSet/CN_CAN00_a2373004
      EcuMFlexConfiguration: EcuMFlexModuleConfigurationRef=CanConfigSet
  module config Nm
    CN_CAN00_a2373004 (NmChannelConfig): NmComMChannelRef=ComMConfigSet/CN_CAN00_a2373004
      CAN00_CAN_5faa4e95 (NmBusType)
        NmStandardBusNmConfig: NmStandardBusType=NM_BUSNM_CANNM  # CAN00_CAN
    NmGlobalConfig
      NmGlobalFeatures: NmNodeIdEnabled=true, NmUserDataEnabled=true
      NmGlobalProperties
  module config PduR
    PduRGeneral
    PduRRoutingTables
      PduRRoutingTable
        LightCtrl_oCAN00_2e88b3f5_Tx (PduRRoutingPath)
          LightCtrl_oCAN00_0afee19e_Tx (PduRDestPdu): PduRDestPduRef=EcucPduCollection/LightCtrl_oCAN00_0afee19e_Tx
          PduRSrcPdu_30bff602 (PduRSrcPdu): PduRSrcPduRef=EcucPduCollection/LightCtrl_oCAN00_2e88b3f5_Tx
        LightSwitch_oCAN00_8d4de26e_Rx (PduRRoutingPath)
          LightSwitch_oCAN00_8d4de26e_Rx_d73f9532_Rx (PduRDestPdu): PduRDestPduRef=EcucPduCollection/LightSwitch_oCAN00_d3b6d56e_Rx
          PduRSrcPdu_d73f9532 (PduRSrcPdu): PduRSrcPduRef=EcucPduCollection/LightSwitch_oCAN00_8d4de26e_Rx
