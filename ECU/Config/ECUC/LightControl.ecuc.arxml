[part 1 of 2: package /ActiveEcuC]
AUTOSAR XML (schema 00048)
package /ActiveEcuC
  ecuc value collection ActiveEcuC: ecu-extract=SYSTEM
    ecuc-values:
      CanSM
      Mcu
      EcuC
      Det
      CanIf
      Os
      Nm
      PduR
      BswM
      Com
      Can
      Rte
      EcuM
      CanNm
      ComM
      Crc
      Dem
      Fee
      MemIf
      NvM
      Fls
      Adc
      VTTAdc
      VTTCan
      VTTCntrl
      VTTEcuC
      VTTFls
      VTTMcu
      VTTOs
      VTTvSet
      vSet
      MemMap
      VTTMemMap
  module config CanSM: implementation-config-variant=VARIANT-PRE-COMPILE, module-description=CanSM_Impl
    CanSMGeneral:
      CanSMDevErrorDetect = true
      CanSMMainFunctionTimePeriod = 0.01
      CanSMVersionInfoApi = false
      CanSMBorCheckLevel = false
      CanSMSetBaudrateApi = true
      CanSMEcuPassiveMode = false
      CanSMPreventBusSleepAtStartUp = false
      CanSmChangeBaudrateApi = false
      CanSMSafeBswChecks = false
      CanSMGeneration: CanSMOutOfBoundsWriteSanitizer=false, CanSMOutOfBoundsReadSanitizer=false
    CanSMConfiguration: CanSMModeRequestRepetitionMax=10, CanSMModeRequestRepetitionTime=0.1
      CHNL_0fb271d2 (CanSMManagerNetwork):
        CanSMBorCounterL1ToL2 = 5
        CanSMBorTimeL1 = 1
        CanSMBorTimeL2 = 3
        CanSMBorTimeTxEnsured = 5
        CanSMBorTxConfirmationPolling = false
        CanSMComMNetworkHandleRef = ComMConfigSet/CN_CAN00_a2373004
        CT_CAN00_9bd332a1 (CanSMController): CanSMControllerId=CanIfCtrlDrvCfg_7d254554/CT_CAN00_6199f384
  module config Mcu: implementation-config-variant=VARIANT-PRE-COMPILE, module-description=Mcu_Impl
    McuModuleConfiguration
      McuClockSettingConfig: McuClockSettingId=1
        McuClockReferencePoint: McuClockReferencePointFrequency=80000000
      4 x McuModeSettingConf:
        NORMAL: McuMode=0, McuVttMode=VTTMCU_MODE_NORMAL
        SLEEP: McuMode=1, McuVttMode=VTTMCU_MODE_SLEEP
        RESET: McuMode=2, McuVttMode=VTTMCU_MODE_RESET
        POWER_OFF: McuMode=3, McuVttMode=VTTMCU_MODE_POWER_OFF
    McuPublishedInformation
      McuResetReasonConf: McuResetReason=0
    McuGeneralConfiguration:
      McuDevErrorDetect = true
      McuGetRamStateApi = false
      McuInitClock = true
      McuNoPll = true
      McuPerformResetApi = true
      McuVersionInfoApi = true
      McuSafeBswChecks = false
  module config EcuC: implementation-config-variant=VARIANT-PRE-COMPILE, module-description=EcuC_Impl
    EcucPduCollection: PduIdTypeEnum=UINT8, PduLengthTypeEnum=UINT8
      7 x Pdu, all with J1939Requestable=false:
        NmBFC_oCAN00_4874935e_Tx: DynamicLength=false, PduLength=8, SysTPduToFrameMappingRef=NmBFC
        CAN00_NmRxPdu_f26020e5: PduLength=8
        LightSwitch_oCAN00_8d4de26e_Rx: DynamicLength=false, PduLength=2, SysTPduToFrameMappingRef=LightSwitch
        LightCtrl_oCAN00_0afee19e_Tx: DynamicLength=false, PduLength=8, SysTPduToFrameMappingRef=LightCtrl
        LightCtrl_oCAN00_2e88b3f5_Tx: DynamicLength=false, PduLength=8
        LightSwitch_oCAN00_d3b6d56e_Rx: DynamicLength=false, PduLength=2
        BFC_f09b214a_Rx: PduLength=8
    EcucGeneral:
      CPUType = CPU32Bit
      ByteOrder = LITTLE_ENDIAN
      BitOrder = LSB_to_MSB
      AtomicBitAccessInBitfield = false
      AtomicVariableAccess = Atomic32BitAccess
      SizeOfEnum = Size32Bit
      SizeOfInt = Size32Bit
      SizeOfROMPointer = Size32Bit
      SizeOfRAMPointer = Size32Bit
      BitFieldDataType = INT
      StructAlignment = Auto
      ArrayAlignment = Auto
      StructInArrayAlignment = Auto
      DummyFunction = false
      DummyStatement = false
      DummyStatementKind = None
      ConditionalGenerating = true
      EcucBswImplementationCodeType = EcuCSourceCode
      EcuCUseStdReturnTypeForRte = false
      BswInitialization
        44 x InitFunction:
          PduR_Init: Header=PduR.h, InitPhase=INIT_TWO_COM, ConfigType=PduR_PBConfigType, ConfigPtrName=PduR_Config_Ptr, ConfigPtrClass=PDUR_INIT_DATA, ModuleRef=PduR  # Ecuc Bsw Init Function PLAIN_TEXT Init function description of PduR in ModelView (UnfilteredInvariantProjectModelView) .
          ComM_Init: Header=ComM.h, InitPhase=INIT_TWO_POST_NVMREADALL, ConfigType=ComM_ConfigType, ConfigPtrName=ComM_Config_Ptr, ConfigPtrClass=COMM_INIT_DATA, ModuleRef=ComM  # Ecuc Bsw Init Function PLAIN_TEXT Init function description of ComM UB:Init function description of ComM /ActiveEcuC/ComM Init function description of ComM in UnfilteredViewInInvariantProject (UnfilteredInvariantProjectModelView) .
          Com_Init: Header=Com.h, InitPhase=INIT_TWO_COM, ConfigType=Com_ConfigType, ConfigPtrName=Com_Config_Ptr, ConfigPtrClass=COM_INIT_DATA, ModuleRef=Com  # Ecuc Bsw Init Function PLAIN_TEXT Init function description of Com in ModelView (UnfilteredInvariantProjectModelView) .
          CanNm_Init: Header=CanNm.h, InitPhase=INIT_TWO_NM, ConfigType=CanNm_ConfigType, ConfigPtrName=CanNm_Config_Ptr, ConfigPtrClass=CANNM_INIT_DATA, ModuleRef=CanNm  # Ecuc Bsw Init Function PLAIN_TEXT Initialization of the CAN Network Management and its internal state machine
          EcuM_Init: Header=EcuM.h, InitPhase=NO_INIT, ConfigType=EcuM_PbConfigType, ConfigPtrName=EcuM_Config_Ptr, ConfigPtrClass=ECUM_INIT_DATA, ModuleRef=EcuM  # Ecuc Bsw Init Function PLAIN_TEXT Init function description of EcuM in ModelView (UnfilteredInvariantProjectModelView) .
          CanSM_Init: Header=CanSM_EcuM.h, InitPhase=INIT_TWO_SM, ConfigType=CanSM_ConfigType, ConfigPtrName=CanSM_Config_Ptr, ConfigPtrClass=CANSM_INIT_DATA, ModuleRef=CanSM  # Ecuc Bsw Init Function PLAIN_TEXT Init function description of CanSM in ModelView (UnfilteredInvariantProjectModelView) .
          BswM_Init: Header=BswM.h, ConfigType=BswM_ConfigType, ConfigPtrName=BswM_Config_Ptr, ConfigPtrClass=BSWM_INIT_DATA, InitPhase=NO_INIT, ModuleRef=BswM  # Ecuc Bsw Init Function PLAIN_TEXT Init function description of BswM in ModelView (UnfilteredInvariantProjectModelView) .
          CanIf_Init: Header=CanIf.h, InitPhase=INIT_TWO_IF, ConfigType=CanIf_ConfigType, ConfigPtrName=CanIf_Config_Ptr, ConfigPtrClass=CANIF_INIT_DATA, ModuleRef=CanIf  # Ecuc Bsw Init Function PLAIN_TEXT Init function description of CanIf in ModelView (UnfilteredInvariantProjectModelView) .
          BswM_InitMemory: Header=BswM.h, InitPhase=INIT_MEMORY, ModuleRef=BswM  # Ecuc Bsw Init Function PLAIN_TEXT InitMemory function description of BswM in ModelView (UnfilteredInvariantProjectModelView) .
          Can_InitMemory: Header=Can.h, InitPhase=INIT_MEMORY, ModuleRef=Can  # Ecuc Bsw Init Function PLAIN_TEXT InitMemory function description of Can in ModelView (UnfilteredInvariantProjectModelView) .
          Can_Init: Header=Can.h, InitPhase=INIT_TWO_DRV, ConfigType=Can_ConfigType, ConfigPtrName=Can_Config_Ptr, ConfigPtrClass=CAN_INIT_DATA, ModuleRef=Can  # Ecuc Bsw Init Function PLAIN_TEXT Init function description of Can in ModelView (UnfilteredInvariantProjectModelView) .
          CanIf_InitMemory: Header=CanIf.h, InitPhase=INIT_MEMORY, ModuleRef=CanIf  # Ecuc Bsw Init Function PLAIN_TEXT InitMemory function description of CanIf in ModelView (UnfilteredInvariantProjectModelView) .
          CanNm_InitMemory: Header=CanNm.h, InitPhase=INIT_MEMORY, ModuleRef=CanNm  # Ecuc Bsw Init Function PLAIN_TEXT Initialize Memory, so that expected start values are set
          CanSM_InitMemory: Header=CanSM_EcuM.h, InitPhase=INIT_MEMORY, ModuleRef=CanSM  # Ecuc Bsw Init Function PLAIN_TEXT InitMemory function description of CanSM in ModelView (UnfilteredInvariantProjectModelView) .
          Com_InitMemory: Header=Com.h, InitPhase=INIT_MEMORY, ModuleRef=Com  # Ecuc Bsw Init Function PLAIN_TEXT InitMemory function description of Com in ModelView (UnfilteredInvariantProjectModelView) .
          ComM_InitMemory: Header=ComM.h, InitPhase=INIT_MEMORY, ModuleRef=ComM  # Ecuc Bsw Init Function PLAIN_TEXT Initializes variables of Communication Manager
          Dem_InitMemory: Header=Dem.h, InitPhase=INIT_MEMORY, ModuleRef=Dem  # Ecuc Bsw Init Function PLAIN_TEXT InitMemory function description of Dem in ModelView (UnfilteredInvariantProjectModelView) .
          Dem_PreInit: Header=Dem.h, InitPhase=INIT_ZERO, ConfigType=Dem_ConfigType, ConfigPtrName=Dem_Config_Ptr, ConfigPtrClass=DEM_INIT_DATA, ModuleRef=Dem  # Ecuc Bsw Init Function PLAIN_TEXT PreInit function description of Dem in ModelView (UnfilteredInvariantProjectModelView) .
          Dem_Init: Header=Dem.h, InitPhase=INIT_TWO_POST_NVMREADALL, ConfigType=Dem_ConfigType, ConfigPtrName=Dem_Config_Ptr, ConfigPtrClass=DEM_INIT_DATA, ModuleRef=Dem  # Ecuc Bsw Init Function PLAIN_TEXT Init function description of Dem in ModelView (UnfilteredInvariantProjectModelView) .
          Fee_Init: Header=Fee.h, InitPhase=INIT_TWO_IF, ModuleRef=Fee  # Ecuc Bsw Init Function PLAIN_TEXT Initialization of the FEE
          Nm_InitMemory: Header=Nm.h, InitPhase=INIT_MEMORY, ModuleRef=Nm  # Ecuc Bsw Init Function PLAIN_TEXT Pre-Initialization of the Network Management and its internal state machine
          Nm_Init: Header=Nm.h, InitPhase=INIT_TWO_NM, ConfigType=Nm_ConfigType, ConfigPtrName=Nm_Config_Ptr, ConfigPtrClass=NM_INIT_DATA, ModuleRef=Nm  # Ecuc Bsw Init Function PLAIN_TEXT Initialization of the Network Management and its internal state machine /ActiveEcuC/Nm Init function description of Nm in UnfilteredViewInInvariantProject (UnfilteredInvariantProjectModelView) .
          NvM_Init: Header=NvM.h, InitPhase=INIT_TWO_SYS, ModuleRef=NvM  # Ecuc Bsw Init Function PLAIN_TEXT Initialization of the NVRAM Manager, to make it ready for NvM_ReadAll being requested
          PduR_InitMemory: Header=PduR.h, InitPhase=INIT_MEMORY, ModuleRef=PduR  # Ecuc Bsw Init Function PLAIN_TEXT InitMemory function description of PduR in ModelView (UnfilteredInvariantProjectModelView) .
          Adc_Init: Header=Adc.h, InitPhase=INIT_TWO_MCAL, ConfigPtrClass=ADC_APPL_CONST, ConfigPtrName=AdcConfigSet, ConfigType=Adc_ConfigType, ModuleRef=Adc
          Adc_InitMemory: Header=Adc.h, InitPhase=INIT_MEMORY, ModuleRef=Adc
          Rte_InitMemory: Header=Rte_Main.h, InitPhase=INIT_MEMORY, ModuleRef=Rte  # UB:Automatically generated by EcuCBswInitFctConfigurationService.
          Fls_InitMemory: Header=Fls.h, InitPhase=INIT_MEMORY, ConfigPtrClass=, ConfigPtrName=, ConfigType=, ModuleRef=Fls
          Det_Init: Header=Det.h, InitPhase=INIT_ZERO, ConfigType=Det_ConfigType, ConfigPtrName=Det_Config_Ptr, ConfigPtrClass=DET_INIT_DATA, ModuleRef=Det  # UB:Initialization of the Det and its internal state machine
          Det_Start: Header=Det.h, InitPhase=INIT_ONE, ModuleRef=Det
          Mcu_Init: Header=Mcu.h, InitPhase=INIT_TWO_MCAL, ConfigPtrClass=MCU_APPL_CONST, ConfigPtrName=McuModuleConfiguration, ConfigType=Mcu_ConfigType, ModuleRef=Mcu
          SchM_Init: Header=Rte_Main.h, InitPhase=NO_INIT, ModuleRef=Rte  # UB:Automatically generated by EcuCBswInitFctConfigurationService.
          Det_InitMemory: Header=Det.h, InitPhase=INIT_MEMORY, ModuleRef=Det  # UB:Initialize Memory, so that expected start values are set
          Fls_Init: Header=Fls.h, InitPhase=INIT_TWO_MCAL, ConfigType=Fls_ConfigType, ConfigPtrName=FlsConfigSet, ConfigPtrClass=FLS_APPL_CONST, ModuleRef=Fls
          BswM_PreInit: Header=BswM.h, InitPhase=INIT_ONE, ConfigType=BswM_ConfigType, ConfigPtrName=BswM_Config_Ptr, ConfigPtrClass=BSWM_INIT_DATA, ModuleRef=BswM
          Rte_StartTiming: Header=Rte_Main.h, InitPhase=NO_INIT, ModuleRef=Rte
          Rte_Start: Header=Rte_Main.h, InitPhase=INIT_THREE, ModuleRef=Rte
          PduR_PreInit: Header=PduR.h, InitPhase=INIT_ONE, ConfigType=PduR_PBConfigType, ConfigPtrName=PduR_Config_Ptr, ConfigPtrClass=PDUR_INIT_DATA, ModuleRef=PduR
          ComM_PostInit: Header=ComM.h, InitPhase=INIT_THREE, ModuleRef=ComM  # /ActiveEcuC/ComM PLAIN_TEXT Post-Initialization of the ComM and its internal state machine
          ComM_PreInit: Header=ComM.h, InitPhase=INIT_ONE, ConfigType=ComM_ConfigType, ConfigPtrName=ComM_Config_Ptr, ConfigPtrClass=COMM_INIT_DATA, ModuleRef=ComM  # /ActiveEcuC/ComM PLAIN_TEXT PreInit function description of ComM in UnfilteredViewInInvariantProject (UnfilteredInvariantProjectModelView) .
          Nm_PreInit: Header=Nm.h, InitPhase=INIT_ONE, ConfigType=Nm_ConfigType, ConfigPtrName=Nm_Config_Ptr, ConfigPtrClass=NM_INIT_DATA, ModuleRef=Nm  # /ActiveEcuC/Nm PLAIN_TEXT PreInit function description of Nm in UnfilteredViewInInvariantProject (UnfilteredInvariantProjectModelView) .
          Nm_PostInit: Header=Nm.h, InitPhase=INIT_THREE, ModuleRef=Nm  # /ActiveEcuC/Nm PLAIN_TEXT Post-Initialization of the Network Management and its internal state machine
          SchM_StartTiming: Header=Rte_Main.h, InitPhase=NO_INIT, ModuleRef=Rte  # /ActiveEcuC/Rte PLAIN_TEXT Automatically generated by EcuCBswInitFctConfigurationService.
          SchM_Start: Header=Rte_Main.h, InitPhase=NO_INIT, ModuleRef=Rte  # /ActiveEcuC/Rte PLAIN_TEXT Automatically generated by EcuCBswInitFctConfigurationService.
      PostbuildLoadable: AlignmentFillPattern=0, PBROMStartAddress=0, PBRAMStartAddress=0, PBROMEndAddress=0, PBRAMEndAddress=0
    EcucHardware
      EcucCoreDefinition: EcucCoreId=0
  module config Det: implementation-config-variant=VARIANT-PRE-COMPILE, module-description=Det_Impl
    DetGeneral:
      DetVersionInfoApi = false
      DetEnableDet = true
      DetExtDebugSupport = true
      DetGlobalFilterSize = 0
      DetBreakFilterSize = 0
      DetLogBufferSize = 0
      DetDltFilterSize = 0
      DetReportErrorRecursionLimit = 0
      DetReportRuntimeErrorRecursionLimit = 0
      DetReportTransientFaultRecursionLimit = 0
  module config CanIf: implementation-config-variant=VARIANT-PRE-COMPILE, module-description=CanIf_Impl
    CanIfPrivateCfg:
      CanIfPrivateSoftwareFilterType = LINEAR
      CanIfPrivateDlcCheck = true
      CanIfSupportTTCAN = false
      CanIfTransceiverMapping = false
      CanIfTransceiverHandling = false
      CanIfSupportExtendedIds = false
      CanIfSupportNmOsek = false
      CanIfTxBufferType = BYTE_QUEUE
      CanIfWakeupSupport = true
      CanIfStaticFdTxBufferSupport = false
      CanIfRxSearchConsiderMsgType = false
      CanIfTxBufferFifoSupport = false
      CanIfSetPduReceptionModeSupport = false
      CanIfCheckWakeupCanRetType = false
      CanIfDataChecksumRxSupport = false
      CanIfDataChecksumTxSupport = false
    CanIfPublicCfg:
      CanIfPublicPnSupport = false
      CanIfPublicCancelTransmitSupport = false
      CanIfPublicDevErrorDetect = true
      CanIfPublicHandleTypeEnum = UINT8
      CanIfPublicMultipleDrvSupport = false
      CanIfPublicNumberOfCanHwUnits = 1
      CanIfPublicReadRxPduDataApi = false
      CanIfPublicReadRxPduNotifyStatusApi = false
      CanIfPublicReadTxPduNotifyStatusApi = false
      CanIfPublicSetDynamicTxIdApi = false
      CanIfPublicTxBuffering = true
      CanIfPublicTxConfirmPollingSupport = false
      CanIfPublicVersionInfoApi = true
      CanIfPublicWakeupCheckValidSupport = true
      CanIfPnWakeupTxPduFilterSupport = false
      CanIfPnTrcvHandlingSupport = false
      CanIfJ1939DynAddrSupport = DISABLED
      CanIfSafeBswChecks = false
      CanIfBusMirroringSupport = false
      CanIfEnableSecurityEventReporting = false
      CanIfSetBaudrateApi = true
      CanIfSupportCanDrvAsr440 = false
      CanIfSupportMultipartition = false
    CanIfInitCfg
      NmBFC_oCAN00_feb4f615_Tx (CanIfTxPduCfg):
        CanIfTxPduCanId = 1026
        CanIfTxPduCanIdType = STANDARD_CAN
        CanIfTxPduDlc = 8
        CanIfTxPduUserTxConfirmationName = CanNm_TxConfirmation
        CanIfTxPduUserTxConfirmationUL = CAN_NM
        CanIfTxPduId = 0
        CanIfTxPduReadNotifyStatus = false
        CanIfTxPduType = STATIC
        CanIfTxPduTruncation = true
        CanIfTxPduBufferRef = CanIfBufferCfg_Tx_Std_0fb271d2
        CanIfTxPduRef = EcucPduCollection/NmBFC_oCAN00_4874935e_Tx
      LightSwitch_oCAN00_042dae16_Rx (CanIfRxPduCfg):
        CanIfRxPduCanId = 528
        CanIfRxPduCanIdType = STANDARD_CAN
        CanIfRxPduDlc = 2
        CanIfRxPduUserRxIndicationName = PduR_CanIfRxIndication
        CanIfRxPduUserRxIndicationUL = PDUR
        CanIfRxPduId = 1
        CanIfRxPduReadData = false
        CanIfRxPduReadNotifyStatus = false
        CanIfRxPduDlcCheck = true
        CanIfRxPduCanHandleTypeLocked = false
        CanIfRxPduHrhIdRef = CanIfInitHohCfg/CN_CAN00_e8c1d35b_Rx_Std
        CanIfRxPduRef = EcucPduCollection/LightSwitch_oCAN00_8d4de26e_Rx
      CanIfBufferCfg_Tx_Std_0fb271d2 (CanIfBufferCfg):
        CanIfBufferSize = 2
        CanIfTxBufferHandlingType = PRIO_BY_CANID
        CanIfTxBufferMappedTxPdus = 2
        CanIfTxBufferMaxPduLength = 8
        CanIfBufferHthRef = CanIfInitHohCfg/CN_CAN00_a2373004_Tx
      LightCtrl_oCAN00_d9f1a7da_Tx (CanIfTxPduCfg):
        CanIfTxPduCanId = 616
        CanIfTxPduCanIdType = STANDARD_CAN
        CanIfTxPduDlc = 8
        CanIfTxPduUserTxConfirmationName = NULL_PTR
        CanIfTxPduUserTxConfirmationUL = NONE
        CanIfTxPduId = 1
        CanIfTxPduReadNotifyStatus = false
        CanIfTxPduType = STATIC
        CanIfTxPduTruncation = true
        CanIfTxPduBufferRef = CanIfBufferCfg_Tx_Std_0fb271d2
        CanIfTxPduRef = EcucPduCollection/LightCtrl_oCAN00_0afee19e_Tx
      CanIfInitHohCfg: CanIfInitRefCfgSet=Can/CanConfigSet
        CN_CAN00_e8c1d35b_Rx_Std (CanIfHrhCfg):
          CanIfHrhSoftwareFilter = true
          CanIfHrhCanCtrlIdRef = CanIfCtrlDrvCfg_7d254554/CT_CAN00_6199f384
          CanIfHrhIdSymRef = CanConfigSet/CN_CAN00_e8c1d35b_Rx_Std
        CN_CAN00_a2373004_Tx (CanIfHthCfg): CanIfHthCanCtrlIdRef=CanIfCtrlDrvCfg_7d254554/CT_CAN00_6199f384, CanIfHthIdSymRef=CanConfigSet/CN_CAN00_a2373004_Tx
      BFC_665f3a14_Rx (CanIfRxPduCfg):
        CanIfRxPduCanIdType = STANDARD_CAN
        CanIfRxPduDlc = 8
        CanIfRxPduUserRxIndicationName = CanNm_RxIndication
        CanIfRxPduUserRxIndicationUL = CAN_NM
        CanIfRxPduId = 0
        CanIfRxPduReadData = false
        CanIfRxPduReadNotifyStatus = false
        CanIfRxPduDlcCheck = true
        CanIfRxPduHrhIdRef = CanIfInitHohCfg/CN_CAN00_e8c1d35b_Rx_Std
        CanIfRxPduRef = BFC_f09b214a_Rx
        CHNL_6a942da5 (CanIfRxPduCanIdRange): CanIfRxPduCanIdRangeLowerCanId=1024, CanIfRxPduCanIdRangeUpperCanId=1087
    CanIfDispatchCfg:
      CanIfDispatchUserCtrlBusOffName = CanSM_ControllerBusOff
      CanIfDispatchUserCtrlBusOffUL = CAN_SM
      CanIfDispatchUserCtrlModeIndicationName = CanSM_ControllerModeIndication
      CanIfDispatchUserCtrlModeIndicationUL = CAN_SM
      CanIfDispatchUserValidateWakeupEventUL = ECUM
      CanIfDispatchUserValidateWakeupEventName = EcuM_ValidateWakeupEvent
    CanIfCtrlDrvCfg_7d254554 (CanIfCtrlDrvCfg): CanIfCtrlDrvTxCancellation=false, CanIfCtrlDrvInitHohConfigRef=CanIfInitHohCfg, CanIfCtrlDrvNameRef=Can/CanGeneral
      CT_CAN00_6199f384 (CanIfCtrlCfg): CanIfCtrlId=0, CanIfCtrlWakeupSupport=true, CanIfCtrlJ1939DynAddrSupport=DISABLED, CanIfCtrlCanCtrlRef=CanConfigSet/CT_CAN00_6199f384
  module config Os: implementation-config-variant=VARIANT-PRE-COMPILE, module-description=Os_Impl
    SystemTimer (OsCounter):
      OsCounterMaxAllowedValue = 2147483647
      OsCounterTicksPerBase = 1
      OsCounterMinCycle = 1
      OsSecondsPerTick = 0.001
      OsCounterType = HARDWARE
      OsCounterAccessingApplication = Os/SystemApplication_OsCore
      OsDriver: OsDriverHighResolution=false, OsDriverHardwareTimerChannelRef=OsHardwareTimer/Stm0_Channel0, OsDriverIsrRef=Os/CounterIsr_SystemTimer
    OsOS:
      OsStackMonitoring = true
      OsStatus = EXTENDED
      OsUseGetServiceId = false
      OsUseParameterAccess = false
      OsUseResScheduler = true
      OsScalabilityClass = SC1
      OsGenerateMemMap = EMPTY
      OsGenerateMemMapForThreads = false
      OsForcibleTermination = false
      OsGenerateCalloutStubs = true
      OsGenerateMemMapForNearAddressing = true
      OsServiceProtection = false
      OsStackUsageMeasurement = false
      OsUseXSignalAsyncApiCalls = false
      OsNumberOfCores = 1
      OsFpuUsage = NONE
      OsUseCase = STANDARD
      OsUseArti = false
      OsMasterCore = Os/OsCore
      OsHooks: OsErrorHook=false, OsPostTaskHook=false, OsPreTaskHook=false, OsShutdownHook=false, OsStartupHook=false, OsProtectionHook=false
      OsStackSummary
        8 x OsStack, all with OsStackCore=Os/OsCore:
          OsCore_Init: OsStackSize=1024, OsStackType=CORE_INIT_STACK, OsStackUser=Os/OsCore
          OsCore_Kernel: OsStackSize=1024, OsStackType=CORE_KERNEL_STACK, OsStackUser=Os/OsCore
          OsCore_Isr_Core: OsStackSize=1024, OsStackType=ISR_SHARED_CORE_STACK, OsStackUser=Os/CounterIsr_SystemTimer
          BswTask: OsStackSize=320, OsStackType=TASK_EXTENDED_STACK, OsStackUser=Os/BswTask
          IoTask: OsStackSize=320, OsStackType=TASK_EXTENDED_STACK, OsStackUser=Os/IoTask
          OsCore_Task_Prio100: OsStackSize=320, OsStackType=TASK_SHARED_PRIORITY_STACK, OsStackUser=Os/InitTask
          OsCore_Task_Prio4294967295: OsStackSize=1024, OsStackType=TASK_SHARED_PRIORITY_STACK, OsStackUser=Os/IdleTask_OsCore
          SwcTask: OsStackSize=320, OsStackType=TASK_EXTENDED_STACK, OsStackUser=Os/SwcTask
    OSDEFAULTAPPMODE (OsAppMode)
    3 x OsTask, all with OsTaskActivation=1, OsTaskSchedule=NON, OsTaskStackSize=320, OsTaskStackSharing=false, OsTaskType=AUTO, OsTaskUsesFpu=false, OsTaskResourceRef=Os/RES_SCHEDULER_OsCore, OsTaskAccessingApplication=Os/SystemApplication_OsCore:
      BswTask: OsTaskPriority=2, OsTaskEventRef=Os/Rte_Ev_Cyclic2_BswTask_0_10ms, OsTaskEventRef=Os/Rte_Ev_Cyclic2_BswTask_0_20ms, OsTaskEventRef=Os/Rte_Ev_Run_Fee_Fee_MainFunction
      InitTask: OsTaskPriority=100
        OsTaskAutostart: OsTaskAppModeRef=Os/OSDEFAULTAPPMODE
      IoTask: OsTaskPriority=3, OsTaskEventRef=Os/Rte_Ev_Run_IoHwAb_IoHwAb_IoHwAb_IoHwAbHandler
    RES_SCHEDULER_OsCore (OsResource): OsResourceProperty=STANDARD, OsResourceAccessingApplication=Os/SystemApplication_OsCore
    3 x OsAlarm, all with OsAlarmCounterRef=Os/SystemTimer, OsAlarmAccessingApplication=Os/SystemApplication_OsCore:
      Rte_Al_TE2_BswTask_0_10ms
        OsAlarmAction
          OsAlarmSetEvent: OsAlarmSetEventRef=Os/Rte_Ev_Cyclic2_BswTask_0_10ms, OsAlarmSetEventTaskRef=Os/BswTask
      Rte_Al_TE2_BswTask_0_20ms
        OsAlarmAction
          OsAlarmSetEvent: OsAlarmSetEventRef=Os/Rte_Ev_Cyclic2_BswTask_0_20ms, OsAlarmSetEventTaskRef=Os/BswTask
      Rte_Al_TE_Fee_Fee_MainFunction
        OsAlarmAction
          OsAlarmSetEvent: OsAlarmSetEventRef=Os/Rte_Ev_Run_Fee_Fee_MainFunction, OsAlarmSetEventTaskRef=Os/BswTask
    3 x OsEvent:
      Rte_Ev_Cyclic2_BswTask_0_10ms
      Rte_Ev_Cyclic2_BswTask_0_20ms
      Rte_Ev_Run_Fee_Fee_MainFunction
    SwcTask (OsTask):
      OsTaskActivation = 1
      OsTaskPriority = 1
      OsTaskSchedule = NON
      OsTaskStackSize = 320
      OsTaskStackSharing = false
      OsTaskType = AUTO
      OsTaskUsesFpu = false
      OsTaskEventRef = Os/Rte_Ev_Cyclic_SwcTask_0_10ms
      OsTaskAccessingApplication = Os/SystemApplication_OsCore
      OsTaskResourceRef = Os/RES_SCHEDULER_OsCore
    Rte_Al_TE_IoHwAb_IoHwAb_IoHwAb_IoHwAbHandler (OsAlarm): OsAlarmCounterRef=Os/SystemTimer, OsAlarmAccessingApplication=Os/SystemApplication_OsCore
      OsAlarmAction
        OsAlarmSetEvent: OsAlarmSetEventRef=Os/Rte_Ev_Run_IoHwAb_IoHwAb_IoHwAb_IoHwAbHandler, OsAlarmSetEventTaskRef=Os/IoTask
    Rte_Ev_Run_IoHwAb_IoHwAb_IoHwAb_IoHwAbHandler (OsEvent)
    Rte_Al_TE_SwcTask_0_10ms (OsAlarm): OsAlarmCounterRef=Os/SystemTimer, OsAlarmAccessingApplication=Os/SystemApplication_OsCore
      OsAlarmAction
        OsAlarmSetEvent: OsAlarmSetEventRef=Os/Rte_Ev_Cyclic_SwcTask_0_10ms, OsAlarmSetEventTaskRef=Os/SwcTask
    Rte_Ev_Cyclic_SwcTask_0_10ms (OsEvent)
    OS_APPMODE_ANY (OsAppMode)
    OsPublishedInformation: OsKernelVersion=7, OsPlatformName=VTT
      VTT (OsDerivativeInformation):
        OsExceptionVectorTableAlignment = 0
        OsInterruptVectorTableAlignment = 0
        OsHardwareManuals = N/A
        OsMpuAlignment = 0
        OsStackAlignment = 0
        OsMpuEndAddressAccessible = true
        OsMpuPrivilegedRegionsConfigurable = false
        OsSystemIntCtrl: OsSystemIntCtrlPrioOrder=ASC, OsSystemIntCtrlMaxPrios=200, OsSystemIntCtrlBaseAddress=0, OsSystemIntCtrlMaxSources=10000
          ExternalIRQ (OsSystemIntCtrlSlaveConfig): OsSystemIntCtrlMasterSource=0
        OsPhysicalCore:
          OsPhysicalCoreId = 0
          OsPhysicalCoreExceptionSources = 0
          OsPhysicalCoreIsAutostart = true
          OsPhysicalCoreMasterStartAllowed = true
          OsPhysicalCorePrivelegedHwAccess = true
        OsHardwareTimer: OsHardwareTimerId=0, OsHardwareTimerUnit=FRT, OsHardwareTimerSize=32, OsHardwareTimerBaseAddress=0, OsHardwareTimerType=HardwareTimer
          Stm0_Channel0 (OsHardwareTimerChannel): OsHardwareTimerChannelId=0, OsHardwareTimerChannelIntSource=0, OsHardwareTimerChannelOffset=0
        DEFAULT (OsInterruptSupportedType):
          OsInterruptSupportedTypeSeparateSources = false
          OsInterruptSupportedTypeSeparatePriority = false
          OsInterruptSupportedTypeIsMapped = false
          OsInterruptSupportedTypePostActionRequired = false
    OsCore:
      OsCoreIsAutostart = true
      OsCoreIsAutosar = true
      OsCorePhysicalCoreRef = VTT/OsPhysicalCore
      OsCoreEcucCoreRef = EcucHardware/EcucCoreDefinition
      OsCoreIdleTask = Os/IdleTask_OsCore
      OsCoreSystemApplication = Os/SystemApplication_OsCore
      OsCoreResScheduler = Os/RES_SCHEDULER_OsCore
      OsCoreStacks:
        OsCoreKernelStackSize = 1024
        OsCoreStartupStackSize = 1024
        OsCoreShutdownStackSize = 1024
        OsCoreErrorStackSize = 1024
        OsCoreProtectionStackSize = 1024
        OsCoreInitStackSize = 1024
    IdleTask_OsCore (OsTask):
      OsTaskActivation = 1
      OsTaskPriority = 4294967295
      OsTaskSchedule = FULL
      OsTaskStackSharing = false
      OsTaskStackSize = 1024
      OsTaskType = AUTO
      OsTaskUsesFpu = false
      OsTaskAccessingApplication = Os/SystemApplication_OsCore
      OsTaskResourceRef = Os/RES_SCHEDULER_OsCore
      OsTaskAutostart: OsTaskAppModeRef=Os/OS_APPMODE_ANY
    SystemApplication_OsCore (OsApplication):
      OsTrusted = true
      OsTrustedApplicationDelayTimingViolationCall = false
      OsTrustedApplicationWithProtection = false
      OsApplicationIsPrivileged = true
      OsAppUseTrustedFunctionStubs = false
      OsApplicationCoreRef = EcucHardware/EcucCoreDefinition
      OsAppAlarmRef = Os/Rte_Al_TE2_BswTask_0_10ms
      OsAppAlarmRef = Os/Rte_Al_TE2_BswTask_0_20ms
      OsAppAlarmRef = Os/Rte_Al_TE_Fee_Fee_MainFunction
      OsAppAlarmRef = Os/Rte_Al_TE_IoHwAb_IoHwAb_IoHwAb_IoHwAbHandler
      OsAppAlarmRef = Os/Rte_Al_TE_SwcTask_0_10ms
      OsAppCounterRef = Os/SystemTimer
      OsAppTaskRef = Os/IdleTask_OsCore
      OsAppTaskRef = Os/BswTask
      OsAppTaskRef = Os/InitTask
      OsAppTaskRef = Os/IoTask
      OsAppTaskRef = Os/SwcTask
      OsAppIsrRef = Os/CounterIsr_SystemTimer
      OsApplicationHooks: OsAppErrorHook=false, OsAppShutdownHook=false, OsAppStartupHook=false
    CounterIsr_SystemTimer (OsIsr):
      OsIsrCategory = CATEGORY_2
      OsIsrInterruptType = EXTERNAL
      OsIsrInterruptSource = 1
      OsIsrInterruptPriority = 0
      OsIsrStackSize = 1024
      OsIsrEnableNesting = false
      OsIsrSpecialFunctionName = Os_TimerPfrtIsr
      OsIsrUsesFpu = false
      OsIsrInitialEnableInterruptSource = false
      OsIsrInterruptMapping = VTT/DEFAULT
  module config Nm: implementation-config-variant=VARIANT-PRE-COMPILE, module-description=Nm_Impl
    NmGlobalConfig
      NmGlobalFeatures:
        NmNodeIdEnabled = true
        NmUserDataEnabled = true
        NmBusSynchronizationEnabled = false
        NmCarWakeUpRxEnabled = false
        NmComControlEnabled = false
        NmComUserDataSupport = false
        NmCoordinatorSupportEnabled = false
        NmNodeDetectionEnabled = false
        NmPduRxIndicationEnabled = false
        NmRemoteSleepIndEnabled = false
        NmRepeatMsgIndEnabled = false
        NmStateChangeIndEnabled = true
        NmMacroLayerEnabled = false
        NmCoordinatorSyncSupport = false
        NmRuntimeMeasurementSupport = false
        NmCoordinatorRequestChannelsInBusSleep = false
        NmCoordinatorPassiveStartUpForwarding = false
        NmStateChangeIndCallback = BswM_Nm_StateChangeNotification
        NmCallbacksPrototypeHeader = BswM_Nm.h
      NmGlobalConstants: NmNumberOfChannels=1
      NmGlobalProperties: NmDevErrorDetect=true, NmVersionInfoApi=false, NmSafeBswChecks=false, NmCycletimeMainFunction=0.01
      NmGeneration:
        NmOutOfBoundsWriteSanitizer = false
        NmOutOfBoundsReadSanitizer = false
        NmShortSymbols = false
        NmInterfacesForDeactivatedData = false
        NmReferringKeysInComments = false
    CN_CAN00_a2373004 (NmChannelConfig):
      NmChannelId = 0
      NmChannelSleepMaster = false
      NmStateReportEnabled = false
      NmSynchronizingNetwork = false
      NmPassiveModeEnabled = false
      NmComMChannelRef = ComMConfigSet/CN_CAN00_a2373004
      CAN00_CAN_5faa4e95 (NmBusType)
        NmStandardBusNmConfig: NmStandardBusType=NM_BUSNM_CANNM  # CAN00_CAN
  module config PduR: implementation-config-variant=VARIANT-PRE-COMPILE, module-description=PduR_Impl
    PduRRoutingTables: PduRConfigurationId=0
      PduRRoutingTable
        LightCtrl_oCAN00_2e88b3f5_Tx (PduRRoutingPath): PduRRoutingPathCommunicationType=COMMUNICATION_INTERFACE, PduRMulticoreRoutingPath=false, PduRLockRef=PduRLock_PduRExclusiveArea
          PduRSrcPdu_30bff602 (PduRSrcPdu):
            PduRSourcePduHandleId = 0
            PduRSrcPduDirection = TRANSMIT
            PduRSrcPduRef = EcucPduCollection/LightCtrl_oCAN00_2e88b3f5_Tx
            PduRSrcPduPduRBswModulesRef = PduR/Com
          LightCtrl_oCAN00_0afee19e_Tx (PduRDestPdu):
            PduRDestPduHandleId = 0
            PduRDestPduDirection = TRANSMIT
            PduRDestPduRoutingType = API_FORWARDING
            PduRDestPduDataProcessing = IMMEDIATE
            PduRPduLengthHandlingStrategy = IGNORE
            PduRDestPduDataProvision = PDUR_DIRECT
            PduRTransmissionConfirmation = false
            PduRDestPduCrossPartitionDestination = false
            PduRDestPduRef = EcucPduCollection/LightCtrl_oCAN00_0afee19e_Tx
            PduRDestPduPduRBswModulesRef = PduR/CanIf
        LightSwitch_oCAN00_8d4de26e_Rx (PduRRoutingPath): PduRRoutingPathCommunicationType=COMMUNICATION_INTERFACE, PduRMulticoreRoutingPath=false, PduRLockRef=PduRLock_PduRExclusiveArea
          LightSwitch_oCAN00_8d4de26e_Rx_d73f9532_Rx (PduRDestPdu):
            PduRDestPduHandleId = 0
            PduRDestPduDirection = RECEIVE
            PduRDestPduRoutingType = API_FORWARDING
            PduRDestPduDataProcessing = IMMEDIATE
            PduRPduLengthHandlingStrategy = IGNORE
            PduRTransmissionConfirmation = false
            PduRDestPduCrossPartitionDestination = false
            PduRDestPduRef = EcucPduCollection/LightSwitch_oCAN00_d3b6d56e_Rx
            PduRDestPduPduRBswModulesRef = PduR/Com
          PduRSrcPdu_d73f9532 (PduRSrcPdu):
            PduRSourcePduHandleId = 0
            PduRSrcPduDirection = RECEIVE
            PduRSrcPduRef = EcucPduCollection/LightSwitch_oCAN00_8d4de26e_Rx
            PduRSrcPduPduRBswModulesRef = PduR/CanIf
      PduRLock_PduRExclusiveArea (PduRLock)
        PduRExclusiveArea: PduRExclusiveAreaId=0
    PduRGeneral:
      PduRDevErrorDetect = true
      PduRVersionInfoApi = false
      PduRMetaDataSupport = false
      PduRPduCallback = false
      PduRSwitching = false
      PduRSafeBswChecks = false
      PduREnableDeferredTransmission = false
      PduREnableDeferredReception = false
      PduRSupportMulticore = false
      PduRRoutingTypeGateway = false
      PduRSpinlockRetryCounter = 4294967295
      PduRExtendedErrorChecks = false
      PduRGeneration:
        PduROutOfBoundsWriteProtectionStrategy = NONE
        PduROutOfBoundsWriteSanitizer = false
        PduROutOfBoundsReadSanitizer = false
        PduRNumericalDataTypeMinimizationStrategy = WITH_CAST
        PduRReduceConstantData2Define = false
        PduRBoolDataInArrayOfStructStrategy = BITMASKING
        PduRDeduplicateIndirectedData = true
        PduRDataDeduplicationStrategy = WITH_CAST
        PduRReduceBoolDataByNegationThreshold = 2
        PduRReduceBoolDataByNumericalComparisonThreshold = 2
        PduRReduceBoolDataByNumericalRelationThreshold = 2
        PduRReduceBoolDataByNumericalOperandStrategy = WITH_ANY_VALUE
        PduRReduceNumericalDataByOffsetThreshold = 2
        PduRReduceNumericalDataByArraySubtractionThreshold = 2
        PduRReduceDataByStreaming = false
        PduRShortSymbols = false
        PduRInterfacesForDeactivatedData = false
        PduRReferringKeysInComments = false
    CanIf (PduRBswModules):
      PduRCancelReceive = false
      PduRCancelTransmit = false
      PduRChangeParameterRequestApi = false
      PduRCommunicationInterface = true
      PduRLowerModule = true
      PduRTransportProtocol = false
      PduRTriggertransmit = false
      PduRTxConfirmation = false
      PduRUpperModule = false
      PduRUseTag = false
      PduRBswModuleRef = CanIf
    Com (PduRBswModules):
      PduRCancelReceive = false
      PduRCancelTransmit = false
      PduRChangeParameterRequestApi = false
      PduRCommunicationInterface = true
      PduRLowerModule = false
      PduRTransportProtocol = false
      PduRTriggertransmit = false
      PduRTxConfirmation = false
      PduRUpperModule = true
      PduRUseTag = false
      PduRBswModuleRef = Com
  module config BswM: implementation-config-variant=VARIANT-PRE-COMPILE, module-description=BswM_Impl
    BswMConfig
      BswMArbitration
        ESH_PrepToWait (BswMRule):
          BswMNestedExecutionOnly = false
          BswMRuleId = 6
          BswMRuleInitState = BSWM_FALSE
          BswMRuleExpressionRef = ESH_LE_PrepShutdownToWaitForNvM
          BswMRuleTrueActionList = ESH_AL_PrepShutdownToWaitForNvM
        ESH_LE_PrepShutdownToWaitForNvM (BswMLogicalExpression): BswMLogicalOperator=BSWM_AND, BswMArgumentRef=ESH_Cond_StateIsPrepShutdown
        ESH_Cond_StateIsPrepShutdown (BswMModeCondition): BswMConditionType=BSWM_EQUALS, BswMConditionMode=ESH_State
          BswMConditionValue
            BswMBswMode: BswMBswRequestedMode=ESH_PREP_SHUTDOWN
        ESH_State (BswMModeRequestPort): BswMArbitrateOnInit=true, BswMRequestProcessing=BSWM_IMMEDIATE
          BswMModeRequestSource
            BswMGenericRequest: BswMModeRequesterId=230, BswMRequestedModeMax=7
              7 x BswMGenericRequestMode:
                ESH_INIT: BswMGenericRequestModeValue=0
                ESH_RUN: BswMGenericRequestModeValue=1
                ESH_POST_RUN: BswMGenericRequestModeValue=2
                ESH_PREP_SHUTDOWN: BswMGenericRequestModeValue=3
                ESH_WAIT_FOR_NVM: BswMGenericRequestModeValue=4
                ESH_SHUTDOWN: BswMGenericRequestModeValue=5
                ESH_WAKEUP: BswMGenericRequestModeValue=6
          BswMModeInitValue
            BswMBswModeInitValue: BswMBswModeInitValueMode=ESH_INIT
        ESH_NvM_WriteAllTimer (BswMModeRequestPort): BswMArbitrateOnInit=false, BswMRequestProcessing=BSWM_DEFERRED
          BswMModeRequestSource
            BswMTimer
          BswMModeInitValue
            BswMBswModeInitValue: BswMBswModeInitValueMode=BSWM_TIMER_STOPPED
        ESH_WaitToShutdown (BswMRule):
          BswMNestedExecutionOnly = false
          BswMRuleId = 9
          BswMRuleInitState = BSWM_FALSE
          BswMRuleExpressionRef = ESH_LE_WaitForNvMToShutdown
          BswMRuleTrueActionList = ESH_AL_WaitForNvMToShutdown
        ESH_LE_WaitForNvMToShutdown (BswMLogicalExpression):
          BswMLogicalOperator = BSWM_AND
          BswMArgumentRef = ESH_Cond_StateIsWaitForNvm
          BswMArgumentRef = ESH_LE_WriteNotPending
          BswMArgumentRef = ESH_LE_NoWakeupOrKillAll
        ESH_Cond_StateIsWaitForNvm (BswMModeCondition): BswMConditionType=BSWM_EQUALS, BswMConditionMode=ESH_State
          BswMConditionValue
            BswMBswMode: BswMBswRequestedMode=ESH_WAIT_FOR_NVM
        ESH_LE_WriteNotPending (BswMLogicalExpression): BswMLogicalOperator=BSWM_OR, BswMArgumentRef=ESH_Cond_NvMWAIsNotPending, BswMArgumentRef=ESH_Cond_NvWWriteAllTimerNotRunning
        ESH_Cond_NvMWAIsNotPending (BswMModeCondition): BswMConditionType=BSWM_EQUALS_NOT, BswMConditionMode=ESH_NvMIndication
          BswMConditionValue
            BswMBswMode: BswMBswRequestedMode=NVM_REQ_PENDING
        ESH_NvMIndication (BswMModeRequestPort): BswMArbitrateOnInit=false, BswMRequestProcessing=BSWM_DEFERRED
          BswMModeRequestSource
            BswMNvMJobModeIndication: BswMNvmService=NvmWriteAll
          BswMModeInitValue
            BswMBswModeInitValue: BswMBswModeInitValueMode=NVM_REQ_OK
        ESH_Cond_NvWWriteAllTimerNotRunning (BswMModeCondition): BswMConditionType=BSWM_EQUALS_NOT, BswMConditionMode=ESH_NvM_WriteAllTimer
          BswMConditionValue
            BswMBswMode: BswMBswRequestedMode=BSWM_TIMER_STARTED
        ESH_Cond_NoValidatedWakeups (BswMModeCondition): BswMConditionType=BSWM_EQUALS, BswMConditionMode=ESH_EcuM_GetValidatedWakeupEvents
          BswMConditionValue
            BswMBswMode: BswMBswRequestedMode=0
        ESH_EcuM_GetValidatedWakeupEvents (BswMModeRequestPort): BswMArbitrateOnInit=false, BswMRequestProcessing=BSWM_DEFERRED
          BswMModeRequestSource
            BswMUserConditionRequest: BswMUserCondition=EcuM_GetValidatedWakeupEvents()
        ESH_WaitToWakeup (BswMRule):
          BswMNestedExecutionOnly = false
          BswMRuleId = 10
          BswMRuleInitState = BSWM_FALSE
          BswMRuleExpressionRef = ESH_LE_WaitForNvMToWakeup
          BswMRuleTrueActionList = ESH_AL_WaitForNvMWakeup
        ESH_LE_WaitForNvMToWakeup (BswMLogicalExpression): BswMLogicalOperator=BSWM_AND, BswMArgumentRef=ESH_Cond_StateIsWaitForNvm, BswMArgumentRef=ESH_LE_ValidWakeup
        ESH_LE_ValidWakeup (BswMLogicalExpression): BswMLogicalOperator=BSWM_OR, BswMArgumentRef=ESH_Cond_ValidatedWakeups, BswMArgumentRef=ESH_Cond_ComMPendingRequests
        ESH_Cond_ValidatedWakeups (BswMModeCondition): BswMConditionType=BSWM_EQUALS_NOT, BswMConditionMode=ESH_EcuM_GetValidatedWakeupEvents
          BswMConditionValue
            BswMBswMode: BswMBswRequestedMode=0
        ESH_NvM_CancelWriteAllTimer (BswMModeRequestPort): BswMArbitrateOnInit=false, BswMRequestProcessing=BSWM_DEFERRED
          BswMModeRequestSource
            BswMTimer
          BswMModeInitValue
            BswMBswModeInitValue: BswMBswModeInitValueMode=BSWM_TIMER_STOPPED
        ESH_RunToPostRun (BswMRule):
          BswMNestedExecutionOnly = false
          BswMRuleId = 7
          BswMRuleInitState = BSWM_FALSE
          BswMRuleExpressionRef = ESH_LE_RunToPostRunTransition
          BswMRuleTrueActionList = ESH_AL_ExitRun
        ESH_Cond_StateIsRun (BswMModeCondition): BswMConditionType=BSWM_EQUALS, BswMConditionMode=ESH_State
          BswMConditionValue
            BswMBswMode: BswMBswRequestedMode=ESH_RUN
        ESH_LE_AllChannelsNoCom (BswMLogicalExpression): BswMLogicalOperator=BSWM_AND, BswMArgumentRef=ESH_Cond_NoComOn_CN_CAN00_a2373004
        ESH_Cond_SelfRunReqTimerExpired (BswMModeCondition): BswMConditionType=BSWM_EQUALS, BswMConditionMode=ESH_SelfRunRequestTimer
          BswMConditionValue
            BswMBswMode: BswMBswRequestedMode=BSWM_TIMER_EXPIRED
        ESH_SelfRunRequestTimer (BswMModeRequestPort): BswMArbitrateOnInit=false, BswMRequestProcessing=BSWM_DEFERRED
          BswMModeRequestSource
            BswMTimer
          BswMModeInitValue
            BswMBswModeInitValue: BswMBswModeInitValueMode=BSWM_TIMER_STOPPED
        ESH_Cond_StateIsPostRun (BswMModeCondition): BswMConditionType=BSWM_EQUALS, BswMConditionMode=ESH_State
          BswMConditionValue
            BswMBswMode: BswMBswRequestedMode=ESH_POST_RUN
        ESH_LE_RunRequestsOrWakeup (BswMLogicalExpression): BswMLogicalOperator=BSWM_OR, BswMArgumentRef=ESH_LE_ValidWakeup
        ESH_WakeupToRun (BswMRule):
          BswMNestedExecutionOnly = false
          BswMRuleId = 12
          BswMRuleInitState = BSWM_FALSE
          BswMRuleExpressionRef = ESH_LE_WakeupToRun
          BswMRuleTrueActionList = ESH_AL_WakeupToRun
        ESH_LE_WakeupToRun (BswMLogicalExpression): BswMLogicalOperator=BSWM_AND, BswMArgumentRef=ESH_Cond_StateIsWakeup, BswMArgumentRef=ESH_LE_ValidWakeup, BswMArgumentRef=ESH_LE_CancelNotPending
        ESH_Cond_StateIsWakeup (BswMModeCondition): BswMConditionType=BSWM_EQUALS, BswMConditionMode=ESH_State
          BswMConditionValue
            BswMBswMode: BswMBswRequestedMode=ESH_WAKEUP
        ESH_LE_CancelNotPending (BswMLogicalExpression): BswMLogicalOperator=BSWM_OR, BswMArgumentRef=ESH_Cond_NvMWAIsNotPending, BswMArgumentRef=ESH_Cond_NvWCancelTimerNotRunning
        ESH_Cond_NvWCancelTimerNotRunning (BswMModeCondition): BswMConditionType=BSWM_EQUALS_NOT, BswMConditionMode=ESH_NvM_CancelWriteAllTimer
          BswMConditionValue
            BswMBswMode: BswMBswRequestedMode=BSWM_TIMER_STARTED
        ESH_WakeupToPrep (BswMRule):
          BswMNestedExecutionOnly = false
          BswMRuleId = 11
          BswMRuleInitState = BSWM_FALSE
          BswMRuleExpressionRef = ESH_LE_WakeupToPrepShutdown
          BswMRuleTrueActionList = ESH_AL_WakeupToPrep
        ESH_LE_WakeupToPrepShutdown (BswMLogicalExpression):
          BswMLogicalOperator = BSWM_AND
          BswMArgumentRef = ESH_Cond_StateIsWakeup
          BswMArgumentRef = ESH_LE_CancelNotPending
          BswMArgumentRef = ESH_Cond_NoPendingWakeups
          BswMArgumentRef = ESH_LE_NoWakeup
        ESH_Cond_NoPendingWakeups (BswMModeCondition): BswMConditionType=BSWM_EQUALS, BswMConditionMode=ESH_EcuM_GetPendingWakeupEvents
          BswMConditionValue
            BswMBswMode: BswMBswRequestedMode=0
        ESH_EcuM_GetPendingWakeupEvents (BswMModeRequestPort): BswMArbitrateOnInit=false, BswMRequestProcessing=BSWM_DEFERRED
          BswMModeRequestSource
            BswMUserConditionRequest: BswMUserCondition=EcuM_GetPendingWakeupEvents()
        ESH_InitToWakeup (BswMRule):
          BswMNestedExecutionOnly = false
          BswMRuleId = 3
          BswMRuleInitState = BSWM_FALSE
          BswMRuleExpressionRef = ESH_LE_InitToWakeup
          BswMRuleTrueActionList = ESH_AL_InitToWakeup
        ESH_LE_InitToWakeup (BswMLogicalExpression): BswMLogicalOperator=BSWM_AND, BswMArgumentRef=ESH_Cond_StateIsInit
        ESH_Cond_StateIsInit (BswMModeCondition): BswMConditionType=BSWM_EQUALS, BswMConditionMode=ESH_State
          BswMConditionValue
            BswMBswMode: BswMBswRequestedMode=ESH_INIT
        ESH_RunToPostRunNested (BswMRule):
          BswMNestedExecutionOnly = true
          BswMRuleId = 8
          BswMRuleInitState = BSWM_FALSE
          BswMRuleExpressionRef = ESH_LE_ComMNoPendingRequests
          BswMRuleTrueActionList = ESH_AL_RunToPostRun
        ESH_LE_ComMNoPendingRequests (BswMLogicalExpression): BswMLogicalOperator=BSWM_OR, BswMArgumentRef=ESH_Cond_ComMNoPendingRequests
        ESH_Cond_ComMNoPendingRequests (BswMModeCondition): BswMConditionType=BSWM_EQUALS, BswMConditionMode=ESH_ComMPendingRequests
          BswMConditionValue
            BswMBswMode: BswMBswRequestedMode=ESH_COMM_NO_REQUEST
        ESH_ComMPendingRequests (BswMModeRequestPort): BswMArbitrateOnInit=false, BswMRequestProcessing=BSWM_DEFERRED
          BswMModeRequestSource
            BswMGenericRequest: BswMModeRequesterId=232, BswMRequestedModeMax=2
              ESH_COMM_NO_REQUEST (BswMGenericRequestMode): BswMGenericRequestModeValue=0
              ESH_COMM_PENDING_REQUEST (BswMGenericRequestMode): BswMGenericRequestModeValue=1
          BswMModeInitValue
            BswMBswModeInitValue: BswMBswModeInitValueMode=ESH_COMM_NO_REQUEST
        ESH_LE_NoWakeup (BswMLogicalExpression): BswMLogicalOperator=BSWM_AND, BswMArgumentRef=ESH_Cond_NoValidatedWakeups, BswMArgumentRef=ESH_Cond_ComMNoPendingRequests
        ESH_Cond_ComMPendingRequests (BswMModeCondition): BswMConditionType=BSWM_EQUALS, BswMConditionMode=ESH_ComMPendingRequests
          BswMConditionValue
            BswMBswMode: BswMBswRequestedMode=ESH_COMM_PENDING_REQUEST
        ESH_PostRunNested (BswMRule):
          BswMNestedExecutionOnly = true
          BswMRuleId = 5
          BswMRuleInitState = BSWM_FALSE
          BswMRuleExpressionRef = ESH_LE_PostRunToRun
          BswMRuleFalseActionList = ESH_AL_PostRunToPrepShutdown
          BswMRuleTrueActionList = ESH_AL_PostRunToRun
        ESH_PostRun (BswMRule):
          BswMNestedExecutionOnly = false
          BswMRuleId = 4
          BswMRuleInitState = BSWM_FALSE
          BswMRuleExpressionRef = ESH_LE_PostRun
          BswMRuleTrueActionList = ESH_AL_ExitPostRun
        7 x BswMLogicalExpression:
          ESH_LE_PostRun: BswMLogicalOperator=BSWM_AND, BswMArgumentRef=ESH_Cond_StateIsPostRun, BswMArgumentRef=ESH_Cond_SelfRunReqTimerExpired
          ESH_LE_RunToPostRunTransition: BswMLogicalOperator=BSWM_AND, BswMArgumentRef=ESH_LE_RunReached, BswMArgumentRef=ESH_LE_NoRunAndNoKillAllRequest
          ESH_LE_RunReached: BswMLogicalOperator=BSWM_AND, BswMArgumentRef=ESH_Cond_StateIsRun
          ESH_LE_NoRunAndNoKillAllRequest: BswMLogicalOperator=BSWM_OR, BswMArgumentRef=ESH_LE_NoRunReasons
          ESH_LE_NoRunReasons: BswMLogicalOperator=BSWM_AND, BswMArgumentRef=ESH_LE_AllChannelsNoCom, BswMArgumentRef=ESH_Cond_SelfRunReqTimerExpired
          ESH_LE_NoWakeupOrKillAll: BswMLogicalOperator=BSWM_OR, BswMArgumentRef=ESH_LE_NoWakeup
          ESH_LE_PostRunToRun: BswMLogicalOperator=BSWM_AND, BswMArgumentRef=ESH_LE_RunRequestsOrWakeup
        CC_CN_CAN00_a2373004_RX (BswMRule):
          BswMNestedExecutionOnly = false
          BswMRuleId = 0
          BswMRuleInitState = BSWM_FALSE
          BswMRuleExpressionRef = CC_LE_CN_CAN00_a2373004_RX
          BswMRuleFalseActionList = CC_AL_CN_CAN00_a2373004_RX_Disable
          BswMRuleTrueActionList = CC_AL_CN_CAN00_a2373004_RX_EnableNoinit
        CC_LE_CN_CAN00_a2373004_RX (BswMLogicalExpression): BswMLogicalOperator=BSWM_AND, BswMArgumentRef=CC_Cond_CanSMIndication_CN_CAN00_a2373004_NEQ_CANSM_BSWM_NO_COMMUNICATION
        CC_Cond_CanSMIndication_CN_CAN00_a2373004_NEQ_CANSM_BSWM_NO_COMMUNICATION (BswMModeCondition): BswMConditionType=BSWM_EQUALS_NOT, BswMConditionMode=CC_CanSMIndication_CN_CAN00_a2373004
          BswMConditionValue
            BswMBswMode: BswMBswRequestedMode=CANSM_BSWM_NO_COMMUNICATION
        CC_CanSMIndication_CN_CAN00_a2373004 (BswMModeRequestPort): BswMArbitrateOnInit=false, BswMRequestProcessing=BSWM_IMMEDIATE
          BswMModeRequestSource
            BswMCanSMIndication: BswMCanSMChannelRef=ComMConfigSet/CN_CAN00_a2373004
          BswMModeInitValue
            BswMBswModeInitValue: BswMBswModeInitValueMode=CANSM_BSWM_NO_COMMUNICATION
        CC_CN_CAN00_a2373004_RX_DM (BswMRule):
          BswMNestedExecutionOnly = false
          BswMRuleId = 1
          BswMRuleInitState = BSWM_FALSE
          BswMRuleExpressionRef = CC_LE_CN_CAN00_a2373004_RX_DM
          BswMRuleFalseActionList = CC_AL_CN_CAN00_a2373004_Disable_DM
          BswMRuleTrueActionList = CC_AL_CN_CAN00_a2373004_Enable_DM
        CC_LE_CN_CAN00_a2373004_RX_DM (BswMLogicalExpression): BswMLogicalOperator=BSWM_AND, BswMArgumentRef=CC_Cond_CanSMIndication_CN_CAN00_a2373004_EQ_CANSM_BSWM_FULL_COMMUNICATION
        CC_Cond_CanSMIndication_CN_CAN00_a2373004_EQ_CANSM_BSWM_FULL_COMMUNICATION (BswMModeCondition): BswMConditionType=BSWM_EQUALS, BswMConditionMode=CC_CanSMIndication_CN_CAN00_a2373004
          BswMConditionValue
            BswMBswMode: BswMBswRequestedMode=CANSM_BSWM_FULL_COMMUNICATION
        CC_CN_CAN00_a2373004_TX (BswMRule):
          BswMNestedExecutionOnly = false
          BswMRuleId = 2
          BswMRuleInitState = BSWM_FALSE
          BswMRuleExpressionRef = CC_LE_CN_CAN00_a2373004_TX
          BswMRuleFalseActionList = CC_AL_CN_CAN00_a2373004_TX_Disable
          BswMRuleTrueActionList = CC_AL_CN_CAN00_a2373004_TX_EnableNoinit
        CC_LE_CN_CAN00_a2373004_TX (BswMLogicalExpression): BswMLogicalOperator=BSWM_AND, BswMArgumentRef=CC_Cond_CanSMIndication_CN_CAN00_a2373004_EQ_CANSM_BSWM_FULL_COMMUNICATION
        ESH_Cond_NoComOn_CN_CAN00_a2373004 (BswMModeCondition): BswMConditionType=BSWM_EQUALS, BswMConditionMode=ESH_ComMIndication_CN_CAN00_a2373004
          BswMConditionValue
            BswMBswMode: BswMBswRequestedMode=COMM_NO_COMMUNICATION
        ESH_ComMIndication_CN_CAN00_a2373004 (BswMModeRequestPort): BswMArbitrateOnInit=false, BswMRequestProcessing=BSWM_DEFERRED
          BswMModeRequestSource
            BswMComMIndication: BswMComMChannelRef=ComMConfigSet/CN_CAN00_a2373004
          BswMModeInitValue
            BswMBswModeInitValue: BswMBswModeInitValueMode=COMM_NO_COMMUNICATION
      BswMModeControl: BswMInitActionListRef=INIT_AL_Initialize
        ESH_AL_PrepShutdownToWaitForNvM (BswMActionList): BswMActionListExecution=BSWM_CONDITION
          4 x BswMActionListItem, all with BswMAbortOnFail=false:
            ESH_Action_WriteAllTimer_Start: BswMActionListItemIndex=0, BswMActionListItemRef=BswMModeControl/ESH_Action_WriteAllTimer_Start
            ESH_Action_NvMWriteAll: BswMActionListItemIndex=1, BswMActionListItemRef=BswMModeControl/ESH_Action_NvMWriteAll
            ESH_Action_ESH_WaitForNvm: BswMActionListItemIndex=3, BswMActionListItemRef=BswMModeControl/ESH_Action_ESH_WaitForNvm
            ESH_Action_ComMCheckPendingRequests: BswMActionListItemIndex=2, BswMActionListItemRef=BswMModeControl/ESH_Action_ComMCheckPendingRequests
        3 x BswMAction:
          ESH_Action_WriteAllTimer_Start
            BswMAvailableActions
              BswMTimerControl: BswMTimerAction=BSWM_TIMER_START, BswMTimerValue=60, BswMTimerRef=ESH_NvM_WriteAllTimer
          ESH_Action_NvMWriteAll
            BswMAvailableActions
              BswMUserCallout: BswMUserCalloutFunction=NvM_WriteAll(), BswMCreateCallout=false, BswMUserIncludeFile=NvM.h
          ESH_Action_ESH_WaitForNvm
            BswMAvailableActions
              BswMGenericModeSwitch: BswMGenericRequestRef=ESH_State, BswMGenericRequestModeRef=ESH_WAIT_FOR_NVM
        ESH_AL_WaitForNvMToShutdown (BswMActionList): BswMActionListExecution=BSWM_CONDITION
          ESH_Action_WriteAllTimer_Stop (BswMActionListItem): BswMAbortOnFail=false, BswMActionListItemIndex=0, BswMActionListItemRef=BswMModeControl/ESH_Action_WriteAllTimer_Stop
          ESH_Action_EcuMGoToSelectedShutdownTarget (BswMActionListItem): BswMAbortOnFail=false, BswMActionListItemIndex=1, BswMActionListItemRef=BswMModeControl/ESH_Action_EcuMGoToSelectedShutdownTarget
        ESH_Action_WriteAllTimer_Stop (BswMAction)
          BswMAvailableActions
            BswMTimerControl: BswMTimerAction=BSWM_TIMER_STOP, BswMTimerValue=0, BswMTimerRef=ESH_NvM_WriteAllTimer
        ESH_Action_EcuMGoToSelectedShutdownTarget (BswMAction)
          BswMAvailableActions
            BswMUserCallout: BswMUserCalloutFunction=(void)EcuM_GoToSelectedShutdownTarget(), BswMCreateCallout=false, BswMUserIncludeFile=EcuM.h
        ESH_AL_WaitForNvMWakeup (BswMActionList): BswMActionListExecution=BSWM_CONDITION
          4 x BswMActionListItem, all with BswMAbortOnFail=false:
            ESH_Action_WriteAllTimer_Stop: BswMActionListItemIndex=0, BswMActionListItemRef=BswMModeControl/ESH_Action_WriteAllTimer_Stop
            ESH_Action_CancelWriteAllTimer_Start: BswMActionListItemIndex=1, BswMActionListItemRef=BswMModeControl/ESH_Action_CancelWriteAllTimer_Start
            ESH_Action_CancelNvMWriteAll: BswMActionListItemIndex=2, BswMActionListItemRef=BswMModeControl/ESH_Action_CancelNvMWriteAll
            ESH_Action_ESH_Wakeup: BswMActionListItemIndex=3, BswMActionListItemRef=BswMModeControl/ESH_Action_ESH_Wakeup
        3 x BswMAction:
          ESH_Action_CancelWriteAllTimer_Start
            BswMAvailableActions
              BswMTimerControl: BswMTimerAction=BSWM_TIMER_START, BswMTimerValue=60, BswMTimerRef=ESH_NvM_CancelWriteAllTimer
          ESH_Action_CancelNvMWriteAll
            BswMAvailableActions
              BswMUserCallout: BswMUserCalloutFunction=NvM_CancelWriteAll(), BswMCreateCallout=false, BswMUserIncludeFile=NvM.h
          ESH_Action_ESH_Wakeup
            BswMAvailableActions
              BswMGenericModeSwitch: BswMGenericRequestRef=ESH_State, BswMGenericRequestModeRef=ESH_WAKEUP
        ESH_AL_RunToPostRun (BswMActionList): BswMActionListExecution=BSWM_CONDITION
          3 x BswMActionListItem, all with BswMAbortOnFail=false:
            ESH_Action_EcuMClearValidatedWakeupEvents: BswMActionListItemIndex=1, BswMActionListItemRef=BswMModeControl/ESH_Action_EcuMClearValidatedWakeupEvents
            ESH_Action_ESH_PostRun: BswMActionListItemIndex=2, BswMActionListItemRef=BswMModeControl/ESH_Action_ESH_PostRun
            ESH_Action_ComMDisallow_CN_CAN00_a2373004: BswMActionListItemIndex=0, BswMActionListItemRef=BswMModeControl/ESH_Action_ComMDisallow_CN_CAN00_a2373004
        ESH_Action_EcuMClearValidatedWakeupEvents (BswMAction)
          BswMAvailableActions
            BswMUserCallout: BswMUserCalloutFunction=EcuM_ClearValidatedWakeupEvent(ECUM_WKSOURCE_ALL_SOURCES), BswMCreateCallout=false, BswMUserIncludeFile=EcuM.h
        ESH_Action_ESH_PostRun (BswMAction)
          BswMAvailableActions
            BswMGenericModeSwitch: BswMGenericRequestRef=ESH_State, BswMGenericRequestModeRef=ESH_POST_RUN
        ESH_AL_PostRunToRun (BswMActionList): BswMActionListExecution=BSWM_CONDITION
          3 x BswMActionListItem, all with BswMAbortOnFail=false:
            ESH_Action_SelfRunRequestTimer_Start: BswMActionListItemIndex=1, BswMActionListItemRef=BswMModeControl/ESH_Action_SelfRunRequestTimer_Start
            ESH_Action_ESH_Run: BswMActionListItemIndex=2, BswMActionListItemRef=BswMModeControl/ESH_Action_ESH_Run
            ESH_Action_ComMAllow_CN_CAN00_a2373004: BswMActionListItemIndex=0, BswMActionListItemRef=BswMModeControl/ESH_Action_ComMAllow_CN_CAN00_a2373004
        ESH_Action_SelfRunRequestTimer_Start (BswMAction)
          BswMAvailableActions
            BswMTimerControl: BswMTimerAction=BSWM_TIMER_START, BswMTimerValue=0.1, BswMTimerRef=ESH_SelfRunRequestTimer
        ESH_Action_ESH_Run (BswMAction)
          BswMAvailableActions
            BswMGenericModeSwitch: BswMGenericRequestRef=ESH_State, BswMGenericRequestModeRef=ESH_RUN
        ESH_AL_PostRunToPrepShutdown (BswMActionList): BswMActionListExecution=BSWM_CONDITION
          ESH_Action_ESH_PrepShutdown (BswMActionListItem): BswMAbortOnFail=false, BswMActionListItemIndex=0, BswMActionListItemRef=BswMModeControl/ESH_Action_ESH_PrepShutdown
        ESH_Action_ESH_PrepShutdown (BswMAction)
          BswMAvailableActions
            BswMGenericModeSwitch: BswMGenericRequestRef=ESH_State, BswMGenericRequestModeRef=ESH_PREP_SHUTDOWN
        ESH_AL_WakeupToRun (BswMActionList): BswMActionListExecution=BSWM_CONDITION
          4 x BswMActionListItem, all with BswMAbortOnFail=false:
            ESH_Action_CancelWriteAllTimer_Stop: BswMActionListItemIndex=0, BswMActionListItemRef=BswMModeControl/ESH_Action_CancelWriteAllTimer_Stop
            ESH_Action_SelfRunRequestTimer_Start: BswMActionListItemIndex=2, BswMActionListItemRef=BswMModeControl/ESH_Action_SelfRunRequestTimer_Start
            ESH_Action_ESH_Run: BswMActionListItemIndex=3, BswMActionListItemRef=BswMModeControl/ESH_Action_ESH_Run
            ESH_Action_ComMAllow_CN_CAN00_a2373004: BswMActionListItemIndex=1, BswMActionListItemRef=BswMModeControl/ESH_Action_ComMAllow_CN_CAN00_a2373004
        ESH_Action_CancelWriteAllTimer_Stop (BswMAction)
          BswMAvailableActions
            BswMTimerControl: BswMTimerAction=BSWM_TIMER_STOP, BswMTimerValue=0, BswMTimerRef=ESH_NvM_CancelWriteAllTimer
        3 x BswMActionList, all with BswMActionListExecution=BSWM_CONDITION:
          ESH_AL_WakeupToPrep
            ESH_Action_ESH_PrepShutdown (BswMActionListItem): BswMAbortOnFail=false, BswMActionListItemIndex=0, BswMActionListItemRef=BswMModeControl/ESH_Action_ESH_PrepShutdown
          ESH_AL_InitToWakeup
            ESH_Action_ESH_Wakeup (BswMActionListItem): BswMAbortOnFail=false, BswMActionListItemIndex=0, BswMActionListItemRef=BswMModeControl/ESH_Action_ESH_Wakeup
          INIT_AL_Initialize
            23 x BswMActionListItem, all with BswMAbortOnFail=false:
              INIT_Action_Det_Start: BswMActionListItemIndex=1, BswMActionListItemRef=BswMModeControl/INIT_Action_Det_Start
              INIT_Action_Adc_Init: BswMActionListItemIndex=4, BswMActionListItemRef=BswMModeControl/INIT_Action_Adc_Init
              INIT_Action_Mcu_Init: BswMActionListItemIndex=6, BswMActionListItemRef=BswMModeControl/INIT_Action_Mcu_Init
              INIT_Action_Can_Init: BswMActionListItemIndex=7, BswMActionListItemRef=BswMModeControl/INIT_Action_Can_Init
              INIT_Action_CanIf_Init: BswMActionListItemIndex=8, BswMActionListItemRef=BswMModeControl/INIT_Action_CanIf_Init
              INIT_Action_Fee_Init: BswMActionListItemIndex=9, BswMActionListItemRef=BswMModeControl/INIT_Action_Fee_Init
              INIT_Action_Com_Init: BswMActionListItemIndex=10, BswMActionListItemRef=BswMModeControl/INIT_Action_Com_Init
              INIT_Action_PduR_Init: BswMActionListItemIndex=11, BswMActionListItemRef=BswMModeControl/INIT_Action_PduR_Init
              INIT_Action_CanSM_Init: BswMActionListItemIndex=12, BswMActionListItemRef=BswMModeControl/INIT_Action_CanSM_Init
              INIT_Action_CanNm_Init: BswMActionListItemIndex=13, BswMActionListItemRef=BswMModeControl/INIT_Action_CanNm_Init
              INIT_Action_Nm_Init: BswMActionListItemIndex=14, BswMActionListItemRef=BswMModeControl/INIT_Action_Nm_Init
              INIT_Action_NvM_Init: BswMActionListItemIndex=15, BswMActionListItemRef=BswMModeControl/INIT_Action_NvM_Init
              INIT_Action_NvMReadAll: BswMActionListItemIndex=16, BswMActionListItemRef=BswMModeControl/INIT_Action_NvMReadAll
              INIT_Action_ComM_Init: BswMActionListItemIndex=18, BswMActionListItemRef=BswMModeControl/INIT_Action_ComM_Init
              INIT_Action_Dem_Init: BswMActionListItemIndex=19, BswMActionListItemRef=BswMModeControl/INIT_Action_Dem_Init
              INIT_Action_Fls_Init: BswMActionListItemIndex=5, BswMActionListItemRef=BswMModeControl/INIT_Action_Fls_Init
              INIT_Action_Rte_Start: BswMActionListItemIndex=22, BswMActionListItemRef=BswMModeControl/INIT_Action_Rte_Start
              INIT_Action_PduR_PreInit: BswMActionListItemIndex=3, BswMActionListItemRef=BswMModeControl/INIT_Action_PduR_PreInit
              INIT_Action_ComM_PreInit: BswMActionListItemIndex=0, BswMActionListItemRef=BswMModeControl/INIT_Action_ComM_PreInit
              INIT_Action_Nm_PreInit: BswMActionListItemIndex=2, BswMActionListItemRef=BswMModeControl/INIT_Action_Nm_PreInit
              INIT_Action_ComM_PostInit: BswMActionListItemIndex=20, BswMActionListItemRef=BswMModeControl/INIT_Action_ComM_PostInit
              INIT_Action_Nm_PostInit: BswMActionListItemIndex=21, BswMActionListItemRef=BswMModeControl/INIT_Action_Nm_PostInit
              INIT_Action_EnableInterrupts: BswMActionListItemIndex=17, BswMActionListItemRef=BswMModeControl/INIT_Action_EnableInterrupts
        15 x BswMAction:
          INIT_Action_Det_Start
            BswMAvailableActions
              BswMUserCallout: BswMUserCalloutFunction=Det_Start(), BswMCreateCallout=false, BswMUserIncludeFile=Det.h
          INIT_Action_Adc_Init
            BswMAvailableActions
              BswMUserCallout: BswMUserCalloutFunction=Adc_Init(AdcConfigSet), BswMCreateCallout=false, BswMUserIncludeFile=Adc.h
          INIT_Action_Mcu_Init
            BswMAvailableActions
              BswMUserCallout: BswMUserCalloutFunction=Mcu_Init(McuModuleConfiguration), BswMCreateCallout=false, BswMUserIncludeFile=Mcu.h
          INIT_Action_Can_Init
            BswMAvailableActions
              BswMUserCallout: BswMUserCalloutFunction=Can_Init(Can_Config_Ptr), BswMCreateCallout=false, BswMUserIncludeFile=Can.h
          INIT_Action_CanIf_Init
            BswMAvailableActions
              BswMUserCallout: BswMUserCalloutFunction=CanIf_Init(CanIf_Config_Ptr), BswMCreateCallout=false, BswMUserIncludeFile=CanIf.h
          INIT_Action_Fee_Init
            BswMAvailableActions
              BswMUserCallout: BswMUserCalloutFunction=Fee_Init(), BswMCreateCallout=false, BswMUserIncludeFile=Fee.h
          INIT_Action_Com_Init
            BswMAvailableActions
              BswMUserCallout: BswMUserCalloutFunction=Com_Init(Com_Config_Ptr), BswMCreateCallout=false, BswMUserIncludeFile=Com.h
          INIT_Action_PduR_Init
            BswMAvailableActions
              BswMUserCallout: BswMUserCalloutFunction=PduR_Init(PduR_Config_Ptr), BswMCreateCallout=false, BswMUserIncludeFile=PduR.h
          INIT_Action_CanSM_Init
            BswMAvailableActions
              BswMUserCallout: BswMUserCalloutFunction=CanSM_Init(CanSM_Config_Ptr), BswMCreateCallout=false, BswMUserIncludeFile=CanSM_EcuM.h
          INIT_Action_CanNm_Init
            BswMAvailableActions
              BswMUserCallout: BswMUserCalloutFunction=CanNm_Init(CanNm_Config_Ptr), BswMCreateCallout=false, BswMUserIncludeFile=CanNm.h
          INIT_Action_Nm_Init
            BswMAvailableActions
              BswMUserCallout: BswMUserCalloutFunction=Nm_Init(Nm_Config_Ptr), BswMCreateCallout=false, BswMUserIncludeFile=Nm.h
          INIT_Action_NvM_Init
            BswMAvailableActions
              BswMUserCallout: BswMUserCalloutFunction=NvM_Init(), BswMCreateCallout=false, BswMUserIncludeFile=NvM.h
          INIT_Action_NvMReadAll
            BswMAvailableActions
              BswMUserCallout: BswMUserCalloutFunction=BswM_INIT_NvMReadAll(), BswMCreateCallout=true
          INIT_Action_ComM_Init
            BswMAvailableActions
              BswMUserCallout: BswMUserCalloutFunction=ComM_Init(ComM_Config_Ptr), BswMCreateCallout=false, BswMUserIncludeFile=ComM.h
          INIT_Action_Dem_Init
            BswMAvailableActions
              BswMUserCallout: BswMUserCalloutFunction=Dem_Init(Dem_Config_Ptr), BswMCreateCallout=false, BswMUserIncludeFile=Dem.h
        ESH_AL_ExitRun (BswMActionList): BswMActionListExecution=BSWM_CONDITION
          4 x BswMActionListItem, all with BswMAbortOnFail=false:
            ESH_Action_EnterExclusiveArea: BswMActionListItemIndex=0, BswMActionListItemRef=BswMModeControl/ESH_Action_EnterExclusiveArea
            ESH_Action_ComMCheckPendingRequests: BswMActionListItemIndex=1, BswMActionListItemRef=BswMModeControl/ESH_Action_ComMCheckPendingRequests
            ESH_RunToPostRunNested: BswMActionListItemIndex=2, BswMActionListItemRef=BswMArbitration/ESH_RunToPostRunNested
            ESH_Action_ExitExclusiveArea: BswMActionListItemIndex=3, BswMActionListItemRef=BswMModeControl/ESH_Action_ExitExclusiveArea
        3 x BswMAction:
          ESH_Action_EnterExclusiveArea
            BswMAvailableActions
              BswMUserCallout: BswMUserCalloutFunction=SchM_Enter_BswM_BSWM_EXCLUSIVE_AREA_0(), BswMCreateCallout=false, BswMUserIncludeFile=SchM_BswM.h
          ESH_Action_ComMCheckPendingRequests
            BswMAvailableActions
              BswMUserCallout:
                BswMUserCalloutFunction = ESH_ComM_CheckPendingRequests()
                BswMCreateCallout = true
                BswMUserCode = ComM_StateType CN_CAN00_a2373004 = COMM_NO_COM_NO_PENDING_REQUEST; (void)ComM_GetState(ComMConf_ComMChannel_CN_CAN00_a2373004, &CN_CAN00_a2373004); /* SBSW_BSWM_FCTCALL_LOCALVAR */ if(CN_CAN00_a2373004 != COMM_NO_COM_NO_PENDING_REQUEST) { BswM_RequestMode(BSWM_GENERIC_ESH_ComMPendingRequests, BSWM_GENERICVALUE_ESH_ComMPendingRequests_ESH_COMM_PENDING_REQUEST); } else { BswM_RequestMode(BSWM_GENERIC_ESH_ComMPendingRequests, BSWM_GENERICVALUE_ESH_ComMPendingRequests_ESH_COMM_NO_REQUEST); }
          ESH_Action_ExitExclusiveArea
            BswMAvailableActions
              BswMUserCallout: BswMUserCalloutFunction=SchM_Exit_BswM_BSWM_EXCLUSIVE_AREA_0(), BswMCreateCallout=false, BswMUserIncludeFile=SchM_BswM.h
        ESH_AL_ExitPostRun (BswMActionList): BswMActionListExecution=BSWM_CONDITION
          4 x BswMActionListItem, all with BswMAbortOnFail=false:
            ESH_Action_EnterExclusiveArea: BswMActionListItemIndex=0, BswMActionListItemRef=BswMModeControl/ESH_Action_EnterExclusiveArea
            ESH_Action_ComMCheckPendingRequests: BswMActionListItemIndex=1, BswMActionListItemRef=BswMModeControl/ESH_Action_ComMCheckPendingRequests
            ESH_PostRunNested: BswMActionListItemIndex=2, BswMActionListItemRef=BswMArbitration/ESH_PostRunNested
            ESH_Action_ExitExclusiveArea: BswMActionListItemIndex=3, BswMActionListItemRef=BswMModeControl/ESH_Action_ExitExclusiveArea
        INIT_Action_Fls_Init (BswMAction)
          BswMAvailableActions
            BswMUserCallout: BswMUserCalloutFunction=Fls_Init(FlsConfigSet), BswMCreateCallout=false, BswMUserIncludeFile=Fls.h
        INIT_Action_Rte_Start (BswMAction)
          BswMAvailableActions
            BswMUserCallout: BswMUserCalloutFunction=Rte_Start(), BswMCreateCallout=false, BswMUserIncludeFile=Rte_Main.h
        CC_AL_CN_CAN00_a2373004_RX_Disable (BswMActionList): BswMActionListExecution=BSWM_TRIGGER
          CC_DisablePDUGroup_BFC_oCAN00_Rx_0b0c154c (BswMActionListItem): BswMAbortOnFail=false, BswMActionListItemIndex=0, BswMActionListItemRef=BswMModeControl/CC_DisablePDUGroup_BFC_oCAN00_Rx_0b0c154c
        CC_DisablePDUGroup_BFC_oCAN00_Rx_0b0c154c (BswMAction)
          BswMAvailableActions
            BswMPduGroupSwitch: BswMPduGroupSwitchReinit=false, BswMDisabledPduGroupRef=BFC_oCAN00_Rx_0b0c154c
        CC_AL_CN_CAN00_a2373004_RX_EnableNoinit (BswMActionList): BswMActionListExecution=BSWM_TRIGGER
          CC_EnablePDUGroup_BFC_oCAN00_Rx_0b0c154c (BswMActionListItem): BswMAbortOnFail=false, BswMActionListItemIndex=0, BswMActionListItemRef=BswMModeControl/CC_EnablePDUGroup_BFC_oCAN00_Rx_0b0c154c
        CC_EnablePDUGroup_BFC_oCAN00_Rx_0b0c154c (BswMAction)
          BswMAvailableActions
            BswMPduGroupSwitch: BswMPduGroupSwitchReinit=false, BswMEnabledPduGroupRef=BFC_oCAN00_Rx_0b0c154c
        CC_AL_CN_CAN00_a2373004_Disable_DM (BswMActionList): BswMActionListExecution=BSWM_TRIGGER
          CC_DisableDM_BFC_oCAN00_Rx_0b0c154c (BswMActionListItem): BswMAbortOnFail=false, BswMActionListItemIndex=0, BswMActionListItemRef=BswMModeControl/CC_DisableDM_BFC_oCAN00_Rx_0b0c154c
        CC_DisableDM_BFC_oCAN00_Rx_0b0c154c (BswMAction)
          BswMAvailableActions
            BswMDeadlineMonitoringControl: BswMDisabledDMPduGroupRef=BFC_oCAN00_Rx_0b0c154c
        CC_AL_CN_CAN00_a2373004_Enable_DM (BswMActionList): BswMActionListExecution=BSWM_TRIGGER
          CC_EnableDM_BFC_oCAN00_Rx_0b0c154c (BswMActionListItem): BswMAbortOnFail=false, BswMActionListItemIndex=0, BswMActionListItemRef=BswMModeControl/CC_EnableDM_BFC_oCAN00_Rx_0b0c154c
        CC_EnableDM_BFC_oCAN00_Rx_0b0c154c (BswMAction)
          BswMAvailableActions
            BswMDeadlineMonitoringControl: BswMEnabledDMPduGroupRef=BFC_oCAN00_Rx_0b0c154c
        CC_AL_CN_CAN00_a2373004_TX_Disable (BswMActionList): BswMActionListExecution=BSWM_TRIGGER
          CC_DisablePDUGroup_BFC_oCAN00_Tx_5d56b2ca (BswMActionListItem): BswMAbortOnFail=false, BswMActionListItemIndex=0, BswMActionListItemRef=BswMModeControl/CC_DisablePDUGroup_BFC_oCAN00_Tx_5d56b2ca
        CC_DisablePDUGroup_BFC_oCAN00_Tx_5d56b2ca (BswMAction)
          BswMAvailableActions
            BswMPduGroupSwitch: BswMPduGroupSwitchReinit=false, BswMDisabledPduGroupRef=BFC_oCAN00_Tx_5d56b2ca
        CC_AL_CN_CAN00_a2373004_TX_EnableNoinit (BswMActionList): BswMActionListExecution=BSWM_TRIGGER
          CC_EnablePDUGroup_BFC_oCAN00_Tx_5d56b2ca (BswMActionListItem): BswMAbortOnFail=false, BswMActionListItemIndex=0, BswMActionListItemRef=BswMModeControl/CC_EnablePDUGroup_BFC_oCAN00_Tx_5d56b2ca
        9 x BswMAction:
          CC_EnablePDUGroup_BFC_oCAN00_Tx_5d56b2ca
            BswMAvailableActions
              BswMPduGroupSwitch: BswMPduGroupSwitchReinit=false, BswMEnabledPduGroupRef=BFC_oCAN00_Tx_5d56b2ca
          ESH_Action_ComMDisallow_CN_CAN00_a2373004
            BswMAvailableActions
              BswMComMAllowCom: BswMComAllowed=false, BswMComMAllowChannelRef=ComMConfigSet/CN_CAN00_a2373004
          ESH_Action_ComMAllow_CN_CAN00_a2373004
            BswMAvailableActions
              BswMComMAllowCom: BswMComAllowed=true, BswMComMAllowChannelRef=ComMConfigSet/CN_CAN00_a2373004
          INIT_Action_PduR_PreInit
            BswMAvailableActions
              BswMUserCallout: BswMUserCalloutFunction=PduR_PreInit(PduR_Config_Ptr), BswMCreateCallout=false, BswMUserIncludeFile=PduR.h
          INIT_Action_ComM_PreInit
            BswMAvailableActions
              BswMUserCallout: BswMUserCalloutFunction=ComM_PreInit(ComM_Config_Ptr), BswMCreateCallout=false, BswMUserIncludeFile=ComM.h
          INIT_Action_Nm_PreInit
            BswMAvailableActions
              BswMUserCallout: BswMUserCalloutFunction=Nm_PreInit(Nm_Config_Ptr), BswMCreateCallout=false, BswMUserIncludeFile=Nm.h
          INIT_Action_ComM_PostInit
            BswMAvailableActions
              BswMUserCallout: BswMUserCalloutFunction=ComM_PostInit(), BswMCreateCallout=false, BswMUserIncludeFile=ComM.h
          INIT_Action_Nm_PostInit
            BswMAvailableActions
              BswMUserCallout: BswMUserCalloutFunction=Nm_PostInit(), BswMCreateCallout=false, BswMUserIncludeFile=Nm.h
          INIT_Action_EnableInterrupts
            BswMAvailableActions
              BswMUserCallout: BswMUserCalloutFunction=BswM_AL_SetProgrammableInterrupts(), BswMCreateCallout=true
    BswMGeneral:
      BswMJ1939NmEnabled = false
      BswMNmEnabled = true
      BswMSdEnabled = false
      BswMCanSMEnabled = true
      BswMComMEnabled = true
      BswMEcuMEnabled = true
      BswMNvMEnabled = true
      BswMDcmEnabled = false
      BswMEthSMEnabled = false
      BswMFrSMEnabled = false
      BswMLinSMEnabled = false
      BswMLinTPEnabled = false
      BswMMainFunctionPeriod = 0.01
      BswMDevErrorDetect = false
      BswMVersionInfoApi = true
      BswMGenericRequestEnabled = true
      BswMRuleControlEnabled = false
      BswMModeCheck = true
      BswMPduREnabled = false
      BswMEthIfEnabled = false
      BswMJ1939DcmEnabled = false
      BswMWdgMEnabled = false
      BswMActionListQueueSearchAlgorithm = LINEAR_SEARCH
      BswMSafeBswChecks = false
      BswMCommonData
      BswMGeneration:
        BswMOutOfBoundsWriteSanitizer = false
        BswMOutOfBoundsReadSanitizer = false
        BswMReduceConstantData2Define = true
        BswMBoolDataInArrayOfStructStrategy = BITMASKING
        BswMInterfacesForDeactivatedData = false
  module config Com: implementation-config-variant=VARIANT-PRE-COMPILE, module-description=Com_Impl
    ComConfig: ComConfigurationId=0, ComRxDeferredNotificationCacheSize=0, ComRxImmediateNotificationCacheSize=0
      BFC_oCAN00_Tx_5d56b2ca (ComIPduGroup): ComIPduGroupHandleId=1
      BFC_oCAN00_Rx_0b0c154c (ComIPduGroup): ComIPduGroupHandleId=0
      LightSwitch_oLightSwitch_oCAN00_b775c021_Rx (ComSignal):
        ComBitPosition = 0
        ComBitSize = 2
        ComSignalDataInvalidValue = 3
        ComSignalEndianness = LITTLE_ENDIAN
        ComSignalInitValue = 0
        ComSignalType = UINT8
        ComTimeout = 0
        ComSignalAccess = ACCESS_NEEDED_BY_SWC_OR_COM
        ComHandleId = 0
        ComSystemTemplateSystemSignalRef = LightSwitch
      LightCtrl_oCAN00_2e88b3f5_Tx (ComIPdu):
        ComIPduDirection = SEND
        ComIPduType = NORMAL
        ComIPduHandleId = 0
        ComIPduSignalProcessing = DEFERRED
        ComIPduCancellationSupport = false
        ComIPduGroupRef = BFC_oCAN00_Tx_5d56b2ca
        ComIPduSignalRef = HeadLight_oLightCtrl_oCAN00_3d3756da_Tx
        ComPduIdRef = EcucPduCollection/LightCtrl_oCAN00_2e88b3f5_Tx
        ComIPduMainFunctionRef = ComMainFunctionTx
        ComTxIPdu: ComMinimumDelayTime=0, ComTxIPduUnusedAreasDefault=0
          ComTxModeTrue
            ComTxMode: ComTxModeMode=PERIODIC, ComTxModeTimeOffset=0, ComTxModeTimePeriod=0.01
          ComTxModeFalse
            ComTxMode: ComTxModeMode=PERIODIC, ComTxModeTimeOffset=0, ComTxModeTimePeriod=0.01
      LightSwitch_oCAN00_d3b6d56e_Rx (ComIPdu):
        ComIPduDirection = RECEIVE
        ComIPduType = NORMAL
        ComIPduHandleId = 0
        ComIPduSignalProcessing = DEFERRED
        ComIPduCancellationSupport = false
        ComIPduGroupRef = BFC_oCAN00_Rx_0b0c154c
        ComIPduSignalRef = LightSwitch_oLightSwitch_oCAN00_b775c021_Rx
        ComPduIdRef = EcucPduCollection/LightSwitch_oCAN00_d3b6d56e_Rx
        ComIPduMainFunctionRef = ComMainFunctionRx
      HeadLight_oLightCtrl_oCAN00_3d3756da_Tx (ComSignal):
        ComBitPosition = 0
        ComBitSize = 1
        ComSignalEndianness = LITTLE_ENDIAN
        ComSignalInitValue = 0
        ComSignalType = BOOLEAN
        ComTransferProperty = PENDING
        ComSignalAccess = ACCESS_NEEDED_BY_SWC_OR_COM
        ComHandleId = 0
        ComSystemTemplateSystemSignalRef = HeadLight
      ComMainFunctionRx: ComMainRxTimeBase=0.01
      ComMainFunctionTx: ComMainTxTimeBase=0.01
    ComGeneral:
      ComConfigurationUseDet = false
      ComSafeBswChecks = false
      ComEnableSignalGroupArrayApi = false
      ComRetryFailedTransmitRequests = true
      ComSupportedIPduGroups = 2
      ComVersionInfoApi = false
      ComMetaDataSupport = false
      ComDeferredEventCacheSupport = false
      ComDescriptionGateway = false
      ComMixedModePeriodicSuppression = false
      ComStrictRepetitionPeriod = false
      ComSignalGateway = NONE
      ComMultiPartition = false
    ComGeneration:
      ComOutOfBoundsWriteProtectionStrategy = NONE
      ComOutOfBoundsWriteSanitizer = false
      ComOutOfBoundsReadSanitizer = false
      ComReduceConstantData2Define = false
      ComBoolDataInArrayOfStructStrategy = BOOLEAN
      ComDeduplicateIndirectedData = true
      ComDataDeduplicationStrategy = WITH_CAST
      ComReduceBoolDataByNegationThreshold = 2
      ComReduceBoolDataByNumericalComparisonThreshold = 2
      ComReduceBoolDataByNumericalRelationThreshold = 2
      ComReduceBoolDataByNumericalOperandStrategy = WITH_ANY_VALUE
      ComReduceNumericalDataByOffsetThreshold = 2
      ComReduceNumericalDataByArraySubtractionThreshold = 2
      ComReduceDataByStreaming = false
      ComShortSymbols = false
      ComInterfacesForDeactivatedData = false
      ComReferringKeysInComments = false
      ComNumberOfElementsCommentThreshold = 1000
    ComOptimization:
      ComTxProcessingISRLockThreshold = 1
      ComGatewayProcessingISRLockThreshold = 1
      ComGatewayDescriptionProcessingISRLockThreshold = 1
      ComIPduGroupISRLockThreshold = 1
      ComRxProcessingISRLockThreshold = 1
  module config Can: implementation-config-variant=VARIANT-PRE-COMPILE, module-description=Can_Impl
    CanConfigSet
      CT_CAN00_6199f384 (CanController):
        CanBusName = CAN00
        CanControllerActivation = true
        CanBusoffProcessing = INTERRUPT
        CanControllerBaseAddress = 0
        CanControllerId = 0
        CanRxProcessing = INTERRUPT
        CanTxProcessing = INTERRUPT
        CanWakeupProcessing = INTERRUPT
        CanWakeupSupport = true
        CanWakeupSourceId = 32
        CanCommonCAN = false
        CanControllerDefaultBaudrate = CT_CAN00_6199f384/CanControllerBaudrateConfig
        CanControllerSystemRef = CT_CAN00
        CanWakeupSourceRef = CAN00_f26020e5
        CanCpuClockRef = McuClockSettingConfig/McuClockReferencePoint
        CanControllerBaudrateConfig:
          CanControllerBaudRate = 500
          CanControllerBaudRateConfigID = 0
          CanControllerPropSeg = 3
          CanControllerSeg1 = 2
          CanControllerSeg2 = 2
          CanControllerSyncJumpWidth = 1
          CanBaudrateClock = 80000
          CanBaudratePrescaler = 20
          CanSamplingMode = OneSample
        CanFilterMask: CanFilterMaskValue=0, CanFilterCodeValue=0, IsLocked=false
      CN_CAN00_e8c1d35b_Rx_Std (CanHardwareObject):
        CanHandleType = BASIC
        CanIdType = STANDARD
        CanIdValue = 0
        CanObjectType = RECEIVE
        CanObjectId = 1
        CanHwProcessing = false
        CanObjectHwSize = 2
        CanObjectHwHandle = 1
        CanMaxDataLen = 8
        CanFdPaddingValue = 0
        CanObjectMultiplexedTransmission = false
        CanObjectHwFifo = false
        CanControllerRef = CanConfigSet/CT_CAN00_6199f384
        CanFilterMaskRef = CT_CAN00_6199f384/CanFilterMask
      CN_CAN00_a2373004_Tx (CanHardwareObject):
        CanHandleType = BASIC
        CanIdValue = 0
        CanObjectType = TRANSMIT
        CanIdType = STANDARD
        CanObjectId = 0
        CanHwProcessing = false
        CanObjectHwSize = 1
        CanObjectHwHandle = 0
        CanMaxDataLen = 8
        CanFdPaddingValue = 0
        CanObjectMultiplexedTransmission = false
        CanObjectHwFifo = false
        CanControllerRef = CanConfigSet/CT_CAN00_6199f384
    CanGeneral:
      CanIndex = 0
      CanChangeBaudrateApi = false
      CanDevErrorDetection = true
      CanHardwareCancellation = false
      CanIdenticalIdCancellation = false
      CanMainFunctionBusoffPeriod = 0.01
      CanMainFunctionModePeriod = 0.01
      CanMainFunctionWakeupPeriod = 0.01
      CanMultiplexedTransmission = false
      CanSetBaudrateApi = true
      CanTimeoutDuration = 0.01
      CanVersionInfoApi = false
      CanGenericPrecopy = false
      CanHardwareLoopCheck = false
      CanRxFullCANSupport = false
      CanTxFullCANSupport = false
      CanRxBasicCANSupport = true
      CanUseNestedCANInterrupts = false
      CanHardwareCancelByAppl = false
      CanIndividualProcessing = false
      CanGenericConfirmation = false
      CanGenericConfirmationAPI2 = false
      CanRxQueue = false
      CanSupportMixedID = false
      CanRxQueueSize = 10
      CanMultipleBasicCANObjects = false
      CanMultipleBasicCANTxObjects = false
      CanHardwareHandleType = UINT8
      CanOptimizeOneController = true
      CanInterruptCategory = CATEGORY2
      CanGetStatus = false
      CanInterruptLock = DRIVER
      CanWakeupSupport = true
      CanRamCheck = None
      CanOverrunNotification = DET
      CanReinitStart = false
      CanGenericPreTransmit = false
      CanFdSupport = NONE
      CanRuntimeMeasurementSupport = false
      CanMaxRxDataLen = 8
      CanMaxTxDataLen = 8
      CanUsePeripheralAccessApi = false
      CanMirrorModeSupport = false
      CanUseOsInterruptControl = false
      CanSafeBswChecks = false
      CanSilentModeSupport = false
      CanHwTxFifoSupport = false
      CanCheckWakeupCanRetType = false
      CanFdHardwareBufferOptimization = true
      CanEnableSecurityEventReporting = false
      CanCounterRef = Os/SystemTimer
      CanMainFunctionRWPeriods
  module config Rte: implementation-config-variant=VARIANT-PRE-COMPILE, module-description=Rte_Impl
    CanSM (RteBswModuleInstance): RteBswImplementationRef=CanSM_Impl, RteBswModuleConfigurationRef=CanSM
      CANSM_EXCLUSIVE_AREA_1 (RteBswExclusiveAreaImpl): RteExclusiveAreaImplMechanism=ALL_INTERRUPT_BLOCKING, RteBswExclusiveAreaRef=CANSM_EXCLUSIVE_AREA_1
      CanSM_MainFunctionTimingEvent0 (RteBswEventToTaskMapping):
        RteBswImmediateRestart = false
        RteBswPositionInTask = 5
        RteBswEventRef = CanSM_MainFunctionTimingEvent0
        RteBswMappedToTaskRef = Os/BswTask
        RteBswUsedOsAlarmRef = Os/Rte_Al_TE2_BswTask_0_10ms
        RteBswUsedOsEventRef = Os/Rte_Ev_Cyclic2_BswTask_0_10ms
      5 x RteBswExclusiveAreaImpl, all with RteExclusiveAreaImplMechanism=ALL_INTERRUPT_BLOCKING:
        CANSM_EXCLUSIVE_AREA_{2..6}: RteBswExclusiveAreaRef=CANSM_EXCLUSIVE_AREA_{2..6}
    RteGeneration:
      RteCalibrationSupport = NONE
      RteCodeVendorId = 30
      RteDevErrorDetect = false
      RteDevErrorDetectUninit = false
      RteGenerationMode = COMPATIBILITY_MODE
      RteIocInteractionReturnValue = RTE_IOC
      RteMeasurementSupport = false
      RteOptimizationMode = MEMORY
      RteValueRangeCheckEnabled = false
      RteVfbTraceEnabled = false
      RteVttVfbTraceFunction = Rte_Vtt_Task_WaitEventRet
      RteVttVfbTraceFunction = Rte_Vtt_Task_Dispatch
    Det (RteBswModuleInstance): RteBswImplementationRef=Det_Impl, RteBswModuleConfigurationRef=Det
      DET_EXCLUSIVE_AREA_0 (RteBswExclusiveAreaImpl): RteExclusiveAreaImplMechanism=ALL_INTERRUPT_BLOCKING, RteBswExclusiveAreaRef=DET_EXCLUSIVE_AREA_0
    CanIf (RteBswModuleInstance): RteBswImplementationRef=CanIf_Impl, RteBswModuleConfigurationRef=CanIf
      8 x RteBswExclusiveAreaImpl, all with RteExclusiveAreaImplMechanism=ALL_INTERRUPT_BLOCKING:
        CANIF_EXCLUSIVE_AREA_0: RteBswExclusiveAreaRef=CANIF_EXCLUSIVE_AREA_0
        CANIF_EXCLUSIVE_AREA_2: RteBswExclusiveAreaRef=CANIF_EXCLUSIVE_AREA_2
        CANIF_EXCLUSIVE_AREA_1: RteBswExclusiveAreaRef=CANIF_EXCLUSIVE_AREA_1
        CANIF_EXCLUSIVE_AREA_4: RteBswExclusiveAreaRef=CANIF_EXCLUSIVE_AREA_4
        CANIF_EXCLUSIVE_AREA_3: RteBswExclusiveAreaRef=CANIF_EXCLUSIVE_AREA_3
        CANIF_EXCLUSIVE_AREA_6: RteBswExclusiveAreaRef=CANIF_EXCLUSIVE_AREA_6
        CANIF_EXCLUSIVE_AREA_5: RteBswExclusiveAreaRef=CANIF_EXCLUSIVE_AREA_5
        CANIF_EXCLUSIVE_AREA_7: RteBswExclusiveAreaRef=CANIF_EXCLUSIVE_AREA_7
    RteBswGeneral: RteSchMVersionInfoApi=false, RteUseComShadowSignalApi=false
    8 x RteBswModuleInstance:
      Nm: RteBswImplementationRef=Nm_Impl, RteBswModuleConfigurationRef=Nm
        4 x RteBswExclusiveAreaImpl, all with RteExclusiveAreaImplMechanism=ALL_INTERRUPT_BLOCKING:
          NM_EXCLUSIVE_AREA_1: RteBswExclusiveAreaRef=NM_EXCLUSIVE_AREA_1
          NM_EXCLUSIVE_AREA_0: RteBswExclusiveAreaRef=NM_EXCLUSIVE_AREA_0
          NM_EXCLUSIVE_AREA_2: RteBswExclusiveAreaRef=NM_EXCLUSIVE_AREA_2
          NM_EXCLUSIVE_AREA_3: RteBswExclusiveAreaRef=NM_EXCLUSIVE_AREA_3
      BswM: RteBswImplementationRef=BswM_Impl, RteBswModuleConfigurationRef=BswM
        BSWM_EXCLUSIVE_AREA_0 (RteBswExclusiveAreaImpl): RteExclusiveAreaImplMechanism=ALL_INTERRUPT_BLOCKING, RteBswExclusiveAreaRef=BSWM_EXCLUSIVE_AREA_0
        BswM_MainFunctionTimingEvent0 (RteBswEventToTaskMapping):
          RteBswImmediateRestart = false
          RteBswPositionInTask = 7
          RteBswEventRef = BswM_MainFunctionTimingEvent0
          RteBswMappedToTaskRef = Os/BswTask
          RteBswUsedOsAlarmRef = Os/Rte_Al_TE2_BswTask_0_10ms
          RteBswUsedOsEventRef = Os/Rte_Ev_Cyclic2_BswTask_0_10ms
      PduR: RteBswImplementationRef=PduR_Impl, RteBswModuleConfigurationRef=PduR
        PDUR_EXCLUSIVE_AREA_0 (RteBswExclusiveAreaImpl): RteExclusiveAreaImplMechanism=ALL_INTERRUPT_BLOCKING, RteBswExclusiveAreaRef=PDUR_EXCLUSIVE_AREA_0
      Com: RteBswImplementationRef=Com_Impl, RteBswModuleConfigurationRef=Com
        3 x RteBswExclusiveAreaImpl, all with RteExclusiveAreaImplMechanism=ALL_INTERRUPT_BLOCKING:
          COM_EXCLUSIVE_AREA_RX: RteBswExclusiveAreaRef=COM_EXCLUSIVE_AREA_RX
          COM_EXCLUSIVE_AREA_TX: RteBswExclusiveAreaRef=COM_EXCLUSIVE_AREA_TX
          COM_EXCLUSIVE_AREA_BOTH: RteBswExclusiveAreaRef=COM_EXCLUSIVE_AREA_BOTH
        Com_MainFunctionTx_ComMainFunctionTxTimingEvent0 (RteBswEventToTaskMapping):
          RteBswImmediateRestart = false
          RteBswPositionInTask = 0
          RteBswEventRef = Com_MainFunctionTx_ComMainFunctionTxTimingEvent0
          RteBswMappedToTaskRef = Os/BswTask
          RteBswUsedOsEventRef = Os/Rte_Ev_Cyclic2_BswTask_0_10ms
          RteBswUsedOsAlarmRef = Os/Rte_Al_TE2_BswTask_0_10ms
        Com_MainFunctionRx_ComMainFunctionRxTimingEvent0 (RteBswEventToTaskMapping):
          RteBswImmediateRestart = false
          RteBswPositionInTask = 1
          RteBswEventRef = Com_MainFunctionRx_ComMainFunctionRxTimingEvent0
          RteBswMappedToTaskRef = Os/BswTask
          RteBswUsedOsEventRef = Os/Rte_Ev_Cyclic2_BswTask_0_10ms
          RteBswUsedOsAlarmRef = Os/Rte_Al_TE2_BswTask_0_10ms
      Rte: RteBswImplementationRef=Rte_Impl, RteBswModuleConfigurationRef=Rte
      EcuM: RteBswImplementationRef=EcuM_Impl, RteBswModuleConfigurationRef=EcuM
        3 x RteBswExclusiveAreaImpl, all with RteExclusiveAreaImplMechanism=ALL_INTERRUPT_BLOCKING:
          ECUM_EXCLUSIVE_AREA_1: RteBswExclusiveAreaRef=ECUM_EXCLUSIVE_AREA_1
          ECUM_EXCLUSIVE_AREA_0: RteBswExclusiveAreaRef=ECUM_EXCLUSIVE_AREA_0
          ECUM_EXCLUSIVE_AREA_2: RteBswExclusiveAreaRef=ECUM_EXCLUSIVE_AREA_2
        EcuM_MainFunctionTimingEvent0 (RteBswEventToTaskMapping):
          RteBswImmediateRestart = false
          RteBswPositionInTask = 3
          RteBswEventRef = EcuM_MainFunctionTimingEvent0
          RteBswMappedToTaskRef = Os/BswTask
          RteBswUsedOsEventRef = Os/Rte_Ev_Cyclic2_BswTask_0_10ms
          RteBswUsedOsAlarmRef = Os/Rte_Al_TE2_BswTask_0_10ms
        ECUM_EXCLUSIVE_AREA_3 (RteBswExclusiveAreaImpl): RteExclusiveAreaImplMechanism=ALL_INTERRUPT_BLOCKING, RteBswExclusiveAreaRef=ECUM_EXCLUSIVE_AREA_3
      CanNm: RteBswImplementationRef=CanNm_Impl, RteBswModuleConfigurationRef=CanNm
        CANNM_EXCLUSIVE_AREA_4 (RteBswExclusiveAreaImpl): RteExclusiveAreaImplMechanism=ALL_INTERRUPT_BLOCKING, RteBswExclusiveAreaRef=CANNM_EXCLUSIVE_AREA_4
        CanNm_MainFunctionTimingEvent0 (RteBswEventToTaskMapping):
          RteBswImmediateRestart = false
          RteBswPositionInTask = 6
          RteBswEventRef = CanNm_MainFunctionTimingEvent0
          RteBswMappedToTaskRef = Os/BswTask
          RteBswUsedOsAlarmRef = Os/Rte_Al_TE2_BswTask_0_10ms
          RteBswUsedOsEventRef = Os/Rte_Ev_Cyclic2_BswTask_0_10ms
        6 x RteBswExclusiveAreaImpl, all with RteExclusiveAreaImplMechanism=ALL_INTERRUPT_BLOCKING:
          CANNM_EXCLUSIVE_AREA_3: RteBswExclusiveAreaRef=CANNM_EXCLUSIVE_AREA_3
          CANNM_EXCLUSIVE_AREA_2: RteBswExclusiveAreaRef=CANNM_EXCLUSIVE_AREA_2
          CANNM_EXCLUSIVE_AREA_1: RteBswExclusiveAreaRef=CANNM_EXCLUSIVE_AREA_1
          CANNM_EXCLUSIVE_AREA_5: RteBswExclusiveAreaRef=CANNM_EXCLUSIVE_AREA_5
          CANNM_EXCLUSIVE_AREA_0: RteBswExclusiveAreaRef=CANNM_EXCLUSIVE_AREA_0
          CANNM_EXCLUSIVE_AREA_6: RteBswExclusiveAreaRef=CANNM_EXCLUSIVE_AREA_6
      ComM: RteBswImplementationRef=ComM_Impl, RteBswModuleConfigurationRef=ComM
        ComM_MainFunction_0TimingEvent0 (RteBswEventToTaskMapping):
          RteBswImmediateRestart = false
          RteBswPositionInTask = 4
          RteBswEventRef = ComM_MainFunction_0TimingEvent0
          RteBswMappedToTaskRef = Os/BswTask
          RteBswUsedOsAlarmRef = Os/Rte_Al_TE2_BswTask_0_20ms
          RteBswUsedOsEventRef = Os/Rte_Ev_Cyclic2_BswTask_0_20ms
        8 x RteBswExclusiveAreaImpl, all with RteExclusiveAreaImplMechanism=ALL_INTERRUPT_BLOCKING:
          COMM_EXCLUSIVE_AREA_1: RteBswExclusiveAreaRef=COMM_EXCLUSIVE_AREA_1
          COMM_EXCLUSIVE_AREA_0: RteBswExclusiveAreaRef=COMM_EXCLUSIVE_AREA_0
          COMM_EXCLUSIVE_AREA_{2..7}: RteBswExclusiveAreaRef=COMM_EXCLUSIVE_AREA_{2..7}
    4 x RteSwComponentInstance:
      Det_EcuSwComposition: RteSoftwareComponentInstanceRef=Det
      BswM_EcuSwComposition: RteSoftwareComponentInstanceRef=BswM
        Timer_BswM_MainFunction (RteEventToTaskMapping):
          RteImmediateRestart = false
          RtePositionInTask = 7
          RteEventRef = Timer_BswM_MainFunction
          RteMappedToTaskRef = Os/BswTask
          RteUsedOsEventRef = Os/Rte_Ev_Cyclic2_BswTask_0_10ms
          RteUsedOsAlarmRef = Os/Rte_Al_TE2_BswTask_0_10ms
      ComM_EcuSwComposition: RteSoftwareComponentInstanceRef=ComM
        13 x RteEventToTaskMapping, all with RteImmediateRestart=false:
          Timer_ComM_MainFunction_0: RtePositionInTask=4, RteEventRef=Timer_ComM_MainFunction_0, RteMappedToTaskRef=Os/BswTask, RteUsedOsAlarmRef=Os/Rte_Al_TE2_BswTask_0_20ms, RteUsedOsEventRef=Os/Rte_Ev_Cyclic2_BswTask_0_20ms
          OpEventLimitECUToNoComMode_LimitECUToNoComMode_modeLimitation: RtePositionInTask=12, RteEventRef=OpEventLimitECUToNoComMode_LimitECUToNoComMode_modeLimitation, RteMappedToTaskRef=Os/BswTask
          OpEventReadInhibitCounter_ReadInhibitCounter_modeLimitation: RtePositionInTask=13, RteEventRef=OpEventReadInhibitCounter_ReadInhibitCounter_modeLimitation, RteMappedToTaskRef=Os/BswTask
          OpEventResetInhibitCounter_ResetInhibitCounter_modeLimitation: RtePositionInTask=14, RteEventRef=OpEventResetInhibitCounter_ResetInhibitCounter_modeLimitation, RteMappedToTaskRef=Os/BswTask
          OpEventSetECUGroupClassification_SetECUGroupClassification_modeLimitation: RtePositionInTask=15, RteEventRef=OpEventSetECUGroupClassification_SetECUGroupClassification_modeLimitation, RteMappedToTaskRef=Os/BswTask
          OpEventGetCurrentComMode_GetCurrentComMode_UR_USR_CHNL_f276589c: RteEventRef=OpEventGetCurrentComMode_GetCurrentComMode_UR_USR_CHNL_f276589c
          OpEventGetRequestedComMode_GetRequestedComMode_UR_USR_CHNL_f276589c: RteEventRef=OpEventGetRequestedComMode_GetRequestedComMode_UR_USR_CHNL_f276589c
          OpEventGetMaxComMode_GetMaxComMode_UR_USR_CHNL_f276589c: RteEventRef=OpEventGetMaxComMode_GetMaxComMode_UR_USR_CHNL_f276589c
          OpEventRequestComMode_RequestComMode_UR_USR_CHNL_f276589c: RteEventRef=OpEventRequestComMode_RequestComMode_UR_USR_CHNL_f276589c
          OpEventLimitChannelToNoComMode_LimitChannelToNoComMode_CL_CN_CAN00_a2373004: RteEventRef=OpEventLimitChannelToNoComMode_LimitChannelToNoComMode_CL_CN_CAN00_a2373004
          OpEventPreventWakeUp_PreventWakeUp_CW_CN_CAN00_a2373004: RteEventRef=OpEventPreventWakeUp_PreventWakeUp_CW_CN_CAN00_a2373004
          OpEventGetInhibitionStatus_GetInhibitionStatus_CW_CN_CAN00_a2373004: RteEventRef=OpEventGetInhibitionStatus_GetInhibitionStatus_CW_CN_CAN00_a2373004
          OpEventGetInhibitionStatus_GetInhibitionStatus_CL_CN_CAN00_a2373004: RteEventRef=OpEventGetInhibitionStatus_GetInhibitionStatus_CL_CN_CAN00_a2373004
      EcuM_EcuSwComposition: RteSoftwareComponentInstanceRef=EcuM
        8 x RteEventToTaskMapping, all with RteImmediateRestart=false:
          OpEventSelectShutdownTarget_SelectShutdownTarget_EcuM_ShutdownTarget: RteEventRef=OpEventSelectShutdownTarget_SelectShutdownTarget_EcuM_ShutdownTarget
          OpEventGetShutdownTarget_GetShutdownTarget_EcuM_ShutdownTarget: RteEventRef=OpEventGetShutdownTarget_GetShutdownTarget_EcuM_ShutdownTarget
          OpEventGetLastShutdownTarget_GetLastShutdownTarget_EcuM_ShutdownTarget: RteEventRef=OpEventGetLastShutdownTarget_GetLastShutdownTarget_EcuM_ShutdownTarget
          OpEventSelectShutdownCause_SelectShutdownCause_EcuM_ShutdownTarget: RteEventRef=OpEventSelectShutdownCause_SelectShutdownCause_EcuM_ShutdownTarget
          OpEventGetShutdownCause_GetShutdownCause_EcuM_ShutdownTarget: RteEventRef=OpEventGetShutdownCause_GetShutdownCause_EcuM_ShutdownTarget
          OpEventSelectBootTarget_SelectBootTarget_EcuM_BootTarget: RteEventRef=OpEventSelectBootTarget_SelectBootTarget_EcuM_BootTarget
          OpEventGetBootTarget_GetBootTarget_EcuM_BootTarget: RteEventRef=OpEventGetBootTarget_GetBootTarget_EcuM_BootTarget
          Timer_EcuM_MainFunction: RtePositionInTask=3, RteEventRef=Timer_EcuM_MainFunction, RteMappedToTaskRef=Os/BswTask, RteUsedOsEventRef=Os/Rte_Ev_Cyclic2_BswTask_0_10ms, RteUsedOsAlarmRef=Os/Rte_Al_TE2_BswTask_0_10ms
    4 x RteBswModuleInstance:
      Dem: RteBswImplementationRef=Dem_Impl, RteBswModuleConfigurationRef=Dem
        3 x RteBswExclusiveAreaImpl, all with RteExclusiveAreaImplMechanism=ALL_INTERRUPT_BLOCKING:
          DEM_EXCLUSIVE_AREA_{0..2}: RteBswExclusiveAreaRef=DEM_EXCLUSIVE_AREA_{0..2}
        Dem_MasterMainFunctionTimingEvent0 (RteBswEventToTaskMapping):
          RteBswImmediateRestart = false
          RteBswPositionInTask = 17
          RteBswEventRef = Dem_MasterMainFunctionTimingEvent0
          RteBswMappedToTaskRef = Os/BswTask
          RteBswUsedOsEventRef = Os/Rte_Ev_Cyclic2_BswTask_0_10ms
          RteBswUsedOsAlarmRef = Os/Rte_Al_TE2_BswTask_0_10ms
        Dem_SatelliteMainFunctionTimingEvent0 (RteBswEventToTaskMapping):
          RteBswImmediateRestart = false
          RteBswPositionInTask = 16
          RteBswEventRef = Dem_SatelliteMainFunctionTimingEvent0
          RteBswMappedToTaskRef = Os/BswTask
          RteBswUsedOsEventRef = Os/Rte_Ev_Cyclic2_BswTask_0_10ms
          RteBswUsedOsAlarmRef = Os/Rte_Al_TE2_BswTask_0_10ms
        DEM_EXCLUSIVE_AREA_3 (RteBswExclusiveAreaImpl): RteExclusiveAreaImplMechanism=ALL_INTERRUPT_BLOCKING, RteBswExclusiveAreaRef=DEM_EXCLUSIVE_AREA_3
        DEM_EXCLUSIVE_AREA_4 (RteBswExclusiveAreaImpl): RteExclusiveAreaImplMechanism=ALL_INTERRUPT_BLOCKING, RteBswExclusiveAreaRef=DEM_EXCLUSIVE_AREA_4
      Fee: RteBswImplementationRef=Fee_Impl, RteBswModuleConfigurationRef=Fee
        FEE_EXCLUSIVE_AREA_0 (RteBswExclusiveAreaImpl): RteExclusiveAreaImplMechanism=ALL_INTERRUPT_BLOCKING, RteBswExclusiveAreaRef=FEE_EXCLUSIVE_AREA_0
        Fee_MainFunctionTimingEvent0 (RteBswEventToTaskMapping):
          RteBswImmediateRestart = false
          RteBswPositionInTask = 10
          RteBswEventRef = Fee_MainFunctionTimingEvent0
          RteBswMappedToTaskRef = Os/BswTask
          RteBswUsedOsEventRef = Os/Rte_Ev_Run_Fee_Fee_MainFunction
          RteBswUsedOsAlarmRef = Os/Rte_Al_TE_Fee_Fee_MainFunction
      Fls: RteBswImplementationRef=Fls_Impl, RteBswModuleConfigurationRef=Fls
        Fls_MainFunctionTimingEvent0 (RteBswEventToTaskMapping):
          RteBswImmediateRestart = false
          RteBswPositionInTask = 21
          RteBswEventRef = Fls_MainFunctionTimingEvent0
          RteBswMappedToTaskRef = Os/BswTask
          RteBswUsedOsEventRef = Os/Rte_Ev_Cyclic2_BswTask_0_10ms
          RteBswUsedOsAlarmRef = Os/Rte_Al_TE2_BswTask_0_10ms
      NvM: RteBswImplementationRef=NvM_Impl, RteBswModuleConfigurationRef=NvM
        NVM_EXCLUSIVE_AREA_0 (RteBswExclusiveAreaImpl): RteExclusiveAreaImplMechanism=ALL_INTERRUPT_BLOCKING, RteBswExclusiveAreaRef=NVM_EXCLUSIVE_AREA_0
        NvM_MainFunctionTimingEvent0_0 (RteBswEventToTaskMapping):
          RteBswImmediateRestart = false
          RteBswPositionInTask = 9
          RteBswEventRef = NvM_MainFunctionTimingEvent0
          RteBswMappedToTaskRef = Os/BswTask
          RteBswUsedOsEventRef = Os/Rte_Ev_Cyclic2_BswTask_0_10ms
          RteBswUsedOsAlarmRef = Os/Rte_Al_TE2_BswTask_0_10ms
    NvM_EcuSwComposition (RteSwComponentInstance): RteSoftwareComponentInstanceRef=NvM
      Timer_NvM_MainFunction (RteEventToTaskMapping):
        RteImmediateRestart = false
        RtePositionInTask = 9
        RteEventRef = Timer_NvM_MainFunction
        RteMappedToTaskRef = Os/BswTask
        RteUsedOsAlarmRef = Os/Rte_Al_TE2_BswTask_0_10ms
        RteUsedOsEventRef = Os/Rte_Ev_Cyclic2_BswTask_0_10ms
    LightCtrl (RteSwComponentType): RteComponentTypeRef=LightCtrl
      ComponentTypeCalibration (RteComponentTypeCalibration): RteCalibrationSupportEnabled=false
    RteInitializationBehavior: RteInitializationStrategy=RTE_INITIALIZATION_STRATEGY_AT_DATA_DECLARATION, RteSectionInitializationPolicy=, RteSectionInitializationPolicy=INIT
    RteOsInteraction
      5 x RteUsedOsActivation, all with RteExpectedActivationOffset=0, RteExpectedTickDuration=0:
        Rte_Al_TE2_BswTask_0_10ms: RteActivationOsAlarmRef=Os/Rte_Al_TE2_BswTask_0_10ms, RteActivationOsTaskRef=Os/BswTask
        Rte_Al_TE2_BswTask_0_20ms: RteActivationOsAlarmRef=Os/Rte_Al_TE2_BswTask_0_20ms, RteActivationOsTaskRef=Os/BswTask
        Rte_Al_TE_Fee_Fee_MainFunction: RteActivationOsAlarmRef=Os/Rte_Al_TE_Fee_Fee_MainFunction, RteActivationOsTaskRef=Os/BswTask
        Rte_Al_TE_IoHwAb_IoHwAb_IoHwAb_IoHwAbHandler: RteActivationOsAlarmRef=Os/Rte_Al_TE_IoHwAb_IoHwAb_IoHwAb_IoHwAbHandler, RteActivationOsTaskRef=Os/IoTask
        Rte_Al_TE_SwcTask_0_10ms: RteActivationOsAlarmRef=Os/Rte_Al_TE_SwcTask_0_10ms, RteActivationOsTaskRef=Os/SwcTask
    IoHwAb_001 (RteSwComponentType): RteComponentTypeRef=IoHwAb, RteImplementationRef=IoHwAbImplementation
      ComponentTypeCalibration (RteComponentTypeCalibration): RteCalibrationSupportEnabled=false
    LightCtrl_EcuSwComposition_001 (RteSwComponentInstance): RteSoftwareComponentInstanceRef=LightCtrl
      TMT_LightCtrl (RteEventToTaskMapping):
        RteImmediateRestart = false
        RtePositionInTask = 1
        RteEventRef = TMT_LightCtrl
        RteMappedToTaskRef = Os/SwcTask
        RteUsedOsEventRef = Os/Rte_Ev_Cyclic_SwcTask_0_10ms
        RteUsedOsAlarmRef = Os/Rte_Al_TE_SwcTask_0_10ms
    IoHwAb_EcuSwComposition (RteSwComponentInstance): RteSoftwareComponentInstanceRef=IoHwAb
      3 x RteEventToTaskMapping, all with RteImmediateRestart=false:
        Timer_IoHwAb_IoHwAb_IoHwAbHandler: RtePositionInTask=0, RteEventRef=Timer_IoHwAb_IoHwAb_IoHwAbHandler, RteMappedToTaskRef=Os/IoTask, RteUsedOsAlarmRef=Os/Rte_Al_TE_IoHwAb_IoHwAb_IoHwAb_IoHwAbHandler, RteUsedOsEventRef=Os/Rte_Ev_Run_IoHwAb_IoHwAb_IoHwAb_IoHwAbHandler
        OIT_IoHwAb_LightIntensityPort_LightIntensity_LightIntensityPort_LightIntensity: RteEventRef=OIT_IoHwAb_LightIntensityPort_LightIntensity_LightIntensityPort_LightIntensity
        IoHwAb_InitEvent: RtePositionInTask=1, RteEventRef=IoHwAb_InitEvent, RteMappedToTaskRef=Os/IoTask
    BSW_Handler (RteSwComponentType): RteComponentTypeRef=BSW_Handler, RteImplementationRef=BSW_Handler_Implementation
      ComponentTypeCalibration (RteComponentTypeCalibration): RteCalibrationSupportEnabled=false
    3 x RteSwComponentInstance:
      BSW_Handler_EcuSwComposition: RteSoftwareComponentInstanceRef=BSW_Handler
        TMT_LightCtrl (RteEventToTaskMapping):
          RteImmediateRestart = false
          RtePositionInTask = 2
          RteEventRef = TMT_LightCtrl
          RteMappedToTaskRef = Os/SwcTask
          RteUsedOsEventRef = Os/Rte_Ev_Cyclic_SwcTask_0_10ms
          RteUsedOsAlarmRef = Os/Rte_Al_TE_SwcTask_0_10ms
        BSW_Handler_InitEvent (RteEventToTaskMapping): RteImmediateRestart=false, RtePositionInTask=0, RteEventRef=BSW_Handler_InitEvent, RteMappedToTaskRef=Os/SwcTask
      DemMaster_0_EcuSwComposition: RteSoftwareComponentInstanceRef=DemMaster_0
        42 x RteEventToTaskMapping, all with RteImmediateRestart=false:
          Timer_Dem_MasterMainFunction: RtePositionInTask=17, RteEventRef=Timer_Dem_MasterMainFunction, RteMappedToTaskRef=Os/BswTask, RteUsedOsEventRef=Os/Rte_Ev_Cyclic2_BswTask_0_10ms, RteUsedOsAlarmRef=Os/Rte_Al_TE2_BswTask_0_10ms
          OpEventPostRunRequested_GetPostRunRequested_DemServices: RteEventRef=OpEventPostRunRequested_GetPostRunRequested_DemServices
          OpEventGetDTCStatusAvailabilityMask_GetDTCStatusAvailabilityMask_DemServices: RteEventRef=OpEventGetDTCStatusAvailabilityMask_GetDTCStatusAvailabilityMask_DemServices
          OpEventGetOperationCycleState_GetOperationCycleState_OpCycle_DemOperationCycle: RteEventRef=OpEventGetOperationCycleState_GetOperationCycleState_OpCycle_DemOperationCycle
          OpEventSetOperationCycleState_SetOperationCycleState_OpCycle_DemOperationCycle: RteEventRef=OpEventSetOperationCycleState_SetOperationCycleState_OpCycle_DemOperationCycle
          OpEventClearDTC_ClearDTC_ClearDTC_DemClient_CDD: RteEventRef=OpEventClearDTC_ClearDTC_ClearDTC_DemClient_CDD
          OpEventGetEventMemoryOverflow_GetEventMemoryOverflow_OverflowIndPrimaryMemory_DemClient_CDD: RteEventRef=OpEventGetEventMemoryOverflow_GetEventMemoryOverflow_OverflowIndPrimaryMemory_DemClient_CDD
          OpEventGetEventMemoryOverflow_GetEventMemoryOverflow_OverflowIndPrimaryMemory_DemClient_DCM: RteEventRef=OpEventGetEventMemoryOverflow_GetEventMemoryOverflow_OverflowIndPrimaryMemory_DemClient_DCM
          OpEventClearDTC_ClearDTC_ClearDTC_DemClient_DCM: RteEventRef=OpEventClearDTC_ClearDTC_ClearDTC_DemClient_DCM
          OpEventSelectDTC_SelectDTC_ClearDTC_DemClient_CDD: RteEventRef=OpEventSelectDTC_SelectDTC_ClearDTC_DemClient_CDD
          OpEventGetNumberOfEventMemoryEntries_GetNumberOfEventMemoryEntries_OverflowIndPrimaryMemory_DemClient_CDD: RteEventRef=OpEventGetNumberOfEventMemoryEntries_GetNumberOfEventMemoryEntries_OverflowIndPrimaryMemory_DemClient_CDD
          OpEventSelectDTC_SelectDTC_ClearDTC_DemClient_DCM: RteEventRef=OpEventSelectDTC_SelectDTC_ClearDTC_DemClient_DCM
          OpEventGetNumberOfEventMemoryEntries_GetNumberOfEventMemoryEntries_OverflowIndPrimaryMemory_DemClient_DCM: RteEventRef=OpEventGetNumberOfEventMemoryEntries_GetNumberOfEventMemoryEntries_OverflowIndPrimaryMemory_DemClient_DCM
          OpEventSetEventAvailable_SetEventAvailable_ControlEventAvailable_ADC_E_TIMEOUT: RteEventRef=OpEventSetEventAvailable_SetEventAvailable_ControlEventAvailable_ADC_E_TIMEOUT
          OpEventSetEventAvailable_SetEventAvailable_ControlEventAvailable_CAN_E_TIMEOUT: RteEventRef=OpEventSetEventAvailable_SetEventAvailable_ControlEventAvailable_CAN_E_TIMEOUT
          OpEventSetEventAvailable_SetEventAvailable_ControlEventAvailable_NVM_REQ_FAILED: RteEventRef=OpEventSetEventAvailable_SetEventAvailable_ControlEventAvailable_NVM_REQ_FAILED
          OpEventGetEventAvailable_GetEventAvailable_ControlEventAvailable_NVM_LOSS_OF_REDUNDANCY: RteEventRef=OpEventGetEventAvailable_GetEventAvailable_ControlEventAvailable_NVM_LOSS_OF_REDUNDANCY
          OpEventGetEventAvailable_GetEventAvailable_ControlEventAvailable_NVM_WRITE_PROTECTED: RteEventRef=OpEventGetEventAvailable_GetEventAvailable_ControlEventAvailable_NVM_WRITE_PROTECTED
          OpEventGetEventAvailable_GetEventAvailable_ControlEventAvailable_ADC_E_TIMEOUT: RteEventRef=OpEventGetEventAvailable_GetEventAvailable_ControlEventAvailable_ADC_E_TIMEOUT
          OpEventGetEventAvailable_GetEventAvailable_ControlEventAvailable_NVM_VERIFY_FAILED: RteEventRef=OpEventGetEventAvailable_GetEventAvailable_ControlEventAvailable_NVM_VERIFY_FAILED
          OpEventSetEventAvailable_SetEventAvailable_ControlEventAvailable_NVM_LOSS_OF_REDUNDANCY: RteEventRef=OpEventSetEventAvailable_SetEventAvailable_ControlEventAvailable_NVM_LOSS_OF_REDUNDANCY
          OpEventSetEventAvailable_SetEventAvailable_ControlEventAvailable_NVM_QUEUE_OVERFLOW: RteEventRef=OpEventSetEventAvailable_SetEventAvailable_ControlEventAvailable_NVM_QUEUE_OVERFLOW
          OpEventSetEventAvailable_SetEventAvailable_ControlEventAvailable_NVM_VERIFY_FAILED: RteEventRef=OpEventSetEventAvailable_SetEventAvailable_ControlEventAvailable_NVM_VERIFY_FAILED
          OpEventGetEventAvailable_GetEventAvailable_ControlEventAvailable_CAN_E_TIMEOUT: RteEventRef=OpEventGetEventAvailable_GetEventAvailable_ControlEventAvailable_CAN_E_TIMEOUT
          OpEventGetEventAvailable_GetEventAvailable_ControlEventAvailable_NVM_QUEUE_OVERFLOW: RteEventRef=OpEventGetEventAvailable_GetEventAvailable_ControlEventAvailable_NVM_QUEUE_OVERFLOW
          OpEventGetEventAvailable_GetEventAvailable_ControlEventAvailable_NVM_WRONG_BLOCK_ID: RteEventRef=OpEventGetEventAvailable_GetEventAvailable_ControlEventAvailable_NVM_WRONG_BLOCK_ID
          OpEventGetEventAvailable_GetEventAvailable_ControlEventAvailable_NVM_INTEGRITY_FAILED: RteEventRef=OpEventGetEventAvailable_GetEventAvailable_ControlEventAvailable_NVM_INTEGRITY_FAILED
          OpEventSetEventAvailable_SetEventAvailable_ControlEventAvailable_NVM_WRITE_PROTECTED: RteEventRef=OpEventSetEventAvailable_SetEventAvailable_ControlEventAvailable_NVM_WRITE_PROTECTED
          OpEventSetEventAvailable_SetEventAvailable_ControlEventAvailable_NVM_WRONG_BLOCK_ID: RteEventRef=OpEventSetEventAvailable_SetEventAvailable_ControlEventAvailable_NVM_WRONG_BLOCK_ID
          OpEventGetEventAvailable_GetEventAvailable_ControlEventAvailable_NVM_REQ_FAILED: RteEventRef=OpEventGetEventAvailable_GetEventAvailable_ControlEventAvailable_NVM_REQ_FAILED
          OpEventSetEventAvailable_SetEventAvailable_ControlEventAvailable_NVM_INTEGRITY_FAILED: RteEventRef=OpEventSetEventAvailable_SetEventAvailable_ControlEventAvailable_NVM_INTEGRITY_FAILED
          OpEventGetFaultDetectionCounter_GetFaultDetectionCounter_GeneralEvtInfo: RteEventRef=OpEventGetFaultDetectionCounter_GetFaultDetectionCounter_GeneralEvtInfo
          OpEventGetDTCOfEvent_GetDTCOfEvent_GeneralEvtInfo: RteEventRef=OpEventGetDTCOfEvent_GetDTCOfEvent_GeneralEvtInfo
          OpEventGetEventFailed_GetEventFailed_GeneralEvtInfo: RteEventRef=OpEventGetEventFailed_GetEventFailed_GeneralEvtInfo
          OpEventGetEventExtendedDataRecordEx_GetEventExtendedDataRecordEx_GeneralEvtInfo: RteEventRef=OpEventGetEventExtendedDataRecordEx_GetEventExtendedDataRecordEx_GeneralEvtInfo
          OpEventGetMonitorStatus_GetMonitorStatus_GeneralEvtInfo: RteEventRef=OpEventGetMonitorStatus_GetMonitorStatus_GeneralEvtInfo
          OpEventGetEventStatus_GetEventStatus_GeneralEvtInfo: RteEventRef=OpEventGetEventStatus_GetEventStatus_GeneralEvtInfo
          OpEventGetEventEnableCondition_GetEventEnableCondition_GeneralEvtInfo: RteEventRef=OpEventGetEventEnableCondition_GetEventEnableCondition_GeneralEvtInfo
          OpEventGetEventTested_GetEventTested_GeneralEvtInfo: RteEventRef=OpEventGetEventTested_GetEventTested_GeneralEvtInfo
          OpEventGetEventFreezeFrameDataEx_GetEventFreezeFrameDataEx_GeneralEvtInfo: RteEventRef=OpEventGetEventFreezeFrameDataEx_GetEventFreezeFrameDataEx_GeneralEvtInfo
          OpEventGetEventUdsStatus_GetEventUdsStatus_GeneralEvtInfo: RteEventRef=OpEventGetEventUdsStatus_GetEventUdsStatus_GeneralEvtInfo
          OpEventGetDebouncingOfEvent_GetDebouncingOfEvent_GeneralEvtInfo: RteEventRef=OpEventGetDebouncingOfEvent_GetDebouncingOfEvent_GeneralEvtInfo
      DemSatellite_0_EcuSwComposition: RteSoftwareComponentInstanceRef=DemSatellite_0
        122 x RteEventToTaskMapping, all with RteImmediateRestart=false:
          Timer_Dem_SatelliteMainFunction: RtePositionInTask=16, RteEventRef=Timer_Dem_SatelliteMainFunction, RteMappedToTaskRef=Os/BswTask, RteUsedOsEventRef=Os/Rte_Ev_Cyclic2_BswTask_0_10ms, RteUsedOsAlarmRef=Os/Rte_Al_TE2_BswTask_0_10ms
          OpEventGetEventUdsStatus_GetEventUdsStatus_EvtInfo_CAN_E_TIMEOUT: RteEventRef=OpEventGetEventUdsStatus_GetEventUdsStatus_EvtInfo_CAN_E_TIMEOUT
          OpEventGetEventUdsStatus_GetEventUdsStatus_EvtInfo_NVM_REQ_FAILED: RteEventRef=OpEventGetEventUdsStatus_GetEventUdsStatus_EvtInfo_NVM_REQ_FAILED
          OpEventGetEventUdsStatus_GetEventUdsStatus_EvtInfo_NVM_INTEGRITY_FAILED: RteEventRef=OpEventGetEventUdsStatus_GetEventUdsStatus_EvtInfo_NVM_INTEGRITY_FAILED
          OpEventGetEventUdsStatus_GetEventUdsStatus_EvtInfo_NVM_LOSS_OF_REDUNDANCY: RteEventRef=OpEventGetEventUdsStatus_GetEventUdsStatus_EvtInfo_NVM_LOSS_OF_REDUNDANCY
          OpEventGetEventUdsStatus_GetEventUdsStatus_EvtInfo_NVM_QUEUE_OVERFLOW: RteEventRef=OpEventGetEventUdsStatus_GetEventUdsStatus_EvtInfo_NVM_QUEUE_OVERFLOW
          OpEventGetEventUdsStatus_GetEventUdsStatus_EvtInfo_NVM_WRITE_PROTECTED: RteEventRef=OpEventGetEventUdsStatus_GetEventUdsStatus_EvtInfo_NVM_WRITE_PROTECTED
          OpEventGetEventUdsStatus_GetEventUdsStatus_EvtInfo_NVM_VERIFY_FAILED: RteEventRef=OpEventGetEventUdsStatus_GetEventUdsStatus_EvtInfo_NVM_VERIFY_FAILED
          OpEventGetEventUdsStatus_GetEventUdsStatus_EvtInfo_NVM_WRONG_BLOCK_ID: RteEventRef=OpEventGetEventUdsStatus_GetEventUdsStatus_EvtInfo_NVM_WRONG_BLOCK_ID
          OpEventGetEventStatus_GetEventStatus_EvtInfo_CAN_E_TIMEOUT: RteEventRef=OpEventGetEventStatus_GetEventStatus_EvtInfo_CAN_E_TIMEOUT
          OpEventGetEventStatus_GetEventStatus_EvtInfo_NVM_REQ_FAILED: RteEventRef=OpEventGetEventStatus_GetEventStatus_EvtInfo_NVM_REQ_FAILED
          OpEventGetEventStatus_GetEventStatus_EvtInfo_NVM_INTEGRITY_FAILED: RteEventRef=OpEventGetEventStatus_GetEventStatus_EvtInfo_NVM_INTEGRITY_FAILED
          OpEventGetEventStatus_GetEventStatus_EvtInfo_NVM_LOSS_OF_REDUNDANCY: RteEventRef=OpEventGetEventStatus_GetEventStatus_EvtInfo_NVM_LOSS_OF_REDUNDANCY
          OpEventGetEventStatus_GetEventStatus_EvtInfo_NVM_QUEUE_OVERFLOW: RteEventRef=OpEventGetEventStatus_GetEventStatus_EvtInfo_NVM_QUEUE_OVERFLOW
          OpEventGetEventStatus_GetEventStatus_EvtInfo_NVM_WRITE_PROTECTED: RteEventRef=OpEventGetEventStatus_GetEventStatus_EvtInfo_NVM_WRITE_PROTECTED
          OpEventGetEventStatus_GetEventStatus_EvtInfo_NVM_VERIFY_FAILED: RteEventRef=OpEventGetEventStatus_GetEventStatus_EvtInfo_NVM_VERIFY_FAILED
          OpEventGetEventStatus_GetEventStatus_EvtInfo_NVM_WRONG_BLOCK_ID: RteEventRef=OpEventGetEventStatus_GetEventStatus_EvtInfo_NVM_WRONG_BLOCK_ID
          OpEventGetEventFailed_GetEventFailed_EvtInfo_CAN_E_TIMEOUT: RteEventRef=OpEventGetEventFailed_GetEventFailed_EvtInfo_CAN_E_TIMEOUT
          OpEventGetEventFailed_GetEventFailed_EvtInfo_NVM_REQ_FAILED: RteEventRef=OpEventGetEventFailed_GetEventFailed_EvtInfo_NVM_REQ_FAILED
          OpEventGetEventFailed_GetEventFailed_EvtInfo_NVM_INTEGRITY_FAILED: RteEventRef=OpEventGetEventFailed_GetEventFailed_EvtInfo_NVM_INTEGRITY_FAILED
          OpEventGetEventFailed_GetEventFailed_EvtInfo_NVM_LOSS_OF_REDUNDANCY: RteEventRef=OpEventGetEventFailed_GetEventFailed_EvtInfo_NVM_LOSS_OF_REDUNDANCY
          OpEventGetEventFailed_GetEventFailed_EvtInfo_NVM_QUEUE_OVERFLOW: RteEventRef=OpEventGetEventFailed_GetEventFailed_EvtInfo_NVM_QUEUE_OVERFLOW
          OpEventGetEventFailed_GetEventFailed_EvtInfo_NVM_WRITE_PROTECTED: RteEventRef=OpEventGetEventFailed_GetEventFailed_EvtInfo_NVM_WRITE_PROTECTED
          OpEventGetEventFailed_GetEventFailed_EvtInfo_NVM_VERIFY_FAILED: RteEventRef=OpEventGetEventFailed_GetEventFailed_EvtInfo_NVM_VERIFY_FAILED
          OpEventGetEventFailed_GetEventFailed_EvtInfo_NVM_WRONG_BLOCK_ID: RteEventRef=OpEventGetEventFailed_GetEventFailed_EvtInfo_NVM_WRONG_BLOCK_ID
          OpEventGetEventTested_GetEventTested_EvtInfo_CAN_E_TIMEOUT: RteEventRef=OpEventGetEventTested_GetEventTested_EvtInfo_CAN_E_TIMEOUT
          OpEventGetEventTested_GetEventTested_EvtInfo_NVM_REQ_FAILED: RteEventRef=OpEventGetEventTested_GetEventTested_EvtInfo_NVM_REQ_FAILED
          OpEventGetEventTested_GetEventTested_EvtInfo_NVM_INTEGRITY_FAILED: RteEventRef=OpEventGetEventTested_GetEventTested_EvtInfo_NVM_INTEGRITY_FAILED
          OpEventGetEventTested_GetEventTested_EvtInfo_NVM_LOSS_OF_REDUNDANCY: RteEventRef=OpEventGetEventTested_GetEventTested_EvtInfo_NVM_LOSS_OF_REDUNDANCY
          OpEventGetEventTested_GetEventTested_EvtInfo_NVM_QUEUE_OVERFLOW: RteEventRef=OpEventGetEventTested_GetEventTested_EvtInfo_NVM_QUEUE_OVERFLOW
          OpEventGetEventTested_GetEventTested_EvtInfo_NVM_WRITE_PROTECTED: RteEventRef=OpEventGetEventTested_GetEventTested_EvtInfo_NVM_WRITE_PROTECTED
          OpEventGetEventTested_GetEventTested_EvtInfo_NVM_VERIFY_FAILED: RteEventRef=OpEventGetEventTested_GetEventTested_EvtInfo_NVM_VERIFY_FAILED
          OpEventGetEventTested_GetEventTested_EvtInfo_NVM_WRONG_BLOCK_ID: RteEventRef=OpEventGetEventTested_GetEventTested_EvtInfo_NVM_WRONG_BLOCK_ID
          OpEventGetDTCOfEvent_GetDTCOfEvent_EvtInfo_CAN_E_TIMEOUT: RteEventRef=OpEventGetDTCOfEvent_GetDTCOfEvent_EvtInfo_CAN_E_TIMEOUT
          OpEventGetDTCOfEvent_GetDTCOfEvent_EvtInfo_NVM_REQ_FAILED: RteEventRef=OpEventGetDTCOfEvent_GetDTCOfEvent_EvtInfo_NVM_REQ_FAILED
          OpEventGetDTCOfEvent_GetDTCOfEvent_EvtInfo_NVM_INTEGRITY_FAILED: RteEventRef=OpEventGetDTCOfEvent_GetDTCOfEvent_EvtInfo_NVM_INTEGRITY_FAILED
          OpEventGetDTCOfEvent_GetDTCOfEvent_EvtInfo_NVM_LOSS_OF_REDUNDANCY: RteEventRef=OpEventGetDTCOfEvent_GetDTCOfEvent_EvtInfo_NVM_LOSS_OF_REDUNDANCY
          OpEventGetDTCOfEvent_GetDTCOfEvent_EvtInfo_NVM_QUEUE_OVERFLOW: RteEventRef=OpEventGetDTCOfEvent_GetDTCOfEvent_EvtInfo_NVM_QUEUE_OVERFLOW
          OpEventGetDTCOfEvent_GetDTCOfEvent_EvtInfo_NVM_WRITE_PROTECTED: RteEventRef=OpEventGetDTCOfEvent_GetDTCOfEvent_EvtInfo_NVM_WRITE_PROTECTED
          OpEventGetDTCOfEvent_GetDTCOfEvent_EvtInfo_NVM_VERIFY_FAILED: RteEventRef=OpEventGetDTCOfEvent_GetDTCOfEvent_EvtInfo_NVM_VERIFY_FAILED
          OpEventGetDTCOfEvent_GetDTCOfEvent_EvtInfo_NVM_WRONG_BLOCK_ID: RteEventRef=OpEventGetDTCOfEvent_GetDTCOfEvent_EvtInfo_NVM_WRONG_BLOCK_ID
          OpEventGetFaultDetectionCounter_GetFaultDetectionCounter_EvtInfo_CAN_E_TIMEOUT: RteEventRef=OpEventGetFaultDetectionCounter_GetFaultDetectionCounter_EvtInfo_CAN_E_TIMEOUT
          OpEventGetFaultDetectionCounter_GetFaultDetectionCounter_EvtInfo_NVM_REQ_FAILED: RteEventRef=OpEventGetFaultDetectionCounter_GetFaultDetectionCounter_EvtInfo_NVM_REQ_FAILED
          OpEventGetFaultDetectionCounter_GetFaultDetectionCounter_EvtInfo_NVM_INTEGRITY_FAILED: RteEventRef=OpEventGetFaultDetectionCounter_GetFaultDetectionCounter_EvtInfo_NVM_INTEGRITY_FAILED
          OpEventGetFaultDetectionCounter_GetFaultDetectionCounter_EvtInfo_NVM_LOSS_OF_REDUNDANCY: RteEventRef=OpEventGetFaultDetectionCounter_GetFaultDetectionCounter_EvtInfo_NVM_LOSS_OF_REDUNDANCY
          OpEventGetFaultDetectionCounter_GetFaultDetectionCounter_EvtInfo_NVM_QUEUE_OVERFLOW: RteEventRef=OpEventGetFaultDetectionCounter_GetFaultDetectionCounter_EvtInfo_NVM_QUEUE_OVERFLOW
          OpEventGetFaultDetectionCounter_GetFaultDetectionCounter_EvtInfo_NVM_WRITE_PROTECTED: RteEventRef=OpEventGetFaultDetectionCounter_GetFaultDetectionCounter_EvtInfo_NVM_WRITE_PROTECTED
          OpEventGetFaultDetectionCounter_GetFaultDetectionCounter_EvtInfo_NVM_VERIFY_FAILED: RteEventRef=OpEventGetFaultDetectionCounter_GetFaultDetectionCounter_EvtInfo_NVM_VERIFY_FAILED
          OpEventGetFaultDetectionCounter_GetFaultDetectionCounter_EvtInfo_NVM_WRONG_BLOCK_ID: RteEventRef=OpEventGetFaultDetectionCounter_GetFaultDetectionCounter_EvtInfo_NVM_WRONG_BLOCK_ID
          OpEventGetEventFreezeFrameDataEx_GetEventFreezeFrameDataEx_EvtInfo_CAN_E_TIMEOUT: RteEventRef=OpEventGetEventFreezeFrameDataEx_GetEventFreezeFrameDataEx_EvtInfo_CAN_E_TIMEOUT
          OpEventGetEventFreezeFrameDataEx_GetEventFreezeFrameDataEx_EvtInfo_NVM_REQ_FAILED: RteEventRef=OpEventGetEventFreezeFrameDataEx_GetEventFreezeFrameDataEx_EvtInfo_NVM_REQ_FAILED
          OpEventGetEventFreezeFrameDataEx_GetEventFreezeFrameDataEx_EvtInfo_NVM_INTEGRITY_FAILED: RteEventRef=OpEventGetEventFreezeFrameDataEx_GetEventFreezeFrameDataEx_EvtInfo_NVM_INTEGRITY_FAILED
          OpEventGetEventFreezeFrameDataEx_GetEventFreezeFrameDataEx_EvtInfo_NVM_LOSS_OF_REDUNDANCY: RteEventRef=OpEventGetEventFreezeFrameDataEx_GetEventFreezeFrameDataEx_EvtInfo_NVM_LOSS_OF_REDUNDANCY
          OpEventGetEventFreezeFrameDataEx_GetEventFreezeFrameDataEx_EvtInfo_NVM_QUEUE_OVERFLOW: RteEventRef=OpEventGetEventFreezeFrameDataEx_GetEventFreezeFrameDataEx_EvtInfo_NVM_QUEUE_OVERFLOW
          OpEventGetEventFreezeFrameDataEx_GetEventFreezeFrameDataEx_EvtInfo_NVM_WRITE_PROTECTED: RteEventRef=OpEventGetEventFreezeFrameDataEx_GetEventFreezeFrameDataEx_EvtInfo_NVM_WRITE_PROTECTED
          OpEventGetEventFreezeFrameDataEx_GetEventFreezeFrameDataEx_EvtInfo_NVM_VERIFY_FAILED: RteEventRef=OpEventGetEventFreezeFrameDataEx_GetEventFreezeFrameDataEx_EvtInfo_NVM_VERIFY_FAILED
          OpEventGetEventFreezeFrameDataEx_GetEventFreezeFrameDataEx_EvtInfo_NVM_WRONG_BLOCK_ID: RteEventRef=OpEventGetEventFreezeFrameDataEx_GetEventFreezeFrameDataEx_EvtInfo_NVM_WRONG_BLOCK_ID
          OpEventGetEventExtendedDataRecordEx_GetEventExtendedDataRecordEx_EvtInfo_CAN_E_TIMEOUT: RteEventRef=OpEventGetEventExtendedDataRecordEx_GetEventExtendedDataRecordEx_EvtInfo_CAN_E_TIMEOUT
          OpEventGetEventExtendedDataRecordEx_GetEventExtendedDataRecordEx_EvtInfo_NVM_REQ_FAILED: RteEventRef=OpEventGetEventExtendedDataRecordEx_GetEventExtendedDataRecordEx_EvtInfo_NVM_REQ_FAILED
          OpEventGetEventExtendedDataRecordEx_GetEventExtendedDataRecordEx_EvtInfo_NVM_INTEGRITY_FAILED: RteEventRef=OpEventGetEventExtendedDataRecordEx_GetEventExtendedDataRecordEx_EvtInfo_NVM_INTEGRITY_FAILED
          OpEventGetEventExtendedDataRecordEx_GetEventExtendedDataRecordEx_EvtInfo_NVM_LOSS_OF_REDUNDANCY: RteEventRef=OpEventGetEventExtendedDataRecordEx_GetEventExtendedDataRecordEx_EvtInfo_NVM_LOSS_OF_REDUNDANCY
          OpEventGetEventExtendedDataRecordEx_GetEventExtendedDataRecordEx_EvtInfo_NVM_QUEUE_OVERFLOW: RteEventRef=OpEventGetEventExtendedDataRecordEx_GetEventExtendedDataRecordEx_EvtInfo_NVM_QUEUE_OVERFLOW
          OpEventGetEventExtendedDataRecordEx_GetEventExtendedDataRecordEx_EvtInfo_NVM_WRITE_PROTECTED: RteEventRef=OpEventGetEventExtendedDataRecordEx_GetEventExtendedDataRecordEx_EvtInfo_NVM_WRITE_PROTECTED
          OpEventGetEventExtendedDataRecordEx_GetEventExtendedDataRecordEx_EvtInfo_NVM_VERIFY_FAILED: RteEventRef=OpEventGetEventExtendedDataRecordEx_GetEventExtendedDataRecordEx_EvtInfo_NVM_VERIFY_FAILED
          OpEventGetEventExtendedDataRecordEx_GetEventExtendedDataRecordEx_EvtInfo_NVM_WRONG_BLOCK_ID: RteEventRef=OpEventGetEventExtendedDataRecordEx_GetEventExtendedDataRecordEx_EvtInfo_NVM_WRONG_BLOCK_ID
          OpEventGetEventEnableCondition_GetEventEnableCondition_EvtInfo_CAN_E_TIMEOUT: RteEventRef=OpEventGetEventEnableCondition_GetEventEnableCondition_EvtInfo_CAN_E_TIMEOUT
          OpEventGetEventEnableCondition_GetEventEnableCondition_EvtInfo_NVM_REQ_FAILED: RteEventRef=OpEventGetEventEnableCondition_GetEventEnableCondition_EvtInfo_NVM_REQ_FAILED
          OpEventGetEventEnableCondition_GetEventEnableCondition_EvtInfo_NVM_INTEGRITY_FAILED: RteEventRef=OpEventGetEventEnableCondition_GetEventEnableCondition_EvtInfo_NVM_INTEGRITY_FAILED
          OpEventGetEventEnableCondition_GetEventEnableCondition_EvtInfo_NVM_LOSS_OF_REDUNDANCY: RteEventRef=OpEventGetEventEnableCondition_GetEventEnableCondition_EvtInfo_NVM_LOSS_OF_REDUNDANCY
          OpEventGetEventEnableCondition_GetEventEnableCondition_EvtInfo_NVM_QUEUE_OVERFLOW: RteEventRef=OpEventGetEventEnableCondition_GetEventEnableCondition_EvtInfo_NVM_QUEUE_OVERFLOW
          OpEventGetEventEnableCondition_GetEventEnableCondition_EvtInfo_NVM_WRITE_PROTECTED: RteEventRef=OpEventGetEventEnableCondition_GetEventEnableCondition_EvtInfo_NVM_WRITE_PROTECTED
          OpEventGetEventEnableCondition_GetEventEnableCondition_EvtInfo_NVM_VERIFY_FAILED: RteEventRef=OpEventGetEventEnableCondition_GetEventEnableCondition_EvtInfo_NVM_VERIFY_FAILED
          OpEventGetEventEnableCondition_GetEventEnableCondition_EvtInfo_NVM_WRONG_BLOCK_ID: RteEventRef=OpEventGetEventEnableCondition_GetEventEnableCondition_EvtInfo_NVM_WRONG_BLOCK_ID
          OpEventGetDebouncingOfEvent_GetDebouncingOfEvent_EvtInfo_CAN_E_TIMEOUT: RteEventRef=OpEventGetDebouncingOfEvent_GetDebouncingOfEvent_EvtInfo_CAN_E_TIMEOUT
          OpEventGetDebouncingOfEvent_GetDebouncingOfEvent_EvtInfo_NVM_REQ_FAILED: RteEventRef=OpEventGetDebouncingOfEvent_GetDebouncingOfEvent_EvtInfo_NVM_REQ_FAILED
          OpEventGetDebouncingOfEvent_GetDebouncingOfEvent_EvtInfo_NVM_INTEGRITY_FAILED: RteEventRef=OpEventGetDebouncingOfEvent_GetDebouncingOfEvent_EvtInfo_NVM_INTEGRITY_FAILED
          OpEventGetDebouncingOfEvent_GetDebouncingOfEvent_EvtInfo_NVM_LOSS_OF_REDUNDANCY: RteEventRef=OpEventGetDebouncingOfEvent_GetDebouncingOfEvent_EvtInfo_NVM_LOSS_OF_REDUNDANCY
          OpEventGetDebouncingOfEvent_GetDebouncingOfEvent_EvtInfo_NVM_QUEUE_OVERFLOW: RteEventRef=OpEventGetDebouncingOfEvent_GetDebouncingOfEvent_EvtInfo_NVM_QUEUE_OVERFLOW
          OpEventGetDebouncingOfEvent_GetDebouncingOfEvent_EvtInfo_NVM_WRITE_PROTECTED: RteEventRef=OpEventGetDebouncingOfEvent_GetDebouncingOfEvent_EvtInfo_NVM_WRITE_PROTECTED
          OpEventGetDebouncingOfEvent_GetDebouncingOfEvent_EvtInfo_NVM_VERIFY_FAILED: RteEventRef=OpEventGetDebouncingOfEvent_GetDebouncingOfEvent_EvtInfo_NVM_VERIFY_FAILED
          OpEventGetDebouncingOfEvent_GetDebouncingOfEvent_EvtInfo_NVM_WRONG_BLOCK_ID: RteEventRef=OpEventGetDebouncingOfEvent_GetDebouncingOfEvent_EvtInfo_NVM_WRONG_BLOCK_ID
          OpEventGetEventFailed_GetEventFailed_EvtInfo_ADC_E_TIMEOUT: RteEventRef=OpEventGetEventFailed_GetEventFailed_EvtInfo_ADC_E_TIMEOUT
          OpEventGetEventFreezeFrameDataEx_GetEventFreezeFrameDataEx_Event_ADC_E_TIMEOUT: RteEventRef=OpEventGetEventFreezeFrameDataEx_GetEventFreezeFrameDataEx_Event_ADC_E_TIMEOUT
          OpEventGetEventTested_GetEventTested_EvtInfo_ADC_E_TIMEOUT: RteEventRef=OpEventGetEventTested_GetEventTested_EvtInfo_ADC_E_TIMEOUT
          OpEventGetEventEnableCondition_GetEventEnableCondition_EvtInfo_ADC_E_TIMEOUT: RteEventRef=OpEventGetEventEnableCondition_GetEventEnableCondition_EvtInfo_ADC_E_TIMEOUT
          OpEventGetEventStatus_GetEventStatus_Event_ADC_E_TIMEOUT: RteEventRef=OpEventGetEventStatus_GetEventStatus_Event_ADC_E_TIMEOUT
          OpEventGetEventStatus_GetEventStatus_EvtInfo_ADC_E_TIMEOUT: RteEventRef=OpEventGetEventStatus_GetEventStatus_EvtInfo_ADC_E_TIMEOUT
          OpEventGetEventUdsStatus_GetEventUdsStatus_Event_ADC_E_TIMEOUT: RteEventRef=OpEventGetEventUdsStatus_GetEventUdsStatus_Event_ADC_E_TIMEOUT
          OpEventGetDTCOfEvent_GetDTCOfEvent_Event_ADC_E_TIMEOUT: RteEventRef=OpEventGetDTCOfEvent_GetDTCOfEvent_Event_ADC_E_TIMEOUT
          OpEventSetEventStatus_SetEventStatus_Event_ADC_E_TIMEOUT: RteEventRef=OpEventSetEventStatus_SetEventStatus_Event_ADC_E_TIMEOUT
          OpEventGetDebouncingOfEvent_GetDebouncingOfEvent_EvtInfo_ADC_E_TIMEOUT: RteEventRef=OpEventGetDebouncingOfEvent_GetDebouncingOfEvent_EvtInfo_ADC_E_TIMEOUT
          OpEventGetEventFreezeFrameDataEx_GetEventFreezeFrameDataEx_EvtInfo_ADC_E_TIMEOUT: RteEventRef=OpEventGetEventFreezeFrameDataEx_GetEventFreezeFrameDataEx_EvtInfo_ADC_E_TIMEOUT
          OpEventGetFaultDetectionCounter_GetFaultDetectionCounter_Event_ADC_E_TIMEOUT: RteEventRef=OpEventGetFaultDetectionCounter_GetFaultDetectionCounter_Event_ADC_E_TIMEOUT
          OpEventGetEventUdsStatus_GetEventUdsStatus_EvtInfo_ADC_E_TIMEOUT: RteEventRef=OpEventGetEventUdsStatus_GetEventUdsStatus_EvtInfo_ADC_E_TIMEOUT
          OpEventGetEventTested_GetEventTested_Event_ADC_E_TIMEOUT: RteEventRef=OpEventGetEventTested_GetEventTested_Event_ADC_E_TIMEOUT
          OpEventResetEventDebounceStatus_ResetEventDebounceStatus_Event_ADC_E_TIMEOUT: RteEventRef=OpEventResetEventDebounceStatus_ResetEventDebounceStatus_Event_ADC_E_TIMEOUT
          OpEventGetDTCOfEvent_GetDTCOfEvent_EvtInfo_ADC_E_TIMEOUT: RteEventRef=OpEventGetDTCOfEvent_GetDTCOfEvent_EvtInfo_ADC_E_TIMEOUT
          OpEventGetFaultDetectionCounter_GetFaultDetectionCounter_EvtInfo_ADC_E_TIMEOUT: RteEventRef=OpEventGetFaultDetectionCounter_GetFaultDetectionCounter_EvtInfo_ADC_E_TIMEOUT
          OpEventGetEventExtendedDataRecordEx_GetEventExtendedDataRecordEx_Event_ADC_E_TIMEOUT: RteEventRef=OpEventGetEventExtendedDataRecordEx_GetEventExtendedDataRecordEx_Event_ADC_E_TIMEOUT
          OpEventGetEventFailed_GetEventFailed_Event_ADC_E_TIMEOUT: RteEventRef=OpEventGetEventFailed_GetEventFailed_Event_ADC_E_TIMEOUT
          OpEventGetEventExtendedDataRecordEx_GetEventExtendedDataRecordEx_EvtInfo_ADC_E_TIMEOUT: RteEventRef=OpEventGetEventExtendedDataRecordEx_GetEventExtendedDataRecordEx_EvtInfo_ADC_E_TIMEOUT
          OpEventResetEventStatus_ResetEventStatus_Event_ADC_E_TIMEOUT: RteEventRef=OpEventResetEventStatus_ResetEventStatus_Event_ADC_E_TIMEOUT
          OpEventGetMonitorStatus_GetMonitorStatus_EvtInfo_NVM_LOSS_OF_REDUNDANCY: RteEventRef=OpEventGetMonitorStatus_GetMonitorStatus_EvtInfo_NVM_LOSS_OF_REDUNDANCY
          OpEventGetMonitorStatus_GetMonitorStatus_EvtInfo_NVM_INTEGRITY_FAILED: RteEventRef=OpEventGetMonitorStatus_GetMonitorStatus_EvtInfo_NVM_INTEGRITY_FAILED
          OpEventGetMonitorStatus_GetMonitorStatus_EvtInfo_NVM_QUEUE_OVERFLOW: RteEventRef=OpEventGetMonitorStatus_GetMonitorStatus_EvtInfo_NVM_QUEUE_OVERFLOW
          OpEventGetMonitorStatus_GetMonitorStatus_EvtInfo_CAN_E_TIMEOUT: RteEventRef=OpEventGetMonitorStatus_GetMonitorStatus_EvtInfo_CAN_E_TIMEOUT
          OpEventGetMonitorStatus_GetMonitorStatus_EvtInfo_NVM_WRITE_PROTECTED: RteEventRef=OpEventGetMonitorStatus_GetMonitorStatus_EvtInfo_NVM_WRITE_PROTECTED
          OpEventGetMonitorStatus_GetMonitorStatus_EvtInfo_NVM_VERIFY_FAILED: RteEventRef=OpEventGetMonitorStatus_GetMonitorStatus_EvtInfo_NVM_VERIFY_FAILED
          OpEventGetMonitorStatus_GetMonitorStatus_EvtInfo_ADC_E_TIMEOUT: RteEventRef=OpEventGetMonitorStatus_GetMonitorStatus_EvtInfo_ADC_E_TIMEOUT
          OpEventGetMonitorStatus_GetMonitorStatus_EvtInfo_NVM_WRONG_BLOCK_ID: RteEventRef=OpEventGetMonitorStatus_GetMonitorStatus_EvtInfo_NVM_WRONG_BLOCK_ID
          OpEventGetMonitorStatus_GetMonitorStatus_EvtInfo_NVM_REQ_FAILED: RteEventRef=OpEventGetMonitorStatus_GetMonitorStatus_EvtInfo_NVM_REQ_FAILED
          OpEventGetEventStatus_GetEventStatus_GeneralEvtInfo: RteEventRef=OpEventGetEventStatus_GetEventStatus_GeneralEvtInfo
          OpEventGetEventTested_GetEventTested_GeneralEvtInfo: RteEventRef=OpEventGetEventTested_GetEventTested_GeneralEvtInfo
          OpEventGetDebouncingOfEvent_GetDebouncingOfEvent_GeneralEvtInfo: RteEventRef=OpEventGetDebouncingOfEvent_GetDebouncingOfEvent_GeneralEvtInfo
          OpEventGetDTCOfEvent_GetDTCOfEvent_GeneralEvtInfo: RteEventRef=OpEventGetDTCOfEvent_GetDTCOfEvent_GeneralEvtInfo
          OpEventGetEventEnableCondition_GetEventEnableCondition_GeneralEvtInfo: RteEventRef=OpEventGetEventEnableCondition_GetEventEnableCondition_GeneralEvtInfo
          OpEventGetEventUdsStatus_GetEventUdsStatus_GeneralEvtInfo: RteEventRef=OpEventGetEventUdsStatus_GetEventUdsStatus_GeneralEvtInfo
          OpEventGetEventExtendedDataRecordEx_GetEventExtendedDataRecordEx_GeneralEvtInfo: RteEventRef=OpEventGetEventExtendedDataRecordEx_GetEventExtendedDataRecordEx_GeneralEvtInfo
          OpEventGetMonitorStatus_GetMonitorStatus_GeneralEvtInfo: RteEventRef=OpEventGetMonitorStatus_GetMonitorStatus_GeneralEvtInfo
          OpEventGetEventFreezeFrameDataEx_GetEventFreezeFrameDataEx_GeneralEvtInfo: RteEventRef=OpEventGetEventFreezeFrameDataEx_GetEventFreezeFrameDataEx_GeneralEvtInfo
          OpEventGetEventFailed_GetEventFailed_GeneralEvtInfo: RteEventRef=OpEventGetEventFailed_GetEventFailed_GeneralEvtInfo
          OpEventGetFaultDetectionCounter_GetFaultDetectionCounter_GeneralEvtInfo: RteEventRef=OpEventGetFaultDetectionCounter_GetFaultDetectionCounter_GeneralEvtInfo
    Can_0 (RteBswModuleInstance): RteBswImplementationRef=Can_Impl, RteBswModuleConfigurationRef=Can
      3 x RteBswEventToTaskMapping, all with RteBswImmediateRestart=false, RteBswMappedToTaskRef=Os/BswTask, RteBswUsedOsEventRef=Os/Rte_Ev_Cyclic2_BswTask_0_10ms, RteBswUsedOsAlarmRef=Os/Rte_Al_TE2_BswTask_0_10ms:
        Can_MainFunction_BusOffTimingEvent0: RteBswPositionInTask=18, RteBswEventRef=Can_MainFunction_BusOffTimingEvent0
        Can_MainFunction_WakeupTimingEvent0: RteBswPositionInTask=20, RteBswEventRef=Can_MainFunction_WakeupTimingEvent0
        Can_MainFunction_ModeTimingEvent0: RteBswPositionInTask=19, RteBswEventRef=Can_MainFunction_ModeTimingEvent0
      8 x RteBswExclusiveAreaImpl, all with RteExclusiveAreaImplMechanism=ALL_INTERRUPT_BLOCKING:
        CAN_EXCLUSIVE_AREA_{0..7}: RteBswExclusiveAreaRef=CAN_EXCLUSIVE_AREA_{0..7}
  module config EcuM: implementation-config-variant=VARIANT-PRE-COMPILE, module-description=EcuM_Impl
    EcuMGeneral:
      EcuMDevErrorDetect = true
      EcuMIncludeDem = true
      EcuMIncludeDet = true
      EcuMMainFunctionPeriod = 0.01
      EcuMVersionInfoApi = false
      EcuMDeferredBswMNotification = false
      EcuMSlaveCoreHandling = true
      EcuMEnableFixBehavior = false
      EcuMNonChannelWakeupInRun = false
      EcuMSafeBswChecks = false
      EcuMSchMStartInitialization = true
      EcuMGeneration: EcuMOutOfBoundsWriteSanitizer=false, EcuMOutOfBoundsReadSanitizer=false, EcuMInterfacesForDeactivatedData=false
    EcuMFlexGeneral: EcuMAlarmClockPresent=false, EcuMResetLoopDetection=false, EcuMEnableDefBehaviour=false
    EcuMConfiguration
      EcuMFlexConfiguration: EcuMFlexModuleConfigurationRef=Can/CanConfigSet, EcuMNormalMcuModeRef=McuModuleConfiguration/NORMAL, EcuMFlexModuleConfigurationRef=DemConfigSet
        ECUM_RESET_WDG (EcuMResetMode): EcuMResetModeId=1
        ECUM_CAUSE_DCM (EcuMShutdownCause): EcuMShutdownCauseId=3
        ECUM_CAUSE_UNKNOWN (EcuMShutdownCause): EcuMShutdownCauseId=0
        ECUM_RESET_IO (EcuMResetMode): EcuMResetModeId=2
        ECUM_RESET_MCU (EcuMResetMode): EcuMResetModeId=0
        ECUM_CAUSE_WDGM (EcuMShutdownCause): EcuMShutdownCauseId=2
        ECUM_RESET_WAKEUP (EcuMResetMode): EcuMResetModeId=3
        ECUM_CAUSE_ECU_STATE (EcuMShutdownCause): EcuMShutdownCauseId=1
      EcuMCommonConfiguration: EcuMConfigConsistencyHash=15235935062125827326, EcuMDefaultAppMode=Os/OSDEFAULTAPPMODE, EcuMOSResource=Os/RES_SCHEDULER_OsCore
        EcuMDefaultShutdownTarget: EcuMDefaultState=EcuMStateOff, EcuMDefaultResetModeRef=ECUM_RESET_MCU
        3 x EcuMWakeupSource, all with EcuMWakeupSourcePolling=false:
          CAN00_f26020e5: EcuMWakeupSourceId=5, EcuMComMChannelRef=ComMConfigSet/CN_CAN00_a2373004  # CN_CAN00
          ECUM_WKSOURCE_POWER: EcuMWakeupSourceId=0, EcuMValidationTimeout=0, EcuMCheckWakeupTimeout=0
          ECUM_WKSOURCE_INTERNAL_RESET: EcuMWakeupSourceId=2, EcuMValidationTimeout=0, EcuMCheckWakeupTimeout=0
        EcuMDriverRestartList
        3 x EcuMWakeupSource, all with EcuMValidationTimeout=0, EcuMCheckWakeupTimeout=0, EcuMWakeupSourcePolling=false:
          ECUM_WKSOURCE_INTERNAL_WDG: EcuMWakeupSourceId=3
          ECUM_WKSOURCE_RESET: EcuMWakeupSourceId=1
          ECUM_WKSOURCE_EXTERNAL_WDG: EcuMWakeupSourceId=4
        EcuMSleepMode: EcuMSleepModeId=0, EcuMSleepModeMcuModeRef=McuModuleConfiguration/SLEEP, EcuMWakeupSourceMask=CAN00_f26020e5
        EcuMDriverInitListZero
          17 x EcuMDriverInitItem:
            BswM_InitMemory: EcuMModuleID=BswM, EcuMModuleService=BswM_InitMemory, EcuMModuleHeader=BswM.h
            Can_InitMemory: EcuMModuleID=Can, EcuMModuleService=Can_InitMemory, EcuMModuleHeader=Can.h
            CanIf_InitMemory: EcuMModuleID=CanIf, EcuMModuleService=CanIf_InitMemory, EcuMModuleHeader=CanIf.h
            CanNm_InitMemory: EcuMModuleID=CanNm, EcuMModuleService=CanNm_InitMemory, EcuMModuleHeader=CanNm.h
            CanSM_InitMemory: EcuMModuleID=CanSM, EcuMModuleService=CanSM_InitMemory, EcuMModuleHeader=CanSM_EcuM.h
            Com_InitMemory: EcuMModuleID=Com, EcuMModuleService=Com_InitMemory, EcuMModuleHeader=Com.h
            ComM_InitMemory: EcuMModuleID=ComM, EcuMModuleService=ComM_InitMemory, EcuMModuleHeader=ComM.h
            PduR_InitMemory: EcuMModuleID=PduR, EcuMModuleService=PduR_InitMemory, EcuMModuleHeader=PduR.h
            Adc_InitMemory: EcuMModuleID=Adc, EcuMModuleService=Adc_InitMemory, EcuMModuleHeader=Adc.h
            Rte_InitMemory: EcuMModuleID=Rte, EcuMModuleService=Rte_InitMemory, EcuMModuleHeader=Rte.h
            Fls_InitMemory: EcuMModuleID=Fls, EcuMModuleService=Fls_InitMemory, EcuMModuleHeader=Fls.h
            Mcu_InitMemory: EcuMModuleID=Mcu, EcuMModuleService=Mcu_InitMemory, EcuMModuleHeader=Mcu.h
            Nm_InitMemory: index=0, EcuMModuleID=Nm, EcuMModuleService=Nm_InitMemory, EcuMModuleHeader=Nm.h
            Det_InitMemory: index=1, EcuMModuleID=Det, EcuMModuleService=Det_InitMemory, EcuMModuleHeader=Det.h
            Dem_InitMemory: EcuMModuleID=Dem, EcuMModuleService=Dem_InitMemory, EcuMModuleHeader=Dem.h
            Det_Init: EcuMModuleID=Det, EcuMModuleService=Det_Init, EcuMModuleHeader=Det.h
            Dem_PreInit: EcuMModuleID=Dem, EcuMModuleService=Dem_PreInit, EcuMModuleHeader=Dem.h
        EcuMDriverInitListOne
  module config CanNm: implementation-config-variant=VARIANT-PRE-COMPILE, module-description=CanNm_Impl
    CanNmGlobalConfig:
      CanNmPnEiraCalcEnabled = false
      CanNmUserDataEnabled = true
      CanNmBusLoadReductionEnabled = false
      CanNmBusSynchronizationEnabled = false
      CanNmComUserDataSupport = false
      CanNmCoordinatorSyncSupport = false
      CanNmDevErrorDetect = true
      CanNmImmediateTxconfEnabled = false
      CanNmMainFunctionPeriod = 0.01
      CanNmPassiveModeEnabled = false
      CanNmPduRxIndicationEnabled = false
      CanNmRemoteSleepIndEnabled = false
      CanNmStateChangeIndEnabled = true
      CanNmVersionInfoApi = false
      CanNmDisableTxErrReport = false
      CanNmApiOptimization = false
      CanNmCanIfRangeConfigDLCCheck = true
      CanNmRuntimeMeasurementSupport = false
      CanNmSafeBswChecks = false
      CanNmComControlEnabled = false
      CanNmImmediateRestartEnabled = false
      CanNmNodeDetectionEnabled = false
      CanNmRepeatMsgIndEnabled = false
      CanNmNodeIdEnabled = true
      CanNmNumberOfChannels = 1
      CAN00_CAN_5faa4e95 (CanNmChannelConfig):
        CanNmMsgCycleOffset = 0
        CanNmMsgCycleTime = 0.1
        CanNmMsgReducedTime = 0.05
        CanNmNodeId = 2
        CanNmRepeatMessageTime = 0.4
        CanNmTimeoutTime = 1
        CanNmUserDataLength = 6
        CanNmWaitBusSleepTime = 0.75
        CanNmBusLoadReductionActive = false
        CanNmCarWakeUpRxEnabled = false
        CanNmImmediateNmTransmissions = 0
        CanNmMsgTimeoutTime = 0.06
        CanNmPduCbvPosition = CANNM_PDU_BYTE_0
        CanNmPduNidPosition = CANNM_PDU_BYTE_1
        CanNmRemoteSleepIndTime = 0.5
        CanNmActiveWakeupBitEnabled = false
        CanNmNodeIdEnabled = true
        CanNmNodeDetectionEnabled = false
        CanNmRepeatMsgIndEnabled = false
        CanNmImmediateRestartEnabled = false
        CanNmComControlEnabled = false
        CanNmCriBitAlwaysEnabled = false
        CanNmComMNetworkHandleRef = ComMConfigSet/CN_CAN00_a2373004
        NmBFC_oCAN00_4874935e_Tx (CanNmTxPdu): CanNmTxConfirmationPduId=0, CanNmTxPduRef=EcucPduCollection/NmBFC_oCAN00_4874935e_Tx
        CAN00_CAN_5faa4e95_Rx (CanNmRxPdu): CanNmRxPduId=0, CanNmRxPduRef=BFC_f09b214a_Rx
      CanNmPnInfo: CanNmPnInfoLength=1, CanNmPnInfoOffset=1
      CanNmGeneration: CanNmOutOfBoundsWriteSanitizer=false, CanNmOutOfBoundsReadSanitizer=false, CanNmInterfacesForDeactivatedData=false
  module config ComM: implementation-config-variant=VARIANT-PRE-COMPILE, module-description=ComM_Impl
    ComMGeneral:
      ComMPncIdCounting = COMM_PNC_ID_COUNT_FROM_NM_MESSAGE
      ComMPncSupport = false
      ComMDevErrorDetect = true
      ComMEcuGroupClassification = 3
      ComMModeLimitationEnabled = false
      ComMSynchronousWakeUp = true
      ComMTMinFullComModeDuration = 5
      ComMVersionInfoApi = false
      ComMWakeupInhibitionEnabled = false
      ComMSafeBswChecks = false
      ComMGeneration: ComMOutOfBoundsWriteSanitizer=false, ComMOutOfBoundsReadSanitizer=false
    ComMConfigSet: ComMPncEnabled=false
      CN_CAN00_a2373004 (ComMChannel):
        ComMBusType = COMM_BUS_TYPE_CAN
        ComMChannelId = 0
        ComMFullCommRequestNotificationEnabled = false
        ComMMainFunctionPeriod = 0.02
        ComMNoCom = false
        ComMNoWakeup = false
        ComMGlobalNvmBlockDescriptor = false
        CN_CAN00_6854f362 (ComMUserPerChannel): ComMUserChannel=USR_CHNL_f276589c
        ComMNetworkManagement: ComMNmVariant=FULL, ComMPncNmRequest=false
      USR_CHNL_f276589c (ComMUser): ComMUserIdentifier=0, ComMUserModeNotification=false  # CN_CAN00
  module config Crc: implementation-config-variant=VARIANT-PRE-COMPILE, module-description=Crc_Impl
    CrcGeneral:
      Crc16Mode = CRC_16_RUNTIME
      Crc32Mode = CRC_32_RUNTIME
      Crc8Mode = CRC_8_RUNTIME
      CrcVersionInfoApi = true
      Crc8H2FMode = CRC_8H2F_RUNTIME
      Crc32P4Mode = CRC_32P4_RUNTIME
      Crc64Mode = CRC_64_RUNTIME
