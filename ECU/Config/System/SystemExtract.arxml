AUTOSAR XML (schema 00048)
standard types defined: boolean, uint8
package /VehicleProject
  system System
package /NM
  nm config NmConfig: can-nm-cluster-coupling=coupled-cluster=CAN00_CAN
    can nm cluster CAN00_CAN: communication-cluster=CAN00, nm-channel-id=0, nm-msg-cycle-time=0.1, nm-network-timeout=1, nm-repeat-message-time=0.4, nm-user-data-length=6, nm-wait-bus-sleep-time=0.75
      can nm node BFC: controller=CT_CAN00, nm-if-ecu=BFC_CAN, nm-node-id=2, tx-nm-pdu=NmBFC_oCAN00, nm-msg-cycle-offset=0, nm-msg-reduced-time=0.05, nm-range-config={lower-can-id=1024, upper-can-id=1087}
      can nm node HLC: nm-if-ecu=HLC_CAN, nm-node-id=3, nm-msg-cycle-offset=0, nm-msg-reduced-time=0.05, nm-range-config={lower-can-id=1024, upper-can-id=1087}
      can nm node LSW: nm-if-ecu=LSW_CAN, nm-node-id=1, nm-msg-cycle-offset=0, nm-msg-reduced-time=0.05, nm-range-config={lower-can-id=1024, upper-can-id=1087}
    nm-if-ecus:
      nm ecu BFC_CAN: ecu-instance=BFC, nm-node-id-enabled=true, nm-user-data-enabled=true
      nm ecu HLC_CAN: nm-node-id-enabled=true, nm-user-data-enabled=true
      nm ecu LSW_CAN: nm-node-id-enabled=true, nm-user-data-enabled=true
package /Cluster
  can cluster CAN00: baudrate=500000, protocol-name=CAN
    can physical channel CHNL: comm-connectors=CN_CAN00
      frame LightCtrl_oCAN00: id 0x268, from BFC, frame-length=8, can-addressing-mode=STANDARD
        pdu LightCtrl_oCAN00: length=8, minimum-delay=0, transmission-mode-false-timing=cyclic-timing={time-offset=0, time-period=0.01}, transmission-mode-true-timing=cyclic-timing={time-offset=0, time-period=0.01}, unused-bit-pattern=0
          signal HeadLight_oLightCtrl_oCAN00: start 0, 1 bit, little-endian, i-signal-type=PRIMITIVE, init-value=0, base-type=boolean, compu {0=Cx0_Off, 1=Cx1_On}, range raw 0..1, transfer-property=PENDING
      frame LightSwitch_oCAN00: id 0x210, to BFC, frame-length=2, can-addressing-mode=STANDARD
        pdu LightSwitch_oCAN00: length=2, minimum-delay=0, transmission-mode-false-timing=cyclic-timing={time-offset=0, time-period=0.1}, transmission-mode-true-timing=cyclic-timing={time-offset=0, time-period=0.1}, unused-bit-pattern=0
          signal LightSwitch_oLightSwitch_oCAN00: start 0, 2 bit, little-endian, i-signal-type=PRIMITIVE, init-value=0, base-type=uint8, invalid-value=3, compu {0=Cx0_Off, 1=Cx1_On, 2=Cx2_Auto, 3=Cx3_SNA} "Source signal range: [0,2]", range raw 0..3, transfer-property=PENDING, to BFC
      frame NmBFC_oCAN00: id 0x402, from BFC, frame-length=8, can-addressing-mode=STANDARD
        nm pdu NmBFC_oCAN00: length=8, unused-bit-pattern=0
package /ECU
  ecu instance BFC: associated-com-i-pdu-group=[BFC_oCAN00_Rx, BFC_oCAN00_Tx]
    can communication controller CT_CAN00
    can communication connector CN_CAN00: comm-controller=CT_CAN00
package /IPDUGroup
  i signal i pdu group BFC_oCAN00_Rx: communication-direction=IN, i-signal-i-pdus=LightSwitch_oCAN00
  i signal i pdu group BFC_oCAN00_Tx: communication-direction=OUT, i-signal-i-pdus=LightCtrl_oCAN00
