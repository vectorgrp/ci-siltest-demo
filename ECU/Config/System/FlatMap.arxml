AUTOSAR XML (schema 00046)
package /COM/VECTOR/CFG/WORKFLOW/SYSDESC/SYNC
  flat map FLATMAP
    7 x flat instance descriptor:
      HeadLight: upstream-reference=ECU_Composition.Output.HeadLight, ecu-extract-reference=COMPOSITIONTYPE.Output.HeadLight
      Output: upstream-reference=ECU_Composition.Output, ecu-extract-reference=COMPOSITIONTYPE.Output
      LightSwitch: upstream-reference=ECU_Composition.Input.LightSwitch, ecu-extract-reference=COMPOSITIONTYPE.Input.LightSwitch
      Input: upstream-reference=ECU_Composition.Input, ecu-extract-reference=COMPOSITIONTYPE.Input
      BSW_Handler: upstream-reference=ECU_Composition.BSW_Handler, ecu-extract-reference=COMPOSITIONTYPE.BSW_Handler
      IoHwAb: upstream-reference=ECU_Composition.IoHwAb, ecu-extract-reference=COMPOSITIONTYPE.IoHwAb
      LightCtrl: upstream-reference=ECU_Composition.LightCtrl, ecu-extract-reference=COMPOSITIONTYPE.LightCtrl
