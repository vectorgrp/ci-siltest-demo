AUTOSAR XML (schema 4-1-1)
package /MICROSAR_SWCS_DEV/ComM_swc/Interfaces
  mode switch interface ComM_CurrentMode: is-service=true
    mode group currentMode: sw-calibration-access=READ-WRITE, type=ComMMode
package /MICROSAR_SWCS_DEV/IoHwAb_swc/Interfaces
  client server interface LightIntensity
    operation LightIntensity
      arg io_signal: type=uint16, direction=OUT
    error E_NOT_OK: error-code=1
package /PortInterfaces
  sender receiver interface Input
    data LightSwitch: type=uint8
  sender receiver interface Output
    data HeadLight: type=Boolean
