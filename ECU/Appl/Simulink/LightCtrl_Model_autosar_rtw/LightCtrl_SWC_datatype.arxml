AUTOSAR XML (schema 4-1-1)
standard types defined: uint8, boolean, sint32, uint16
package /DataTypes/PlatformTypes/Ground
  constant specification DefaultInitValue_uint8: value-spec=0
  constant specification DefaultInitValue_Boolean: value-spec=0
package /DataTypes/PlatformTypes/DataConstrs
  range DC_Boolean: raw 0..1
