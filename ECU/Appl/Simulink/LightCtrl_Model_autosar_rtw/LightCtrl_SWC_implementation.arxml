AUTOSAR XML (schema 4-1-1)
package /ComponentTypes
  swc implementation LightCtrl_imp: programming-language=C, sw-version=1.1.1, used-code-generator=Embedded Coder 6.7 (R2014b) 08-Sep-2014, vendor-id=0, behavior=LightCtrl_InternalBehavior
    code-descriptors:
      code Code
        artifact-descriptors:
          short-label=LightCtrl_SWC_c, category=SWSRC
          short-label=LightCtrl_SWC_data_c, category=SWSRC
          short-label=LightCtrl_SWC_h, category=SWHDR
          short-label=LightCtrl_SWC_private_h, category=SWHDR
          short-label=LightCtrl_SWC_types_h, category=SWHDR
          short-label=rtwtypes_h, category=SWHDR
    resource consumption RsrcCons_LightCtrl_SWC
