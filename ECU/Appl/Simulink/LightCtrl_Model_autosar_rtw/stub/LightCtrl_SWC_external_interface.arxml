AUTOSAR XML (schema 4-1-1)
package /MICROSAR_SWCS_DEV/ComM_swc/Interfaces
  client server interface ComM_UserRequest: is-service=true
    4 x operation, all with possible-error=E_NOT_OK:
      GetCurrentComMode
        arg ComMode: type=ComM_ModeType, direction=OUT
      GetMaxComMode
        arg ComMode: type=ComM_ModeType, direction=OUT
      GetRequestedComMode
        arg ComMode: type=ComM_ModeType, direction=OUT
      RequestComMode
        arg ComMode: type=ComM_ModeType, direction=IN
    error E_MODE_LIMITATION: error-code=2
    error E_NOT_OK: error-code=1
