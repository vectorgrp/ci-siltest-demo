/*@!Encoding:65001*/
includes
{
}

variables
{
  const long cHystOnDelay = 2000;
  const long cHystOffDelay = 3000;
  const long cEpsilon = 100;
  const long cLowerThreshold = 60;
  const long cUpperThreshold = 70;
  char CBStr[101];
  const int cMessageTimeout = 500;
  const int cSignalTimeout = 500;
}

void SetLightSwitch (int lightswitch)
{
  @Interface::LightSwitch = lightswitch;
}

void SetLightIntensity (double lightintensity)
{
  @Interface::LightIntensity = lightintensity;
  // Given percentage value in the range [0, 100] is transferred
  // to the voltage in the range [0, 3.3] as expected by the Adc module.
  //@sysvar::VTT::BFC::Adc::AdcLightIntensity = 3.3 * lightintensity / 100.0;
}

RangeViolationCallback(dword checkID)
{
  testStepFail(CBStr);
  ChkControl_Stop(checkID);
}

CheckSignalForValueForTime(int value, signal * sig, long timeout, char passstr[], char failstr[])
{
  dword checkID;
  long result;

  strncpy(CBStr,failstr,100);
  checkID = ChkCreate_MsgSignalValueRangeViolation(sig,value,value,"RangeViolationCallback");
  ChkControl_Start(checkID);
  testWaitForTimeout(timeout);
  result = ChkQuery_NumEvents(checkID);
  if ( result == 0 )
  {
    ChkControl_Stop(checkID);
    testStepPass(passstr);
  }
}

export testcase CheckPreReq()
{
  long result;

  // Toggle SysVars
  SetLightSwitch(@sysvar::Interface::LightSwitch::On);
  SetLightIntensity(100);
  testWaitForTimeout(1000);
  SetLightSwitch(@sysvar::Interface::LightSwitch::Off);
  SetLightIntensity(0);
  testWaitForTimeout(1000);

  // Check ECU general reaction (CAN msg)
  testCaseTitle("TC CheckPreReq","Check setting the prerequisites");
  SetLightSwitch(@sysvar::Interface::LightSwitch::Off);
  SetLightIntensity(0);
  result = testWaitForMessage(LightCtrl, 500);
  if ( result < 1 )
  {
    testStepFail("LightCtrl message Rx timeout");
    return;
  }
  testStepPass("LightCtrl message Rx OK");

  // Check starting conditions
  result = testWaitForSignalMatch(HeadLight,0,500);
  if ( result < 1 )
  {
    testStepFail("Headlight did not switch off");
    return;
  }
  testStepPass("Headlight is off");
  testWaitForTimeout(500);
}

export testcase CheckInstantAutoOnAfterOff()
{
  long result;
  
  testCaseTitle("TC CheckInstantAutoOnAfterOff","Check automatically turning immediatly on when dark and switching to Auto");
  // Init Testcase
  SetLightSwitch(@sysvar::Interface::LightSwitch::Off);
  SetLightIntensity(0);
  testWaitForMessage(LightSwitch, 500);
  testWaitForMessage(LightCtrl, 500);
  testWaitForMessage(LightCtrl, 500);
  
  // Test functionality
  SetLightSwitch(@sysvar::Interface::LightSwitch::Auto);
  testWaitForTimeout(cEpsilon);
  result = testWaitForSignalMatch(HeadLight,1,cEpsilon);
  if ( result != 1 )
  {
    testStepFail("Headlight did not switch on immediatly");
    return;
  }
  testStepPass("Headlight switched on immediatly");
  
  CheckSignalForValueForTime(1,HeadLight,_max(cHystOnDelay,cHystOffDelay)
  ,"Headlight stayed on after switching hysteresis time"
  ,"Headlight did not stay on after switching hysteresis time");
  testWaitForTimeout(500);
}

export testcase CheckStayAutoOffAfterOff()
{
  long result;
    
  testCaseTitle("TC CheckStayAutoOffAfterOff","Check automatic stays off when not dark and switching to Auto");
  // Init Testcase
  SetLightSwitch(@sysvar::Interface::LightSwitch::Off);
  SetLightIntensity(0);
  testWaitForTimeout(cEpsilon);
  SetLightIntensity(90);
  testWaitForMessage(LightSwitch, 500);
  testWaitForMessage(LightCtrl, 500);
  testWaitForMessage(LightCtrl, 500);
  
  // Test functionality
  SetLightSwitch(@sysvar::Interface::LightSwitch::Auto);
  testWaitForTimeout(cEpsilon);
  result = testWaitForSignalMatch(HeadLight,0,cEpsilon);
  if ( result != 1 )
  {
    testStepFail("Headlight did not stay off after switching to Auto");
    return;
  }
  testStepPass("Headlight stayed off after switching to Auto");

  CheckSignalForValueForTime(0,HeadLight,_max(cHystOnDelay,cHystOffDelay)
  ,"Headlight stayed off after switching hysteresis time"
  ,"Headlight did not stay off after switching hysteresis time");
  testWaitForTimeout(500);
}

export testcase CheckAutoOffAmbLightOn()
{
  long result;
  
  testCaseTitle("TC CheckAutoOffAmbLightOn","Check automatically turning off when ambient light turns on");

  // Init Testcase
  testWaitForTimeout(cEpsilon);
  SetLightIntensity(0);
  SetLightSwitch(@sysvar::Interface::LightSwitch::On);
  testWaitForTimeout(cEpsilon);
  SetLightSwitch(@sysvar::Interface::LightSwitch::Auto);
  testWaitForTimeout(cEpsilon*2);
  
  // Test functionality
  SetLightIntensity(90);
  CheckSignalForValueForTime(1,HeadLight,cHystOffDelay - 2*cEpsilon
  ,"Headlight stayed on long enough after light intensity rise"
  ,"Headlight turned off too fast after light intensity rise");
  testWaitForTimeout(cEpsilon);
  result = testWaitForSignalMatch(HeadLight,0,2*cEpsilon);
  if ( result != 1 )
  {
    testStepFail("Headlight did not turn off after light intensity rise");
    return;
  }
  testStepPass("Headlight turned off after light intensity rise");
  testWaitForTimeout(500);
}

export testcase CheckAutoOnAmbLightOff()
{
  long result;
  
  testCaseTitle("TC CheckAutoOnAmbLightOff","Check automatically turning on when ambient light turns off");

  // Init Testcase
  SetLightIntensity(100);
  SetLightSwitch(@sysvar::Interface::LightSwitch::Off);
  testWaitForTimeout(cEpsilon);
  SetLightSwitch(@sysvar::Interface::LightSwitch::Auto);
  testWaitForTimeout(cEpsilon*2);
  
  // Test functionality
  SetLightIntensity(cLowerThreshold - 1);
  CheckSignalForValueForTime(0,HeadLight,cHystOnDelay - 2*cEpsilon
  ,"Headlight stayed off long enough after light intensity drop"
  ,"Headlight turned on too fast after light intensity drop");
  testWaitForTimeout(cEpsilon);
  result = testWaitForSignalMatch(HeadLight, 1, 2*cEpsilon);
  if ( result != 1 )
  {
    testStepFail("Headlight did not turn on after light intensity drop");
    return;
  }
  testStepPass("Headlight turned on after light intensity drop");
  testWaitForTimeout(500);
}
