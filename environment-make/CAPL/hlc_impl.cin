/*@!Encoding:1252*/
variables
{
  enum implementation_types implementation = CAPL;
}